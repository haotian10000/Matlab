/******************************************************************************
* ASAP2 file: LP_VCU020_AA_VCU.a2l
* Code generation for model "LP_VCU020_AA_VCU".
* Model version : 1.8210
* Simulink Coder version : 8.13 (R2017b) 24-Jul-2017
* C source code generated on : Fri Apr 10 14:51:16 2020
* Target selection: ert.tlc
* Embedded hardware selection: Freescale->32-bit PowerPC
* Code generation objectives:
* 1. MISRA C:2012 guidelines
* 2. Polyspace
* 3. Execution efficiency
* 4. Safety precaution
* 5. ROM efficiency
* 6. RAM efficiency
* 7. Traceability
* 8. Debugging
* Validation result: Not run
* (add additional file header information here)
******************************************************************************/ ASAP2_VERSION 1 31
/* Version 1.31 */
/begin PROJECT ProjectName "Project Comment Goes Here"
/begin HEADER "Header Comments go here" /end HEADER
/begin MODULE ModuleName "Module Comment Goes Here"
/begin MOD_PAR "MOD PAR Comment Goes Here" /end MOD_PAR
/begin MOD_COMMON "Mod Common Comment Here" BYTE_ORDER MSB_FIRST /end MOD_COMMON
/begin RECORD_LAYOUT Scalar_BOOLEAN FNC_VALUES 1 UBYTE COLUMN_DIR DIRECT /end RECORD_LAYOUT
/begin RECORD_LAYOUT Scalar_UBYTE FNC_VALUES 1 UBYTE COLUMN_DIR DIRECT /end RECORD_LAYOUT
/begin RECORD_LAYOUT Scalar_BYTE FNC_VALUES 1 SBYTE COLUMN_DIR DIRECT /end RECORD_LAYOUT
/begin RECORD_LAYOUT Scalar_UWORD FNC_VALUES 1 UWORD COLUMN_DIR DIRECT /end RECORD_LAYOUT
/begin RECORD_LAYOUT Scalar_SWORD FNC_VALUES 1 SWORD COLUMN_DIR DIRECT /end RECORD_LAYOUT
/begin RECORD_LAYOUT Scalar_ULONG FNC_VALUES 1 ULONG COLUMN_DIR DIRECT /end RECORD_LAYOUT
/begin RECORD_LAYOUT Scalar_LONG FNC_VALUES 1 SLONG COLUMN_DIR DIRECT /end RECORD_LAYOUT
/begin RECORD_LAYOUT Scalar_FLOAT32_IEEE FNC_VALUES 1 FLOAT32_IEEE COLUMN_DIR DIRECT /end RECORD_LAYOUT
/begin RECORD_LAYOUT Scalar_FLOAT64_IEEE FNC_VALUES 1 FLOAT64_IEEE COLUMN_DIR DIRECT /end RECORD_LAYOUT
/begin RECORD_LAYOUT Lookup1D_BOOLEAN FNC_VALUES 1 UBYTE COLUMN_DIR DIRECT /end RECORD_LAYOUT
/begin RECORD_LAYOUT Lookup1D_X_BOOLEAN AXIS_PTS_X 1 UBYTE INDEX_INCR DIRECT /end RECORD_LAYOUT
/begin RECORD_LAYOUT Lookup1D_BYTE FNC_VALUES 1 SBYTE COLUMN_DIR DIRECT /end RECORD_LAYOUT
/begin RECORD_LAYOUT Lookup1D_X_BYTE AXIS_PTS_X 1 SBYTE INDEX_INCR DIRECT /end RECORD_LAYOUT
/begin RECORD_LAYOUT Lookup1D_UBYTE FNC_VALUES 1 UBYTE COLUMN_DIR DIRECT /end RECORD_LAYOUT
/begin RECORD_LAYOUT Lookup1D_X_UBYTE AXIS_PTS_X 1 UBYTE INDEX_INCR DIRECT /end RECORD_LAYOUT
/begin RECORD_LAYOUT Lookup1D_UWORD FNC_VALUES 1 UWORD COLUMN_DIR DIRECT /end RECORD_LAYOUT
/begin RECORD_LAYOUT Lookup1D_X_UWORD AXIS_PTS_X 1 UWORD INDEX_INCR DIRECT /end RECORD_LAYOUT
/begin RECORD_LAYOUT Lookup1D_WORD FNC_VALUES 1 SWORD COLUMN_DIR DIRECT /end RECORD_LAYOUT
/begin RECORD_LAYOUT Lookup1D_X_WORD AXIS_PTS_X 1 SWORD INDEX_INCR DIRECT /end RECORD_LAYOUT
/begin RECORD_LAYOUT Lookup1D_ULONG FNC_VALUES 1 ULONG COLUMN_DIR DIRECT /end RECORD_LAYOUT
/begin RECORD_LAYOUT Lookup1D_X_ULONG AXIS_PTS_X 1 ULONG INDEX_INCR DIRECT /end RECORD_LAYOUT
/begin RECORD_LAYOUT Lookup1D_SLONG FNC_VALUES 1 SLONG COLUMN_DIR DIRECT /end RECORD_LAYOUT
/begin RECORD_LAYOUT Lookup1D_X_LONG AXIS_PTS_X 1 SLONG INDEX_INCR DIRECT /end RECORD_LAYOUT
/begin RECORD_LAYOUT Lookup1D_FLOAT32_IEEE FNC_VALUES 1 FLOAT32_IEEE COLUMN_DIR DIRECT /end RECORD_LAYOUT
/begin RECORD_LAYOUT Lookup1D_X_FLOAT32_IEEE AXIS_PTS_X 1 FLOAT32_IEEE INDEX_INCR DIRECT /end RECORD_LAYOUT
/begin RECORD_LAYOUT Lookup1D_FLOAT64_IEEE FNC_VALUES 1 FLOAT64_IEEE COLUMN_DIR DIRECT /end RECORD_LAYOUT
/begin RECORD_LAYOUT Lookup1D_X_FLOAT64_IEEE AXIS_PTS_X 1 FLOAT64_IEEE INDEX_INCR DIRECT /end RECORD_LAYOUT
/begin RECORD_LAYOUT Lookup2D_BOOLEAN FNC_VALUES 1 UBYTE COLUMN_DIR DIRECT /end RECORD_LAYOUT
/begin RECORD_LAYOUT Lookup2D_X_BOOLEAN AXIS_PTS_X 1 UBYTE INDEX_INCR DIRECT /end RECORD_LAYOUT
/begin RECORD_LAYOUT Lookup2D_UBYTE FNC_VALUES 1 UBYTE COLUMN_DIR DIRECT /end RECORD_LAYOUT
/begin RECORD_LAYOUT Lookup2D_X_UBYTE AXIS_PTS_X 1 UBYTE INDEX_INCR DIRECT /end RECORD_LAYOUT
/begin RECORD_LAYOUT Lookup2D_BYTE FNC_VALUES 1 SBYTE COLUMN_DIR DIRECT /end RECORD_LAYOUT
/begin RECORD_LAYOUT Lookup2D_X_BYTE AXIS_PTS_X 1 SBYTE INDEX_INCR DIRECT /end RECORD_LAYOUT
/begin RECORD_LAYOUT Lookup2D_UWORD FNC_VALUES 1 UWORD COLUMN_DIR DIRECT /end RECORD_LAYOUT
/begin RECORD_LAYOUT Lookup2D_X_UWORD AXIS_PTS_X 1 UWORD INDEX_INCR DIRECT /end RECORD_LAYOUT
/begin RECORD_LAYOUT Lookup2D_WORD FNC_VALUES 1 SWORD COLUMN_DIR DIRECT /end RECORD_LAYOUT
/begin RECORD_LAYOUT Lookup2D_X_WORD AXIS_PTS_X 1 SWORD INDEX_INCR DIRECT /end RECORD_LAYOUT
/begin RECORD_LAYOUT Lookup2D_ULONG FNC_VALUES 1 ULONG COLUMN_DIR DIRECT /end RECORD_LAYOUT
/begin RECORD_LAYOUT Lookup2D_X_ULONG AXIS_PTS_X 1 ULONG INDEX_INCR DIRECT /end RECORD_LAYOUT
/begin RECORD_LAYOUT Lookup2D_LONG FNC_VALUES 1 SLONG COLUMN_DIR DIRECT /end RECORD_LAYOUT
/begin RECORD_LAYOUT Lookup2D_X_LONG AXIS_PTS_X 1 SLONG INDEX_INCR DIRECT /end RECORD_LAYOUT
/begin RECORD_LAYOUT Lookup2D_FLOAT32_IEEE FNC_VALUES 1 FLOAT32_IEEE COLUMN_DIR DIRECT /end RECORD_LAYOUT
/begin RECORD_LAYOUT Lookup2D_X_FLOAT32_IEEE AXIS_PTS_X 1 FLOAT32_IEEE INDEX_INCR DIRECT /end RECORD_LAYOUT
/begin RECORD_LAYOUT Lookup2D_FLOAT64_IEEE FNC_VALUES 1 FLOAT64_IEEE COLUMN_DIR DIRECT /end RECORD_LAYOUT
/begin RECORD_LAYOUT Lookup2D_X_FLOAT64_IEEE AXIS_PTS_X 1 FLOAT64_IEEE INDEX_INCR DIRECT /end RECORD_LAYOUT
/begin CHARACTERISTIC CalCrv_AccPdlPctUpRateLimit "" CURVE 0x0000 /* @ECU_Address@CalCrv_AccPdlPctUpRateLimit@ */ Lookup1D_FLOAT32_IEEE 0 LP_VCU020_AA_VCU_CM_single_Pct_s 0.0 20000.0
 /begin AXIS_DESCR COM_AXIS NO_INPUT_QUANTITY LP_VCU020_AA_VCU_CM_single_kph 9 -300.0 300.0 AXIS_PTS_REF CalCrvX_VehSpdPoint2PdlRateLimit /end AXIS_DESCR
/end CHARACTERISTIC
/begin AXIS_PTS CalCrvX_VehSpdPoint2PdlRateLimit "" 0x0000 /* @ECU_Address@CalCrvX_VehSpdPoint2PdlRateLimit@ */ NO_INPUT_QUANTITY Lookup1D_X_FLOAT32_IEEE 0 LP_VCU020_AA_VCU_CM_single_kph 9 -300.0 300.0 /end AXIS_PTS
/begin CHARACTERISTIC CalCrv_AccPdlPctDnRateLimit "" CURVE 0x0000 /* @ECU_Address@CalCrv_AccPdlPctDnRateLimit@ */ Lookup1D_FLOAT32_IEEE 0 LP_VCU020_AA_VCU_CM_single_Pct_s 0.0 20000.0
 /begin AXIS_DESCR COM_AXIS NO_INPUT_QUANTITY LP_VCU020_AA_VCU_CM_single_kph 9 -300.0 300.0 AXIS_PTS_REF CalCrvX_VehSpdPoint2PdlRateLimit /end AXIS_DESCR
/end CHARACTERISTIC
/begin CHARACTERISTIC CalCrv_AccPdlPctLPFKd "" CURVE 0x0000 /* @ECU_Address@CalCrv_AccPdlPctLPFKd@ */ Lookup1D_FLOAT32_IEEE 0 LP_VCU020_AA_VCU_CM_single 0.0 1.0
 /begin AXIS_DESCR COM_AXIS NO_INPUT_QUANTITY LP_VCU020_AA_VCU_CM_single_kph 6 -300.0 300.0 AXIS_PTS_REF CalCrvX_VehSpd2AccPdl /end AXIS_DESCR
/end CHARACTERISTIC
/begin AXIS_PTS CalCrvX_VehSpd2AccPdl "" 0x0000 /* @ECU_Address@CalCrvX_VehSpd2AccPdl@ */ NO_INPUT_QUANTITY Lookup1D_X_FLOAT32_IEEE 0 LP_VCU020_AA_VCU_CM_single_kph 6 -300.0 300.0 /end AXIS_PTS
/begin CHARACTERISTIC CalMap_MotDrvEff "" MAP 0x0000 /* @ECU_Address@CalMap_MotDrvEff@ */ Lookup2D_FLOAT32_IEEE 0 LP_VCU020_AA_VCU_CM_single_pct 0.0 100.0
 /begin AXIS_DESCR COM_AXIS NO_INPUT_QUANTITY LP_VCU020_AA_VCU_CM_single_kph 25 -300.0 300.0 AXIS_PTS_REF CalMapX_VehSpdPoint2MotEff /end AXIS_DESCR
 /begin AXIS_DESCR COM_AXIS NO_INPUT_QUANTITY LP_VCU020_AA_VCU_CM_single_Nm 17 -10000.0 10000.0 AXIS_PTS_REF CalMapY_MotTrqPoint2MotEff /end AXIS_DESCR
/end CHARACTERISTIC
/begin AXIS_PTS CalMapY_MotTrqPoint2MotEff "" 0x0000 /* @ECU_Address@CalMapY_MotTrqPoint2MotEff@ */ NO_INPUT_QUANTITY Lookup2D_X_FLOAT32_IEEE 0 LP_VCU020_AA_VCU_CM_single_Nm 17 -10000.0 10000.0 /end AXIS_PTS
/begin AXIS_PTS CalMapX_VehSpdPoint2MotEff "" 0x0000 /* @ECU_Address@CalMapX_VehSpdPoint2MotEff@ */ NO_INPUT_QUANTITY Lookup2D_X_FLOAT32_IEEE 0 LP_VCU020_AA_VCU_CM_single_kph 25 -300.0 300.0 /end AXIS_PTS
/begin CHARACTERISTIC CalCrv_MotExCharDrvTrq "" CURVE 0x0000 /* @ECU_Address@CalCrv_MotExCharDrvTrq@ */ Lookup1D_FLOAT32_IEEE 0 LP_VCU020_AA_VCU_CM_single_Nm -10000.0 10000.0
 /begin AXIS_DESCR COM_AXIS NO_INPUT_QUANTITY LP_VCU020_AA_VCU_CM_single_kph 25 -300.0 300.0 AXIS_PTS_REF CalCrvX_VehSpd2ExChar /end AXIS_DESCR
/end CHARACTERISTIC
/begin AXIS_PTS CalCrvX_VehSpd2ExChar "" 0x0000 /* @ECU_Address@CalCrvX_VehSpd2ExChar@ */ NO_INPUT_QUANTITY Lookup1D_X_FLOAT32_IEEE 0 LP_VCU020_AA_VCU_CM_single_kph 25 -300.0 300.0 /end AXIS_PTS
/begin CHARACTERISTIC CalCrv_MotExCharRecTrq "" CURVE 0x0000 /* @ECU_Address@CalCrv_MotExCharRecTrq@ */ Lookup1D_FLOAT32_IEEE 0 LP_VCU020_AA_VCU_CM_single_Nm -10000.0 10000.0
 /begin AXIS_DESCR COM_AXIS NO_INPUT_QUANTITY LP_VCU020_AA_VCU_CM_single_kph 25 -300.0 300.0 AXIS_PTS_REF CalCrvX_VehSpd2ExChar /end AXIS_DESCR
/end CHARACTERISTIC
/begin CHARACTERISTIC CalMap_DrvTrqLv1Rec2Zero "" MAP 0x0000 /* @ECU_Address@CalMap_DrvTrqLv1Rec2Zero@ */ Lookup2D_FLOAT32_IEEE 0 LP_VCU020_AA_VCU_CM_single_Nm -10000.0 10000.0
 /begin AXIS_DESCR COM_AXIS NO_INPUT_QUANTITY LP_VCU020_AA_VCU_CM_single_pct 21 0.0 100.0 AXIS_PTS_REF CalMapX_PdlPctPoint2Drv /end AXIS_DESCR
 /begin AXIS_DESCR COM_AXIS NO_INPUT_QUANTITY LP_VCU020_AA_VCU_CM_single_kph 66 -300.0 300.0 AXIS_PTS_REF CalMapY_RefSpdPonit /end AXIS_DESCR
/end CHARACTERISTIC
/begin AXIS_PTS CalMapY_RefSpdPonit "" 0x0000 /* @ECU_Address@CalMapY_RefSpdPonit@ */ NO_INPUT_QUANTITY Lookup2D_X_FLOAT32_IEEE 0 LP_VCU020_AA_VCU_CM_single_kph 66 -300.0 300.0 /end AXIS_PTS
/begin AXIS_PTS CalMapX_PdlPctPoint2Drv "" 0x0000 /* @ECU_Address@CalMapX_PdlPctPoint2Drv@ */ NO_INPUT_QUANTITY Lookup2D_X_FLOAT32_IEEE 0 LP_VCU020_AA_VCU_CM_single_pct 21 0.0 100.0 /end AXIS_PTS
/begin CHARACTERISTIC CalMap_DrvTrqLv1Slip2Zero "" MAP 0x0000 /* @ECU_Address@CalMap_DrvTrqLv1Slip2Zero@ */ Lookup2D_FLOAT32_IEEE 0 LP_VCU020_AA_VCU_CM_single_Nm -10000.0 10000.0
 /begin AXIS_DESCR COM_AXIS NO_INPUT_QUANTITY LP_VCU020_AA_VCU_CM_single_pct 21 0.0 100.0 AXIS_PTS_REF CalMapX_PdlPctPoint2Drv /end AXIS_DESCR
 /begin AXIS_DESCR COM_AXIS NO_INPUT_QUANTITY LP_VCU020_AA_VCU_CM_single_kph 66 -300.0 300.0 AXIS_PTS_REF CalMapY_RefSpdPonit /end AXIS_DESCR
/end CHARACTERISTIC
/begin CHARACTERISTIC CalMap_DrvTrqLv2Rec2Zero "" MAP 0x0000 /* @ECU_Address@CalMap_DrvTrqLv2Rec2Zero@ */ Lookup2D_FLOAT32_IEEE 0 LP_VCU020_AA_VCU_CM_single_Nm -10000.0 10000.0
 /begin AXIS_DESCR COM_AXIS NO_INPUT_QUANTITY LP_VCU020_AA_VCU_CM_single_pct 21 0.0 100.0 AXIS_PTS_REF CalMapX_PdlPctPoint2Drv /end AXIS_DESCR
 /begin AXIS_DESCR COM_AXIS NO_INPUT_QUANTITY LP_VCU020_AA_VCU_CM_single_kph 66 -300.0 300.0 AXIS_PTS_REF CalMapY_RefSpdPonit /end AXIS_DESCR
/end CHARACTERISTIC
/begin CHARACTERISTIC CalMap_DrvTrqLv2Slip2Zero "" MAP 0x0000 /* @ECU_Address@CalMap_DrvTrqLv2Slip2Zero@ */ Lookup2D_FLOAT32_IEEE 0 LP_VCU020_AA_VCU_CM_single_Nm -10000.0 10000.0
 /begin AXIS_DESCR COM_AXIS NO_INPUT_QUANTITY LP_VCU020_AA_VCU_CM_single_pct 21 0.0 100.0 AXIS_PTS_REF CalMapX_PdlPctPoint2Drv /end AXIS_DESCR
 /begin AXIS_DESCR COM_AXIS NO_INPUT_QUANTITY LP_VCU020_AA_VCU_CM_single_kph 66 -300.0 300.0 AXIS_PTS_REF CalMapY_RefSpdPonit /end AXIS_DESCR
/end CHARACTERISTIC
/begin CHARACTERISTIC CalMap_DrvTrqLv3Rec2Zero "" MAP 0x0000 /* @ECU_Address@CalMap_DrvTrqLv3Rec2Zero@ */ Lookup2D_FLOAT32_IEEE 0 LP_VCU020_AA_VCU_CM_single_Nm -10000.0 10000.0
 /begin AXIS_DESCR COM_AXIS NO_INPUT_QUANTITY LP_VCU020_AA_VCU_CM_single_pct 21 0.0 100.0 AXIS_PTS_REF CalMapX_PdlPctPoint2Drv /end AXIS_DESCR
 /begin AXIS_DESCR COM_AXIS NO_INPUT_QUANTITY LP_VCU020_AA_VCU_CM_single_kph 66 -300.0 300.0 AXIS_PTS_REF CalMapY_RefSpdPonit /end AXIS_DESCR
/end CHARACTERISTIC
/begin CHARACTERISTIC CalMap_DrvTrqLv3Slip2Zero "" MAP 0x0000 /* @ECU_Address@CalMap_DrvTrqLv3Slip2Zero@ */ Lookup2D_FLOAT32_IEEE 0 LP_VCU020_AA_VCU_CM_single_Nm -10000.0 10000.0
 /begin AXIS_DESCR COM_AXIS NO_INPUT_QUANTITY LP_VCU020_AA_VCU_CM_single_pct 21 0.0 100.0 AXIS_PTS_REF CalMapX_PdlPctPoint2Drv /end AXIS_DESCR
 /begin AXIS_DESCR COM_AXIS NO_INPUT_QUANTITY LP_VCU020_AA_VCU_CM_single_kph 66 -300.0 300.0 AXIS_PTS_REF CalMapY_RefSpdPonit /end AXIS_DESCR
/end CHARACTERISTIC
/begin CHARACTERISTIC CalCrv_DrvModeToggleTrqLPF "" CURVE 0x0000 /* @ECU_Address@CalCrv_DrvModeToggleTrqLPF@ */ Lookup1D_FLOAT32_IEEE 0 LP_VCU020_AA_VCU_CM_single 0.0 1.0
 /begin AXIS_DESCR COM_AXIS NO_INPUT_QUANTITY LP_VCU020_AA_VCU_CM_single_pct 6 0.0 100.0 AXIS_PTS_REF CalCrvX_DeltaPdlPct2DrvModeToggle /end AXIS_DESCR
/end CHARACTERISTIC
/begin AXIS_PTS CalCrvX_DeltaPdlPct2DrvModeToggle "" 0x0000 /* @ECU_Address@CalCrvX_DeltaPdlPct2DrvModeToggle@ */ NO_INPUT_QUANTITY Lookup1D_X_FLOAT32_IEEE 0 LP_VCU020_AA_VCU_CM_single_pct 6 0.0 100.0 /end AXIS_PTS
/begin CHARACTERISTIC CalMap_RecTrqLv1Rec2Zero "" MAP 0x0000 /* @ECU_Address@CalMap_RecTrqLv1Rec2Zero@ */ Lookup2D_FLOAT32_IEEE 0 LP_VCU020_AA_VCU_CM_single_Nm -10000.0 10000.0
 /begin AXIS_DESCR COM_AXIS NO_INPUT_QUANTITY LP_VCU020_AA_VCU_CM_single_pct 11 0.0 100.0 AXIS_PTS_REF CalMapX_PdlPctPoint2Rec /end AXIS_DESCR
 /begin AXIS_DESCR COM_AXIS NO_INPUT_QUANTITY LP_VCU020_AA_VCU_CM_single_kph 66 -300.0 300.0 AXIS_PTS_REF CalMapY_RefSpdPonit /end AXIS_DESCR
/end CHARACTERISTIC
/begin AXIS_PTS CalMapX_PdlPctPoint2Rec "" 0x0000 /* @ECU_Address@CalMapX_PdlPctPoint2Rec@ */ NO_INPUT_QUANTITY Lookup2D_X_FLOAT32_IEEE 0 LP_VCU020_AA_VCU_CM_single_pct 11 0.0 100.0 /end AXIS_PTS
/begin CHARACTERISTIC CalMap_RecTrqLv1Slip2Zero "" MAP 0x0000 /* @ECU_Address@CalMap_RecTrqLv1Slip2Zero@ */ Lookup2D_FLOAT32_IEEE 0 LP_VCU020_AA_VCU_CM_single_Nm -10000.0 10000.0
 /begin AXIS_DESCR COM_AXIS NO_INPUT_QUANTITY LP_VCU020_AA_VCU_CM_single_pct 11 0.0 100.0 AXIS_PTS_REF CalMapX_PdlPctPoint2Rec /end AXIS_DESCR
 /begin AXIS_DESCR COM_AXIS NO_INPUT_QUANTITY LP_VCU020_AA_VCU_CM_single_kph 66 -300.0 300.0 AXIS_PTS_REF CalMapY_RefSpdPonit /end AXIS_DESCR
/end CHARACTERISTIC
/begin CHARACTERISTIC CalMap_RecTrqLv2Rec2Zero "" MAP 0x0000 /* @ECU_Address@CalMap_RecTrqLv2Rec2Zero@ */ Lookup2D_FLOAT32_IEEE 0 LP_VCU020_AA_VCU_CM_single_Nm -10000.0 10000.0
 /begin AXIS_DESCR COM_AXIS NO_INPUT_QUANTITY LP_VCU020_AA_VCU_CM_single_pct 11 0.0 100.0 AXIS_PTS_REF CalMapX_PdlPctPoint2Rec /end AXIS_DESCR
 /begin AXIS_DESCR COM_AXIS NO_INPUT_QUANTITY LP_VCU020_AA_VCU_CM_single_kph 66 -300.0 300.0 AXIS_PTS_REF CalMapY_RefSpdPonit /end AXIS_DESCR
/end CHARACTERISTIC
/begin CHARACTERISTIC CalMap_RecTrqLv2Slip2Zero "" MAP 0x0000 /* @ECU_Address@CalMap_RecTrqLv2Slip2Zero@ */ Lookup2D_FLOAT32_IEEE 0 LP_VCU020_AA_VCU_CM_single_Nm -10000.0 10000.0
 /begin AXIS_DESCR COM_AXIS NO_INPUT_QUANTITY LP_VCU020_AA_VCU_CM_single_pct 11 0.0 100.0 AXIS_PTS_REF CalMapX_PdlPctPoint2Rec /end AXIS_DESCR
 /begin AXIS_DESCR COM_AXIS NO_INPUT_QUANTITY LP_VCU020_AA_VCU_CM_single_kph 66 -300.0 300.0 AXIS_PTS_REF CalMapY_RefSpdPonit /end AXIS_DESCR
/end CHARACTERISTIC
/begin CHARACTERISTIC CalMap_RecTrqLv3Rec2Zero "" MAP 0x0000 /* @ECU_Address@CalMap_RecTrqLv3Rec2Zero@ */ Lookup2D_FLOAT32_IEEE 0 LP_VCU020_AA_VCU_CM_single_Nm -10000.0 10000.0
 /begin AXIS_DESCR COM_AXIS NO_INPUT_QUANTITY LP_VCU020_AA_VCU_CM_single_pct 11 0.0 100.0 AXIS_PTS_REF CalMapX_PdlPctPoint2Rec /end AXIS_DESCR
 /begin AXIS_DESCR COM_AXIS NO_INPUT_QUANTITY LP_VCU020_AA_VCU_CM_single_kph 66 -300.0 300.0 AXIS_PTS_REF CalMapY_RefSpdPonit /end AXIS_DESCR
/end CHARACTERISTIC
/begin CHARACTERISTIC CalMap_RecTrqLv3Slip2Zero "" MAP 0x0000 /* @ECU_Address@CalMap_RecTrqLv3Slip2Zero@ */ Lookup2D_FLOAT32_IEEE 0 LP_VCU020_AA_VCU_CM_single_Nm -10000.0 10000.0
 /begin AXIS_DESCR COM_AXIS NO_INPUT_QUANTITY LP_VCU020_AA_VCU_CM_single_pct 11 0.0 100.0 AXIS_PTS_REF CalMapX_PdlPctPoint2Rec /end AXIS_DESCR
 /begin AXIS_DESCR COM_AXIS NO_INPUT_QUANTITY LP_VCU020_AA_VCU_CM_single_kph 66 -300.0 300.0 AXIS_PTS_REF CalMapY_RefSpdPonit /end AXIS_DESCR
/end CHARACTERISTIC
/begin CHARACTERISTIC CalCrv_CCSCtlKp2TarSpd "" CURVE 0x0000 /* @ECU_Address@CalCrv_CCSCtlKp2TarSpd@ */ Lookup1D_FLOAT32_IEEE 0 LP_VCU020_AA_VCU_CM_single 0.0 10000.0
 /begin AXIS_DESCR COM_AXIS NO_INPUT_QUANTITY LP_VCU020_AA_VCU_CM_single_kph 11 -300.0 300.0 AXIS_PTS_REF CalCrvX_CCSDeltaSpd /end AXIS_DESCR
/end CHARACTERISTIC
/begin AXIS_PTS CalCrvX_CCSDeltaSpd "" 0x0000 /* @ECU_Address@CalCrvX_CCSDeltaSpd@ */ NO_INPUT_QUANTITY Lookup1D_X_FLOAT32_IEEE 0 LP_VCU020_AA_VCU_CM_single_kph 11 -300.0 300.0 /end AXIS_PTS
/begin CHARACTERISTIC CalCrv_CCSCtlKi2TarSpd "" CURVE 0x0000 /* @ECU_Address@CalCrv_CCSCtlKi2TarSpd@ */ Lookup1D_FLOAT32_IEEE 0 LP_VCU020_AA_VCU_CM_single 0.0 10000.0
 /begin AXIS_DESCR COM_AXIS NO_INPUT_QUANTITY LP_VCU020_AA_VCU_CM_single_kph 11 -300.0 300.0 AXIS_PTS_REF CalCrvX_CCSDeltaSpd /end AXIS_DESCR
/end CHARACTERISTIC
/begin CHARACTERISTIC CalCrv_CCSCtlKd2TarSpd "" CURVE 0x0000 /* @ECU_Address@CalCrv_CCSCtlKd2TarSpd@ */ Lookup1D_FLOAT32_IEEE 0 LP_VCU020_AA_VCU_CM_single 0.0 10000.0
 /begin AXIS_DESCR COM_AXIS NO_INPUT_QUANTITY LP_VCU020_AA_VCU_CM_single_kph 11 -300.0 300.0 AXIS_PTS_REF CalCrvX_CCSDeltaSpd /end AXIS_DESCR
/end CHARACTERISTIC
/begin CHARACTERISTIC CalCrv_CreepTrqUpRateLimit "" CURVE 0x0000 /* @ECU_Address@CalCrv_CreepTrqUpRateLimit@ */ Lookup1D_FLOAT32_IEEE 0 LP_VCU020_AA_VCU_CM_single_Nm_s 0.0 20000.0
 /begin AXIS_DESCR COM_AXIS NO_INPUT_QUANTITY LP_VCU020_AA_VCU_CM_single_kph 9 -300.0 300.0 AXIS_PTS_REF CalCrvX_TrqPoint2CreepTrqRateLimit /end AXIS_DESCR
/end CHARACTERISTIC
/begin AXIS_PTS CalCrvX_TrqPoint2CreepTrqRateLimit "" 0x0000 /* @ECU_Address@CalCrvX_TrqPoint2CreepTrqRateLimit@ */ NO_INPUT_QUANTITY Lookup1D_X_FLOAT32_IEEE 0 LP_VCU020_AA_VCU_CM_single_kph 9 -300.0 300.0 /end AXIS_PTS
/begin CHARACTERISTIC CalCrv_CreepTrqDnRateLimit "" CURVE 0x0000 /* @ECU_Address@CalCrv_CreepTrqDnRateLimit@ */ Lookup1D_FLOAT32_IEEE 0 LP_VCU020_AA_VCU_CM_single_Nm_s 0.0 20000.0
 /begin AXIS_DESCR COM_AXIS NO_INPUT_QUANTITY LP_VCU020_AA_VCU_CM_single_kph 9 -300.0 300.0 AXIS_PTS_REF CalCrvX_TrqPoint2CreepTrqRateLimit /end AXIS_DESCR
/end CHARACTERISTIC
/begin CHARACTERISTIC CalCrv_CreepTrq "" CURVE 0x0000 /* @ECU_Address@CalCrv_CreepTrq@ */ Lookup1D_FLOAT32_IEEE 0 LP_VCU020_AA_VCU_CM_single_Nm -10000.0 10000.0
 /begin AXIS_DESCR COM_AXIS NO_INPUT_QUANTITY LP_VCU020_AA_VCU_CM_single_kph 21 -300.0 300.0 AXIS_PTS_REF CalCrvX_CreepSpd /end AXIS_DESCR
/end CHARACTERISTIC
/begin AXIS_PTS CalCrvX_CreepSpd "" 0x0000 /* @ECU_Address@CalCrvX_CreepSpd@ */ NO_INPUT_QUANTITY Lookup1D_X_FLOAT32_IEEE 0 LP_VCU020_AA_VCU_CM_single_kph 21 -300.0 300.0 /end AXIS_PTS
/begin CHARACTERISTIC CalCrv_CreepDTrq "" CURVE 0x0000 /* @ECU_Address@CalCrv_CreepDTrq@ */ Lookup1D_FLOAT32_IEEE 0 LP_VCU020_AA_VCU_CM_single_Nm -10000.0 10000.0
 /begin AXIS_DESCR COM_AXIS NO_INPUT_QUANTITY LP_VCU020_AA_VCU_CM_single_kph 21 -300.0 300.0 AXIS_PTS_REF CalCrvX_CreepSpd /end AXIS_DESCR
/end CHARACTERISTIC
/begin CHARACTERISTIC CalCrv_Kd2VehSpd "" CURVE 0x0000 /* @ECU_Address@CalCrv_Kd2VehSpd@ */ Lookup1D_FLOAT32_IEEE 0 LP_VCU020_AA_VCU_CM_single 0.0 1.0
 /begin AXIS_DESCR COM_AXIS NO_INPUT_QUANTITY LP_VCU020_AA_VCU_CM_single_kph 6 -300.0 300.0 AXIS_PTS_REF CalCrvX_VehSpdPoint2LPF /end AXIS_DESCR
/end CHARACTERISTIC
/begin AXIS_PTS CalCrvX_VehSpdPoint2LPF "" 0x0000 /* @ECU_Address@CalCrvX_VehSpdPoint2LPF@ */ NO_INPUT_QUANTITY Lookup1D_X_FLOAT32_IEEE 0 LP_VCU020_AA_VCU_CM_single_kph 6 -300.0 300.0 /end AXIS_PTS
/begin CHARACTERISTIC CalCrv_Kd2LastWheelTrq "" CURVE 0x0000 /* @ECU_Address@CalCrv_Kd2LastWheelTrq@ */ Lookup1D_FLOAT32_IEEE 0 LP_VCU020_AA_VCU_CM_single 0.0 1.0
 /begin AXIS_DESCR COM_AXIS NO_INPUT_QUANTITY LP_VCU020_AA_VCU_CM_single_Nm 6 -10000.0 10000.0 AXIS_PTS_REF CalCrvX_LastWheelTrqPoint2LPF /end AXIS_DESCR
/end CHARACTERISTIC
/begin AXIS_PTS CalCrvX_LastWheelTrqPoint2LPF "" 0x0000 /* @ECU_Address@CalCrvX_LastWheelTrqPoint2LPF@ */ NO_INPUT_QUANTITY Lookup1D_X_FLOAT32_IEEE 0 LP_VCU020_AA_VCU_CM_single_Nm 6 -10000.0 10000.0 /end AXIS_PTS
/begin CHARACTERISTIC CalCrv_StartUpCtlTrqReq "" CURVE 0x0000 /* @ECU_Address@CalCrv_StartUpCtlTrqReq@ */ Lookup1D_FLOAT32_IEEE 0 LP_VCU020_AA_VCU_CM_single_Nm -10000.0 10000.0
 /begin AXIS_DESCR COM_AXIS NO_INPUT_QUANTITY LP_VCU020_AA_VCU_CM_single_kph 7 -300.0 300.0 AXIS_PTS_REF CalCrvX_StartUpCtlWheelSpd /end AXIS_DESCR
/end CHARACTERISTIC
/begin AXIS_PTS CalCrvX_StartUpCtlWheelSpd "" 0x0000 /* @ECU_Address@CalCrvX_StartUpCtlWheelSpd@ */ NO_INPUT_QUANTITY Lookup1D_X_FLOAT32_IEEE 0 LP_VCU020_AA_VCU_CM_single_kph 7 -300.0 300.0 /end AXIS_PTS
/begin CHARACTERISTIC CalMap_MotTrqUpRateLimit2TrqCrossZero "" MAP 0x0000 /* @ECU_Address@CalMap_MotTrqUpRateLimit2TrqCrossZero@ */ Lookup2D_FLOAT32_IEEE 0 LP_VCU020_AA_VCU_CM_single_Nm_s 0.0 20000.0
 /begin AXIS_DESCR COM_AXIS NO_INPUT_QUANTITY LP_VCU020_AA_VCU_CM_single_Nm 21 -10000.0 10000.0 AXIS_PTS_REF CalMapX_MotTrqPoint2TrqN2P /end AXIS_DESCR
 /begin AXIS_DESCR COM_AXIS NO_INPUT_QUANTITY LP_VCU020_AA_VCU_CM_single_kph 21 -300.0 300.0 AXIS_PTS_REF CalMapY_VehSpdPoint2TrqN2P /end AXIS_DESCR
/end CHARACTERISTIC
/begin AXIS_PTS CalMapY_VehSpdPoint2TrqN2P "" 0x0000 /* @ECU_Address@CalMapY_VehSpdPoint2TrqN2P@ */ NO_INPUT_QUANTITY Lookup2D_X_FLOAT32_IEEE 0 LP_VCU020_AA_VCU_CM_single_kph 21 -300.0 300.0 /end AXIS_PTS
/begin AXIS_PTS CalMapX_MotTrqPoint2TrqN2P "" 0x0000 /* @ECU_Address@CalMapX_MotTrqPoint2TrqN2P@ */ NO_INPUT_QUANTITY Lookup2D_X_FLOAT32_IEEE 0 LP_VCU020_AA_VCU_CM_single_Nm 21 -10000.0 10000.0 /end AXIS_PTS
/begin CHARACTERISTIC CalMap_MotTrqDnRateLimit2TrqCrossZero "" MAP 0x0000 /* @ECU_Address@CalMap_MotTrqDnRateLimit2TrqCrossZero@ */ Lookup2D_FLOAT32_IEEE 0 LP_VCU020_AA_VCU_CM_single_Nm_s 0.0 20000.0
 /begin AXIS_DESCR COM_AXIS NO_INPUT_QUANTITY LP_VCU020_AA_VCU_CM_single_Nm 21 -10000.0 10000.0 AXIS_PTS_REF CalMapX_MotTrqPoint2TrqP2N /end AXIS_DESCR
 /begin AXIS_DESCR COM_AXIS NO_INPUT_QUANTITY LP_VCU020_AA_VCU_CM_single_kph 21 -300.0 300.0 AXIS_PTS_REF CalMapY_VehSpdPoint2TrqP2N /end AXIS_DESCR
/end CHARACTERISTIC
/begin AXIS_PTS CalMapY_VehSpdPoint2TrqP2N "" 0x0000 /* @ECU_Address@CalMapY_VehSpdPoint2TrqP2N@ */ NO_INPUT_QUANTITY Lookup2D_X_FLOAT32_IEEE 0 LP_VCU020_AA_VCU_CM_single_kph 21 -300.0 300.0 /end AXIS_PTS
/begin AXIS_PTS CalMapX_MotTrqPoint2TrqP2N "" 0x0000 /* @ECU_Address@CalMapX_MotTrqPoint2TrqP2N@ */ NO_INPUT_QUANTITY Lookup2D_X_FLOAT32_IEEE 0 LP_VCU020_AA_VCU_CM_single_Nm 21 -10000.0 10000.0 /end AXIS_PTS
/begin CHARACTERISTIC CalCrv_DrvTrqUpRateScaleFactorByPdlPct "" CURVE 0x0000 /* @ECU_Address@CalCrv_DrvTrqUpRateScaleFactorByPdlPct@ */ Lookup1D_FLOAT32_IEEE 0 LP_VCU020_AA_VCU_CM_single 0.0 1000.0
 /begin AXIS_DESCR COM_AXIS NO_INPUT_QUANTITY LP_VCU020_AA_VCU_CM_single_pct 20 -100.0 100.0 AXIS_PTS_REF CalCrvX_AccPdlPctPoint2TrqRateLimit /end AXIS_DESCR
/end CHARACTERISTIC
/begin AXIS_PTS CalCrvX_AccPdlPctPoint2TrqRateLimit "" 0x0000 /* @ECU_Address@CalCrvX_AccPdlPctPoint2TrqRateLimit@ */ NO_INPUT_QUANTITY Lookup1D_X_FLOAT32_IEEE 0 LP_VCU020_AA_VCU_CM_single_pct 20 -100.0 100.0 /end AXIS_PTS
/begin CHARACTERISTIC CalCrv_VehSpdLPFKd "" CURVE 0x0000 /* @ECU_Address@CalCrv_VehSpdLPFKd@ */ Lookup1D_FLOAT32_IEEE 0 LP_VCU020_AA_VCU_CM_single 0.0 1.0
 /begin AXIS_DESCR COM_AXIS NO_INPUT_QUANTITY LP_VCU020_AA_VCU_CM_single_kph 8 -300.0 300.0 AXIS_PTS_REF CalCrvX_VehSpd2SpdLPF /end AXIS_DESCR
/end CHARACTERISTIC
/begin AXIS_PTS CalCrvX_VehSpd2SpdLPF "" 0x0000 /* @ECU_Address@CalCrvX_VehSpd2SpdLPF@ */ NO_INPUT_QUANTITY Lookup1D_X_FLOAT32_IEEE 0 LP_VCU020_AA_VCU_CM_single_kph 8 -300.0 300.0 /end AXIS_PTS
/begin CHARACTERISTIC CalCrv_RecTrqScaleFactor "" CURVE 0x0000 /* @ECU_Address@CalCrv_RecTrqScaleFactor@ */ Lookup1D_FLOAT32_IEEE 0 LP_VCU020_AA_VCU_CM_single 0.0 1.0
 /begin AXIS_DESCR COM_AXIS NO_INPUT_QUANTITY LP_VCU020_AA_VCU_CM_single 11 0.0 1.0 AXIS_PTS_REF CalCrvX_LowSpdScale /end AXIS_DESCR
/end CHARACTERISTIC
/begin AXIS_PTS CalCrvX_LowSpdScale "" 0x0000 /* @ECU_Address@CalCrvX_LowSpdScale@ */ NO_INPUT_QUANTITY Lookup1D_X_FLOAT32_IEEE 0 LP_VCU020_AA_VCU_CM_single 11 0.0 1.0 /end AXIS_PTS
/begin CHARACTERISTIC CalCrv_KpCreepCtl "" CURVE 0x0000 /* @ECU_Address@CalCrv_KpCreepCtl@ */ Lookup1D_FLOAT32_IEEE 0 LP_VCU020_AA_VCU_CM_single 0.0 10000.0
 /begin AXIS_DESCR COM_AXIS NO_INPUT_QUANTITY LP_VCU020_AA_VCU_CM_single_kph 6 -300.0 300.0 AXIS_PTS_REF CalCrvX_DeltaSpd2CreepCtl /end AXIS_DESCR
/end CHARACTERISTIC
/begin AXIS_PTS CalCrvX_DeltaSpd2CreepCtl "" 0x0000 /* @ECU_Address@CalCrvX_DeltaSpd2CreepCtl@ */ NO_INPUT_QUANTITY Lookup1D_X_FLOAT32_IEEE 0 LP_VCU020_AA_VCU_CM_single_kph 6 -300.0 300.0 /end AXIS_PTS
/begin CHARACTERISTIC CalCrv_KiCreepCtl "" CURVE 0x0000 /* @ECU_Address@CalCrv_KiCreepCtl@ */ Lookup1D_FLOAT32_IEEE 0 LP_VCU020_AA_VCU_CM_single 0.0 10000.0
 /begin AXIS_DESCR COM_AXIS NO_INPUT_QUANTITY LP_VCU020_AA_VCU_CM_single_kph 6 -300.0 300.0 AXIS_PTS_REF CalCrvX_DeltaSpd2CreepCtl /end AXIS_DESCR
/end CHARACTERISTIC
/begin CHARACTERISTIC CalCrv_KdCreepCtl "" CURVE 0x0000 /* @ECU_Address@CalCrv_KdCreepCtl@ */ Lookup1D_FLOAT32_IEEE 0 LP_VCU020_AA_VCU_CM_single 0.0 10000.0
 /begin AXIS_DESCR COM_AXIS NO_INPUT_QUANTITY LP_VCU020_AA_VCU_CM_single_kph 6 -300.0 300.0 AXIS_PTS_REF CalCrvX_DeltaSpd2CreepCtl /end AXIS_DESCR
/end CHARACTERISTIC
/begin CHARACTERISTIC CalCrv_TrqUpRate2HACAVHActive "" CURVE 0x0000 /* @ECU_Address@CalCrv_TrqUpRate2HACAVHActive@ */ Lookup1D_FLOAT32_IEEE 0 LP_VCU020_AA_VCU_CM_single_Nm_s 0.0 20000.0
 /begin AXIS_DESCR COM_AXIS NO_INPUT_QUANTITY LP_VCU020_AA_VCU_CM_single_s 6 0.0 10.0 AXIS_PTS_REF CalCrvX_Time2HACTrqRate /end AXIS_DESCR
/end CHARACTERISTIC
/begin AXIS_PTS CalCrvX_Time2HACTrqRate "" 0x0000 /* @ECU_Address@CalCrvX_Time2HACTrqRate@ */ NO_INPUT_QUANTITY Lookup1D_X_FLOAT32_IEEE 0 LP_VCU020_AA_VCU_CM_single_s 6 0.0 10.0 /end AXIS_PTS
/begin CHARACTERISTIC CalCrv_TrqDnRate2HACAVHActive "" CURVE 0x0000 /* @ECU_Address@CalCrv_TrqDnRate2HACAVHActive@ */ Lookup1D_FLOAT32_IEEE 0 LP_VCU020_AA_VCU_CM_single_Nm_s 0.0 20000.0
 /begin AXIS_DESCR COM_AXIS NO_INPUT_QUANTITY LP_VCU020_AA_VCU_CM_single_s 6 0.0 10.0 AXIS_PTS_REF CalCrvX_Time2HACTrqRate /end AXIS_DESCR
/end CHARACTERISTIC
/begin CHARACTERISTIC CalCrv_TrqUpRate2HACEPBActive "" CURVE 0x0000 /* @ECU_Address@CalCrv_TrqUpRate2HACEPBActive@ */ Lookup1D_FLOAT32_IEEE 0 LP_VCU020_AA_VCU_CM_single_Nm_s 0.0 20000.0
 /begin AXIS_DESCR COM_AXIS NO_INPUT_QUANTITY LP_VCU020_AA_VCU_CM_single_s 6 0.0 10.0 AXIS_PTS_REF CalCrvX_Time2HACTrqRate /end AXIS_DESCR
/end CHARACTERISTIC
/begin CHARACTERISTIC CalCrv_TrqDnRate2HACEPBActive "" CURVE 0x0000 /* @ECU_Address@CalCrv_TrqDnRate2HACEPBActive@ */ Lookup1D_FLOAT32_IEEE 0 LP_VCU020_AA_VCU_CM_single_Nm_s 0.0 20000.0
 /begin AXIS_DESCR COM_AXIS NO_INPUT_QUANTITY LP_VCU020_AA_VCU_CM_single_s 6 0.0 10.0 AXIS_PTS_REF CalCrvX_Time2HACTrqRate /end AXIS_DESCR
/end CHARACTERISTIC
/begin CHARACTERISTIC CalCrv_KpHACWithSlowDown "" CURVE 0x0000 /* @ECU_Address@CalCrv_KpHACWithSlowDown@ */ Lookup1D_FLOAT32_IEEE 0 LP_VCU020_AA_VCU_CM_single 0.0 10000.0
 /begin AXIS_DESCR COM_AXIS NO_INPUT_QUANTITY LP_VCU020_AA_VCU_CM_single_kph 7 -300.0 300.0 AXIS_PTS_REF CalCrvX_VehSpd2HACWithSlowDown /end AXIS_DESCR
/end CHARACTERISTIC
/begin AXIS_PTS CalCrvX_VehSpd2HACWithSlowDown "" 0x0000 /* @ECU_Address@CalCrvX_VehSpd2HACWithSlowDown@ */ NO_INPUT_QUANTITY Lookup1D_X_FLOAT32_IEEE 0 LP_VCU020_AA_VCU_CM_single_kph 7 -300.0 300.0 /end AXIS_PTS
/begin CHARACTERISTIC CalCrv_KiHACWithSlowDown "" CURVE 0x0000 /* @ECU_Address@CalCrv_KiHACWithSlowDown@ */ Lookup1D_FLOAT32_IEEE 0 LP_VCU020_AA_VCU_CM_single 0.0 10000.0
 /begin AXIS_DESCR COM_AXIS NO_INPUT_QUANTITY LP_VCU020_AA_VCU_CM_single_kph 7 -300.0 300.0 AXIS_PTS_REF CalCrvX_VehSpd2HACWithSlowDown /end AXIS_DESCR
/end CHARACTERISTIC
/begin CHARACTERISTIC CalCrv_KdHACWithSlowDown "" CURVE 0x0000 /* @ECU_Address@CalCrv_KdHACWithSlowDown@ */ Lookup1D_FLOAT32_IEEE 0 LP_VCU020_AA_VCU_CM_single 0.0 10000.0
 /begin AXIS_DESCR COM_AXIS NO_INPUT_QUANTITY LP_VCU020_AA_VCU_CM_single_kph 7 -300.0 300.0 AXIS_PTS_REF CalCrvX_VehSpd2HACWithSlowDown /end AXIS_DESCR
/end CHARACTERISTIC
/begin CHARACTERISTIC CalCrv_KpHACWithBackSlide1 "" CURVE 0x0000 /* @ECU_Address@CalCrv_KpHACWithBackSlide1@ */ Lookup1D_FLOAT32_IEEE 0 LP_VCU020_AA_VCU_CM_single 0.0 10000.0
 /begin AXIS_DESCR COM_AXIS NO_INPUT_QUANTITY LP_VCU020_AA_VCU_CM_single_kph 7 -300.0 300.0 AXIS_PTS_REF CalCrvX_VehSpd2HACWithBackSlide1 /end AXIS_DESCR
/end CHARACTERISTIC
/begin AXIS_PTS CalCrvX_VehSpd2HACWithBackSlide1 "" 0x0000 /* @ECU_Address@CalCrvX_VehSpd2HACWithBackSlide1@ */ NO_INPUT_QUANTITY Lookup1D_X_FLOAT32_IEEE 0 LP_VCU020_AA_VCU_CM_single_kph 7 -300.0 300.0 /end AXIS_PTS
/begin CHARACTERISTIC CalCrv_KiHACWithBackSlide1 "" CURVE 0x0000 /* @ECU_Address@CalCrv_KiHACWithBackSlide1@ */ Lookup1D_FLOAT32_IEEE 0 LP_VCU020_AA_VCU_CM_single 0.0 10000.0
 /begin AXIS_DESCR COM_AXIS NO_INPUT_QUANTITY LP_VCU020_AA_VCU_CM_single_kph 7 -300.0 300.0 AXIS_PTS_REF CalCrvX_VehSpd2HACWithBackSlide1 /end AXIS_DESCR
/end CHARACTERISTIC
/begin CHARACTERISTIC CalCrv_KdHACWithBackSlide1 "" CURVE 0x0000 /* @ECU_Address@CalCrv_KdHACWithBackSlide1@ */ Lookup1D_FLOAT32_IEEE 0 LP_VCU020_AA_VCU_CM_single 0.0 10000.0
 /begin AXIS_DESCR COM_AXIS NO_INPUT_QUANTITY LP_VCU020_AA_VCU_CM_single_kph 7 -300.0 300.0 AXIS_PTS_REF CalCrvX_VehSpd2HACWithBackSlide1 /end AXIS_DESCR
/end CHARACTERISTIC
/begin CHARACTERISTIC CalCrv_KpHACWithBackSlide2 "" CURVE 0x0000 /* @ECU_Address@CalCrv_KpHACWithBackSlide2@ */ Lookup1D_FLOAT32_IEEE 0 LP_VCU020_AA_VCU_CM_single 0.0 10000.0
 /begin AXIS_DESCR COM_AXIS NO_INPUT_QUANTITY LP_VCU020_AA_VCU_CM_single_kph 7 -300.0 300.0 AXIS_PTS_REF CalCrvX_VehSpd2HACWithBackSlide2 /end AXIS_DESCR
/end CHARACTERISTIC
/begin AXIS_PTS CalCrvX_VehSpd2HACWithBackSlide2 "" 0x0000 /* @ECU_Address@CalCrvX_VehSpd2HACWithBackSlide2@ */ NO_INPUT_QUANTITY Lookup1D_X_FLOAT32_IEEE 0 LP_VCU020_AA_VCU_CM_single_kph 7 -300.0 300.0 /end AXIS_PTS
/begin CHARACTERISTIC CalCrv_KiHACWithBackSlide2 "" CURVE 0x0000 /* @ECU_Address@CalCrv_KiHACWithBackSlide2@ */ Lookup1D_FLOAT32_IEEE 0 LP_VCU020_AA_VCU_CM_single 0.0 10000.0
 /begin AXIS_DESCR COM_AXIS NO_INPUT_QUANTITY LP_VCU020_AA_VCU_CM_single_kph 7 -300.0 300.0 AXIS_PTS_REF CalCrvX_VehSpd2HACWithBackSlide2 /end AXIS_DESCR
/end CHARACTERISTIC
/begin CHARACTERISTIC CalCrv_KdHACWithBackSlide2 "" CURVE 0x0000 /* @ECU_Address@CalCrv_KdHACWithBackSlide2@ */ Lookup1D_FLOAT32_IEEE 0 LP_VCU020_AA_VCU_CM_single 0.0 10000.0
 /begin AXIS_DESCR COM_AXIS NO_INPUT_QUANTITY LP_VCU020_AA_VCU_CM_single_kph 7 -300.0 300.0 AXIS_PTS_REF CalCrvX_VehSpd2HACWithBackSlide2 /end AXIS_DESCR
/end CHARACTERISTIC
/begin CHARACTERISTIC CalCrv_TrqThreshold2HAC "" CURVE 0x0000 /* @ECU_Address@CalCrv_TrqThreshold2HAC@ */ Lookup1D_FLOAT32_IEEE 0 LP_VCU020_AA_VCU_CM_single_Nm -10000.0 10000.0
 /begin AXIS_DESCR COM_AXIS NO_INPUT_QUANTITY LP_VCU020_AA_VCU_CM_single_kph 17 -300.0 300.0 AXIS_PTS_REF CalCrvX_VehSpd2HACTrqSwt /end AXIS_DESCR
/end CHARACTERISTIC
/begin AXIS_PTS CalCrvX_VehSpd2HACTrqSwt "" 0x0000 /* @ECU_Address@CalCrvX_VehSpd2HACTrqSwt@ */ NO_INPUT_QUANTITY Lookup1D_X_FLOAT32_IEEE 0 LP_VCU020_AA_VCU_CM_single_kph 17 -300.0 300.0 /end AXIS_PTS
/begin CHARACTERISTIC CalCrv_KpHDC "" CURVE 0x0000 /* @ECU_Address@CalCrv_KpHDC@ */ Lookup1D_FLOAT32_IEEE 0 LP_VCU020_AA_VCU_CM_single 0.0 10000.0
 /begin AXIS_DESCR COM_AXIS NO_INPUT_QUANTITY LP_VCU020_AA_VCU_CM_single_kph 7 -300.0 300.0 AXIS_PTS_REF CalCrvX_DeltaVehSpd2HDC /end AXIS_DESCR
/end CHARACTERISTIC
/begin AXIS_PTS CalCrvX_DeltaVehSpd2HDC "" 0x0000 /* @ECU_Address@CalCrvX_DeltaVehSpd2HDC@ */ NO_INPUT_QUANTITY Lookup1D_X_FLOAT32_IEEE 0 LP_VCU020_AA_VCU_CM_single_kph 7 -300.0 300.0 /end AXIS_PTS
/begin CHARACTERISTIC CalCrv_KiHDC "" CURVE 0x0000 /* @ECU_Address@CalCrv_KiHDC@ */ Lookup1D_FLOAT32_IEEE 0 LP_VCU020_AA_VCU_CM_single 0.0 10000.0
 /begin AXIS_DESCR COM_AXIS NO_INPUT_QUANTITY LP_VCU020_AA_VCU_CM_single_kph 7 -300.0 300.0 AXIS_PTS_REF CalCrvX_DeltaVehSpd2HDC /end AXIS_DESCR
/end CHARACTERISTIC
/begin CHARACTERISTIC CalCrv_KdHDC "" CURVE 0x0000 /* @ECU_Address@CalCrv_KdHDC@ */ Lookup1D_FLOAT32_IEEE 0 LP_VCU020_AA_VCU_CM_single 0.0 10000.0
 /begin AXIS_DESCR COM_AXIS NO_INPUT_QUANTITY LP_VCU020_AA_VCU_CM_single_kph 7 -300.0 300.0 AXIS_PTS_REF CalCrvX_DeltaVehSpd2HDC /end AXIS_DESCR
/end CHARACTERISTIC
/begin CHARACTERISTIC CalCrv_DrvTrqUpRateLimitByLastTrq "" CURVE 0x0000 /* @ECU_Address@CalCrv_DrvTrqUpRateLimitByLastTrq@ */ Lookup1D_FLOAT32_IEEE 0 LP_VCU020_AA_VCU_CM_single_Nm_s 0.0 20000.0
 /begin AXIS_DESCR COM_AXIS NO_INPUT_QUANTITY LP_VCU020_AA_VCU_CM_single_Nm 8 0.0 10000.0 AXIS_PTS_REF CalCrvX_WheelTrqPoint2TrqRateLimit /end AXIS_DESCR
/end CHARACTERISTIC
/begin AXIS_PTS CalCrvX_WheelTrqPoint2TrqRateLimit "" 0x0000 /* @ECU_Address@CalCrvX_WheelTrqPoint2TrqRateLimit@ */ NO_INPUT_QUANTITY Lookup1D_X_FLOAT32_IEEE 0 LP_VCU020_AA_VCU_CM_single_Nm 8 0.0 10000.0 /end AXIS_PTS
/begin CHARACTERISTIC CalCrv_DrvTrqUpRateLimitByVehSpd "" CURVE 0x0000 /* @ECU_Address@CalCrv_DrvTrqUpRateLimitByVehSpd@ */ Lookup1D_FLOAT32_IEEE 0 LP_VCU020_AA_VCU_CM_single_Nm_s 0.0 20000.0
 /begin AXIS_DESCR COM_AXIS NO_INPUT_QUANTITY LP_VCU020_AA_VCU_CM_single_kph 8 -300.0 300.0 AXIS_PTS_REF CalCrvX_VehSpdPoint2TrqRateLimit /end AXIS_DESCR
/end CHARACTERISTIC
/begin AXIS_PTS CalCrvX_VehSpdPoint2TrqRateLimit "" 0x0000 /* @ECU_Address@CalCrvX_VehSpdPoint2TrqRateLimit@ */ NO_INPUT_QUANTITY Lookup1D_X_FLOAT32_IEEE 0 LP_VCU020_AA_VCU_CM_single_kph 8 -300.0 300.0 /end AXIS_PTS
/begin CHARACTERISTIC CalCrv_DrvTrqDnRateLimitByLastTrq "" CURVE 0x0000 /* @ECU_Address@CalCrv_DrvTrqDnRateLimitByLastTrq@ */ Lookup1D_FLOAT32_IEEE 0 LP_VCU020_AA_VCU_CM_single_Nm_s 0.0 20000.0
 /begin AXIS_DESCR COM_AXIS NO_INPUT_QUANTITY LP_VCU020_AA_VCU_CM_single_Nm 8 0.0 10000.0 AXIS_PTS_REF CalCrvX_WheelTrqPoint2TrqRateLimit /end AXIS_DESCR
/end CHARACTERISTIC
/begin CHARACTERISTIC CalCrv_DrvTrqDnRateLimitByVehSpd "" CURVE 0x0000 /* @ECU_Address@CalCrv_DrvTrqDnRateLimitByVehSpd@ */ Lookup1D_FLOAT32_IEEE 0 LP_VCU020_AA_VCU_CM_single_Nm_s 0.0 20000.0
 /begin AXIS_DESCR COM_AXIS NO_INPUT_QUANTITY LP_VCU020_AA_VCU_CM_single_kph 8 -300.0 300.0 AXIS_PTS_REF CalCrvX_VehSpdPoint2TrqRateLimit /end AXIS_DESCR
/end CHARACTERISTIC
/begin CHARACTERISTIC CalCrv_HACMode1TrqUpRate "" CURVE 0x0000 /* @ECU_Address@CalCrv_HACMode1TrqUpRate@ */ Lookup1D_FLOAT32_IEEE 0 LP_VCU020_AA_VCU_CM_single_Nm_s 0.0 20000.0
 /begin AXIS_DESCR COM_AXIS NO_INPUT_QUANTITY LP_VCU020_AA_VCU_CM_single_Nm 6 0.0 10000.0 AXIS_PTS_REF CalCrvX_WheelTrq2HACRateLimit /end AXIS_DESCR
/end CHARACTERISTIC
/begin AXIS_PTS CalCrvX_WheelTrq2HACRateLimit "" 0x0000 /* @ECU_Address@CalCrvX_WheelTrq2HACRateLimit@ */ NO_INPUT_QUANTITY Lookup1D_X_FLOAT32_IEEE 0 LP_VCU020_AA_VCU_CM_single_Nm 6 0.0 10000.0 /end AXIS_PTS
/begin CHARACTERISTIC CalCrv_HACMode1TrqDnRate "" CURVE 0x0000 /* @ECU_Address@CalCrv_HACMode1TrqDnRate@ */ Lookup1D_FLOAT32_IEEE 0 LP_VCU020_AA_VCU_CM_single_Nm_s 0.0 20000.0
 /begin AXIS_DESCR COM_AXIS NO_INPUT_QUANTITY LP_VCU020_AA_VCU_CM_single_Nm 6 0.0 10000.0 AXIS_PTS_REF CalCrvX_WheelTrq2HACRateLimit /end AXIS_DESCR
/end CHARACTERISTIC
/begin CHARACTERISTIC CalCrv_HACMode2TrqDnRate "" CURVE 0x0000 /* @ECU_Address@CalCrv_HACMode2TrqDnRate@ */ Lookup1D_FLOAT32_IEEE 0 LP_VCU020_AA_VCU_CM_single_Nm_s 0.0 20000.0
 /begin AXIS_DESCR COM_AXIS NO_INPUT_QUANTITY LP_VCU020_AA_VCU_CM_single_Nm 6 0.0 10000.0 AXIS_PTS_REF CalCrvX_WheelTrq2HACRateLimit /end AXIS_DESCR
/end CHARACTERISTIC
/begin CHARACTERISTIC CalCrv_HACMode2TrqUpRate "" CURVE 0x0000 /* @ECU_Address@CalCrv_HACMode2TrqUpRate@ */ Lookup1D_FLOAT32_IEEE 0 LP_VCU020_AA_VCU_CM_single_Nm_s 0.0 20000.0
 /begin AXIS_DESCR COM_AXIS NO_INPUT_QUANTITY LP_VCU020_AA_VCU_CM_single_Nm 6 0.0 10000.0 AXIS_PTS_REF CalCrvX_WheelTrq2HACRateLimit /end AXIS_DESCR
/end CHARACTERISTIC
/begin CHARACTERISTIC CalCrv_RecTrqUpRateLimitByVehSpd "" CURVE 0x0000 /* @ECU_Address@CalCrv_RecTrqUpRateLimitByVehSpd@ */ Lookup1D_FLOAT32_IEEE 0 LP_VCU020_AA_VCU_CM_single_Nm_s 0.0 20000.0
 /begin AXIS_DESCR COM_AXIS NO_INPUT_QUANTITY LP_VCU020_AA_VCU_CM_single_kph 8 -300.0 300.0 AXIS_PTS_REF CalCrvX_VehSpdPoint2TrqRateLimit /end AXIS_DESCR
/end CHARACTERISTIC
/begin CHARACTERISTIC CalCrv_RecTrqUpRateLimitByLastTrq "" CURVE 0x0000 /* @ECU_Address@CalCrv_RecTrqUpRateLimitByLastTrq@ */ Lookup1D_FLOAT32_IEEE 0 LP_VCU020_AA_VCU_CM_single_Nm_s 0.0 20000.0
 /begin AXIS_DESCR COM_AXIS NO_INPUT_QUANTITY LP_VCU020_AA_VCU_CM_single_Nm 8 0.0 10000.0 AXIS_PTS_REF CalCrvX_WheelTrqPoint2TrqRateLimit /end AXIS_DESCR
/end CHARACTERISTIC
/begin CHARACTERISTIC CalCrv_RecTrqDnRateLimitByVehSpd "" CURVE 0x0000 /* @ECU_Address@CalCrv_RecTrqDnRateLimitByVehSpd@ */ Lookup1D_FLOAT32_IEEE 0 LP_VCU020_AA_VCU_CM_single_Nm_s 0.0 20000.0
 /begin AXIS_DESCR COM_AXIS NO_INPUT_QUANTITY LP_VCU020_AA_VCU_CM_single_kph 8 -300.0 300.0 AXIS_PTS_REF CalCrvX_VehSpdPoint2TrqRateLimit /end AXIS_DESCR
/end CHARACTERISTIC
/begin CHARACTERISTIC CalCrv_RecTrqDnRateLimitByLastTrq "" CURVE 0x0000 /* @ECU_Address@CalCrv_RecTrqDnRateLimitByLastTrq@ */ Lookup1D_FLOAT32_IEEE 0 LP_VCU020_AA_VCU_CM_single_Nm_s 0.0 20000.0
 /begin AXIS_DESCR COM_AXIS NO_INPUT_QUANTITY LP_VCU020_AA_VCU_CM_single_Nm 8 0.0 10000.0 AXIS_PTS_REF CalCrvX_WheelTrqPoint2TrqRateLimit /end AXIS_DESCR
/end CHARACTERISTIC
/begin CHARACTERISTIC CalMap_TrqDirectSwtDnRateLimit "" MAP 0x0000 /* @ECU_Address@CalMap_TrqDirectSwtDnRateLimit@ */ Lookup2D_FLOAT32_IEEE 0 LP_VCU020_AA_VCU_CM_single_Nm_s 0.0 20000.0
 /begin AXIS_DESCR COM_AXIS NO_INPUT_QUANTITY LP_VCU020_AA_VCU_CM_single_Nm 13 -10000.0 10000.0 AXIS_PTS_REF CalMapX_MotTrqPoint2TrqDirectSwt /end AXIS_DESCR
 /begin AXIS_DESCR COM_AXIS NO_INPUT_QUANTITY LP_VCU020_AA_VCU_CM_single_kph 15 -300.0 300.0 AXIS_PTS_REF CalMapY_VehSpdPoint2TrqDirectSwt /end AXIS_DESCR
/end CHARACTERISTIC
/begin AXIS_PTS CalMapY_VehSpdPoint2TrqDirectSwt "" 0x0000 /* @ECU_Address@CalMapY_VehSpdPoint2TrqDirectSwt@ */ NO_INPUT_QUANTITY Lookup2D_X_FLOAT32_IEEE 0 LP_VCU020_AA_VCU_CM_single_kph 15 -300.0 300.0 /end AXIS_PTS
/begin AXIS_PTS CalMapX_MotTrqPoint2TrqDirectSwt "" 0x0000 /* @ECU_Address@CalMapX_MotTrqPoint2TrqDirectSwt@ */ NO_INPUT_QUANTITY Lookup2D_X_FLOAT32_IEEE 0 LP_VCU020_AA_VCU_CM_single_Nm 13 -10000.0 10000.0 /end AXIS_PTS
/begin CHARACTERISTIC CalMap_TrqDirectSwtUpRateLimit "" MAP 0x0000 /* @ECU_Address@CalMap_TrqDirectSwtUpRateLimit@ */ Lookup2D_FLOAT32_IEEE 0 LP_VCU020_AA_VCU_CM_single_Nm_s 0.0 20000.0
 /begin AXIS_DESCR COM_AXIS NO_INPUT_QUANTITY LP_VCU020_AA_VCU_CM_single_Nm 13 -10000.0 10000.0 AXIS_PTS_REF CalMapX_MotTrqPoint2TrqDirectSwt /end AXIS_DESCR
 /begin AXIS_DESCR COM_AXIS NO_INPUT_QUANTITY LP_VCU020_AA_VCU_CM_single_kph 15 -300.0 300.0 AXIS_PTS_REF CalMapY_VehSpdPoint2TrqDirectSwt /end AXIS_DESCR
/end CHARACTERISTIC
/begin CHARACTERISTIC CalCrv_KdSpdLimit1 "" CURVE 0x0000 /* @ECU_Address@CalCrv_KdSpdLimit1@ */ Lookup1D_FLOAT32_IEEE 0 LP_VCU020_AA_VCU_CM_single 0.0 10000.0
 /begin AXIS_DESCR COM_AXIS NO_INPUT_QUANTITY LP_VCU020_AA_VCU_CM_single_kph 11 -300.0 300.0 AXIS_PTS_REF CalCrvX_DeltaSpd2SpdLimit /end AXIS_DESCR
/end CHARACTERISTIC
/begin AXIS_PTS CalCrvX_DeltaSpd2SpdLimit "" 0x0000 /* @ECU_Address@CalCrvX_DeltaSpd2SpdLimit@ */ NO_INPUT_QUANTITY Lookup1D_X_FLOAT32_IEEE 0 LP_VCU020_AA_VCU_CM_single_kph 11 -300.0 300.0 /end AXIS_PTS
/begin CHARACTERISTIC CalCrv_KiSpdLimit1 "" CURVE 0x0000 /* @ECU_Address@CalCrv_KiSpdLimit1@ */ Lookup1D_FLOAT32_IEEE 0 LP_VCU020_AA_VCU_CM_single 0.0 10000.0
 /begin AXIS_DESCR COM_AXIS NO_INPUT_QUANTITY LP_VCU020_AA_VCU_CM_single_kph 11 -300.0 300.0 AXIS_PTS_REF CalCrvX_DeltaSpd2SpdLimit /end AXIS_DESCR
/end CHARACTERISTIC
/begin CHARACTERISTIC CalCrv_KpSpdLimit1 "" CURVE 0x0000 /* @ECU_Address@CalCrv_KpSpdLimit1@ */ Lookup1D_FLOAT32_IEEE 0 LP_VCU020_AA_VCU_CM_single 0.0 10000.0
 /begin AXIS_DESCR COM_AXIS NO_INPUT_QUANTITY LP_VCU020_AA_VCU_CM_single_kph 11 -300.0 300.0 AXIS_PTS_REF CalCrvX_DeltaSpd2SpdLimit /end AXIS_DESCR
/end CHARACTERISTIC
/begin CHARACTERISTIC CalCrv_KdSpdLimit2 "" CURVE 0x0000 /* @ECU_Address@CalCrv_KdSpdLimit2@ */ Lookup1D_FLOAT32_IEEE 0 LP_VCU020_AA_VCU_CM_single 0.0 10000.0
 /begin AXIS_DESCR COM_AXIS NO_INPUT_QUANTITY LP_VCU020_AA_VCU_CM_single_kph 11 -300.0 300.0 AXIS_PTS_REF CalCrvX_DeltaSpd2SpdLimit /end AXIS_DESCR
/end CHARACTERISTIC
/begin CHARACTERISTIC CalCrv_KiSpdLimit2 "" CURVE 0x0000 /* @ECU_Address@CalCrv_KiSpdLimit2@ */ Lookup1D_FLOAT32_IEEE 0 LP_VCU020_AA_VCU_CM_single 0.0 10000.0
 /begin AXIS_DESCR COM_AXIS NO_INPUT_QUANTITY LP_VCU020_AA_VCU_CM_single_kph 11 -300.0 300.0 AXIS_PTS_REF CalCrvX_DeltaSpd2SpdLimit /end AXIS_DESCR
/end CHARACTERISTIC
/begin CHARACTERISTIC CalCrv_KpSpdLimit2 "" CURVE 0x0000 /* @ECU_Address@CalCrv_KpSpdLimit2@ */ Lookup1D_FLOAT32_IEEE 0 LP_VCU020_AA_VCU_CM_single 0.0 10000.0
 /begin AXIS_DESCR COM_AXIS NO_INPUT_QUANTITY LP_VCU020_AA_VCU_CM_single_kph 11 -300.0 300.0 AXIS_PTS_REF CalCrvX_DeltaSpd2SpdLimit /end AXIS_DESCR
/end CHARACTERISTIC
/begin CHARACTERISTIC CalCrv_KdSpdLimit3 "" CURVE 0x0000 /* @ECU_Address@CalCrv_KdSpdLimit3@ */ Lookup1D_FLOAT32_IEEE 0 LP_VCU020_AA_VCU_CM_single 0.0 10000.0
 /begin AXIS_DESCR COM_AXIS NO_INPUT_QUANTITY LP_VCU020_AA_VCU_CM_single_kph 11 -300.0 300.0 AXIS_PTS_REF CalCrvX_DeltaSpd2SpdLimit /end AXIS_DESCR
/end CHARACTERISTIC
/begin CHARACTERISTIC CalCrv_KiSpdLimit3 "" CURVE 0x0000 /* @ECU_Address@CalCrv_KiSpdLimit3@ */ Lookup1D_FLOAT32_IEEE 0 LP_VCU020_AA_VCU_CM_single 0.0 10000.0
 /begin AXIS_DESCR COM_AXIS NO_INPUT_QUANTITY LP_VCU020_AA_VCU_CM_single_kph 11 -300.0 300.0 AXIS_PTS_REF CalCrvX_DeltaSpd2SpdLimit /end AXIS_DESCR
/end CHARACTERISTIC
/begin CHARACTERISTIC CalCrv_KpSpdLimit3 "" CURVE 0x0000 /* @ECU_Address@CalCrv_KpSpdLimit3@ */ Lookup1D_FLOAT32_IEEE 0 LP_VCU020_AA_VCU_CM_single 0.0 10000.0
 /begin AXIS_DESCR COM_AXIS NO_INPUT_QUANTITY LP_VCU020_AA_VCU_CM_single_kph 11 -300.0 300.0 AXIS_PTS_REF CalCrvX_DeltaSpd2SpdLimit /end AXIS_DESCR
/end CHARACTERISTIC
/begin CHARACTERISTIC CalCrv_KdSpdLimit4 "" CURVE 0x0000 /* @ECU_Address@CalCrv_KdSpdLimit4@ */ Lookup1D_FLOAT32_IEEE 0 LP_VCU020_AA_VCU_CM_single 0.0 10000.0
 /begin AXIS_DESCR COM_AXIS NO_INPUT_QUANTITY LP_VCU020_AA_VCU_CM_single_kph 11 -300.0 300.0 AXIS_PTS_REF CalCrvX_DeltaSpd2SpdLimit /end AXIS_DESCR
/end CHARACTERISTIC
/begin CHARACTERISTIC CalCrv_KiSpdLimit4 "" CURVE 0x0000 /* @ECU_Address@CalCrv_KiSpdLimit4@ */ Lookup1D_FLOAT32_IEEE 0 LP_VCU020_AA_VCU_CM_single 0.0 10000.0
 /begin AXIS_DESCR COM_AXIS NO_INPUT_QUANTITY LP_VCU020_AA_VCU_CM_single_kph 11 -300.0 300.0 AXIS_PTS_REF CalCrvX_DeltaSpd2SpdLimit /end AXIS_DESCR
/end CHARACTERISTIC
/begin CHARACTERISTIC CalCrv_KpSpdLimit4 "" CURVE 0x0000 /* @ECU_Address@CalCrv_KpSpdLimit4@ */ Lookup1D_FLOAT32_IEEE 0 LP_VCU020_AA_VCU_CM_single 0.0 10000.0
 /begin AXIS_DESCR COM_AXIS NO_INPUT_QUANTITY LP_VCU020_AA_VCU_CM_single_kph 11 -300.0 300.0 AXIS_PTS_REF CalCrvX_DeltaSpd2SpdLimit /end AXIS_DESCR
/end CHARACTERISTIC
/begin CHARACTERISTIC CalCrv_TrqQuickUpRate2GearN "" CURVE 0x0000 /* @ECU_Address@CalCrv_TrqQuickUpRate2GearN@ */ Lookup1D_FLOAT32_IEEE 0 LP_VCU020_AA_VCU_CM_single_Nm_s 0.0 20000.0
 /begin AXIS_DESCR COM_AXIS NO_INPUT_QUANTITY LP_VCU020_AA_VCU_CM_single_s 6 0.0 10.0 AXIS_PTS_REF CalCrvX_Time2GearNTrq /end AXIS_DESCR
/end CHARACTERISTIC
/begin AXIS_PTS CalCrvX_Time2GearNTrq "" 0x0000 /* @ECU_Address@CalCrvX_Time2GearNTrq@ */ NO_INPUT_QUANTITY Lookup1D_X_FLOAT32_IEEE 0 LP_VCU020_AA_VCU_CM_single_s 6 0.0 10.0 /end AXIS_PTS
/begin CHARACTERISTIC CalCrv_TrqQuickDnRate2GearN "" CURVE 0x0000 /* @ECU_Address@CalCrv_TrqQuickDnRate2GearN@ */ Lookup1D_FLOAT32_IEEE 0 LP_VCU020_AA_VCU_CM_single_Nm_s 0.0 20000.0
 /begin AXIS_DESCR COM_AXIS NO_INPUT_QUANTITY LP_VCU020_AA_VCU_CM_single_s 6 0.0 10.0 AXIS_PTS_REF CalCrvX_Time2GearNTrq /end AXIS_DESCR
/end CHARACTERISTIC
/begin CHARACTERISTIC CalCrv_TrqSlowUpRate2GearN "" CURVE 0x0000 /* @ECU_Address@CalCrv_TrqSlowUpRate2GearN@ */ Lookup1D_FLOAT32_IEEE 0 LP_VCU020_AA_VCU_CM_single_Nm_s 0.0 20000.0
 /begin AXIS_DESCR COM_AXIS NO_INPUT_QUANTITY LP_VCU020_AA_VCU_CM_single_s 6 0.0 10.0 AXIS_PTS_REF CalCrvX_Time2GearNTrq /end AXIS_DESCR
/end CHARACTERISTIC
/begin CHARACTERISTIC CalCrv_TrqSlowDnRate2GearN "" CURVE 0x0000 /* @ECU_Address@CalCrv_TrqSlowDnRate2GearN@ */ Lookup1D_FLOAT32_IEEE 0 LP_VCU020_AA_VCU_CM_single_Nm_s 0.0 20000.0
 /begin AXIS_DESCR COM_AXIS NO_INPUT_QUANTITY LP_VCU020_AA_VCU_CM_single_s 6 0.0 10.0 AXIS_PTS_REF CalCrvX_Time2GearNTrq /end AXIS_DESCR
/end CHARACTERISTIC
/begin CHARACTERISTIC CalCrv_TrqUpRateLastTrqGearN "" CURVE 0x0000 /* @ECU_Address@CalCrv_TrqUpRateLastTrqGearN@ */ Lookup1D_FLOAT32_IEEE 0 LP_VCU020_AA_VCU_CM_single_Nm_s 0.0 20000.0
 /begin AXIS_DESCR COM_AXIS NO_INPUT_QUANTITY LP_VCU020_AA_VCU_CM_single_Nm 8 0.0 10000.0 AXIS_PTS_REF CalCrvX_WheelTrqPoint2GearNRate /end AXIS_DESCR
/end CHARACTERISTIC
/begin AXIS_PTS CalCrvX_WheelTrqPoint2GearNRate "" 0x0000 /* @ECU_Address@CalCrvX_WheelTrqPoint2GearNRate@ */ NO_INPUT_QUANTITY Lookup1D_X_FLOAT32_IEEE 0 LP_VCU020_AA_VCU_CM_single_Nm 8 0.0 10000.0 /end AXIS_PTS
/begin CHARACTERISTIC CalCrv_TrqDnRateLastTrqGearN "" CURVE 0x0000 /* @ECU_Address@CalCrv_TrqDnRateLastTrqGearN@ */ Lookup1D_FLOAT32_IEEE 0 LP_VCU020_AA_VCU_CM_single_Nm_s 0.0 20000.0
 /begin AXIS_DESCR COM_AXIS NO_INPUT_QUANTITY LP_VCU020_AA_VCU_CM_single_Nm 8 0.0 10000.0 AXIS_PTS_REF CalCrvX_WheelTrqPoint2GearNRate /end AXIS_DESCR
/end CHARACTERISTIC
/begin CHARACTERISTIC CalCrv_MotRpmScaleFactor "" CURVE 0x0000 /* @ECU_Address@CalCrv_MotRpmScaleFactor@ */ Lookup1D_FLOAT32_IEEE 0 LP_VCU020_AA_VCU_CM_single 0.0 1.0
 /begin AXIS_DESCR COM_AXIS NO_INPUT_QUANTITY LP_VCU020_AA_VCU_CM_single_rpm 11 -20000.0 20000.0 AXIS_PTS_REF CalCrvX_MotRpm2VehSpdCal /end AXIS_DESCR
/end CHARACTERISTIC
/begin AXIS_PTS CalCrvX_MotRpm2VehSpdCal "" 0x0000 /* @ECU_Address@CalCrvX_MotRpm2VehSpdCal@ */ NO_INPUT_QUANTITY Lookup1D_X_FLOAT32_IEEE 0 LP_VCU020_AA_VCU_CM_single_rpm 11 -20000.0 20000.0 /end AXIS_PTS
/begin CHARACTERISTIC CalMap_Evb_VacuumOff "" VAL_BLK 0x0000 /* @ECU_Address@CalMap_Evb_VacuumOff@ */ Scalar_FLOAT32_IEEE 0 LP_VCU020_AA_VCU_CM_single 0.0 1.0 /* Array Size */ NUMBER 9 /end CHARACTERISTIC
/begin CHARACTERISTIC CalMap_Evb_VacuumOn "" VAL_BLK 0x0000 /* @ECU_Address@CalMap_Evb_VacuumOn@ */ Scalar_FLOAT32_IEEE 0 LP_VCU020_AA_VCU_CM_single 0.0 1.0 /* Array Size */ NUMBER 9 /end CHARACTERISTIC
/begin CHARACTERISTIC Cal_ACCAllowCancelTm "" VALUE 0x0000 /* @ECU_Address@Cal_ACCAllowCancelTm@ */ Scalar_FLOAT32_IEEE 0 LP_VCU020_AA_VCU_CM_single_s 0.0 10.0 /end CHARACTERISTIC
/begin CHARACTERISTIC Cal_ACCAllowConfirmTm "" VALUE 0x0000 /* @ECU_Address@Cal_ACCAllowConfirmTm@ */ Scalar_FLOAT32_IEEE 0 LP_VCU020_AA_VCU_CM_single_s 0.0 10.0 /end CHARACTERISTIC
/begin CHARACTERISTIC Cal_APSActiveMaxSpd "" VALUE 0x0000 /* @ECU_Address@Cal_APSActiveMaxSpd@ */ Scalar_FLOAT32_IEEE 0 LP_VCU020_AA_VCU_CM_single_kph -300.0 300.0 /end CHARACTERISTIC
/begin CHARACTERISTIC Cal_APSActiveMaxTm "" VALUE 0x0000 /* @ECU_Address@Cal_APSActiveMaxTm@ */ Scalar_FLOAT32_IEEE 0 LP_VCU020_AA_VCU_CM_single_s 0.0 10000.0 /end CHARACTERISTIC
/begin CHARACTERISTIC Cal_APSAllowCancelTm "" VALUE 0x0000 /* @ECU_Address@Cal_APSAllowCancelTm@ */ Scalar_FLOAT32_IEEE 0 LP_VCU020_AA_VCU_CM_single_s 0.0 10.0 /end CHARACTERISTIC
/begin CHARACTERISTIC Cal_APSAllowConfirmTm "" VALUE 0x0000 /* @ECU_Address@Cal_APSAllowConfirmTm@ */ Scalar_FLOAT32_IEEE 0 LP_VCU020_AA_VCU_CM_single_s 0.0 10.0 /end CHARACTERISTIC
/begin CHARACTERISTIC Cal_APSEPBCtlMaxWaitTm "" VALUE 0x0000 /* @ECU_Address@Cal_APSEPBCtlMaxWaitTm@ */ Scalar_FLOAT32_IEEE 0 LP_VCU020_AA_VCU_CM_single_s 0.0 1000.0 /end CHARACTERISTIC
/begin CHARACTERISTIC Cal_APSEnableMaxSpd "" VALUE 0x0000 /* @ECU_Address@Cal_APSEnableMaxSpd@ */ Scalar_FLOAT32_IEEE 0 LP_VCU020_AA_VCU_CM_single_kph -300.0 300.0 /end CHARACTERISTIC
/begin CHARACTERISTIC Cal_APSPdlActiveDeltaTrq "" VALUE 0x0000 /* @ECU_Address@Cal_APSPdlActiveDeltaTrq@ */ Scalar_FLOAT32_IEEE 0 LP_VCU020_AA_VCU_CM_single_Nm -10000.0 10000.0 /end CHARACTERISTIC
/begin CHARACTERISTIC Cal_AcPtcHeatPwr "" VALUE 0x0000 /* @ECU_Address@Cal_AcPtcHeatPwr@ */ Scalar_FLOAT32_IEEE 0 LP_VCU020_AA_VCU_CM_single_kw 0.0 300.0 /end CHARACTERISTIC
/begin CHARACTERISTIC Cal_AccPdlActiveThreshold "" VALUE 0x0000 /* @ECU_Address@Cal_AccPdlActiveThreshold@ */ Scalar_FLOAT32_IEEE 0 LP_VCU020_AA_VCU_CM_single_pct -100.0 100.0 /end CHARACTERISTIC
/begin CHARACTERISTIC Cal_AccPdlActiveTrqOffSet2ACC "" VALUE 0x0000 /* @ECU_Address@Cal_AccPdlActiveTrqOffSet2ACC@ */ Scalar_FLOAT32_IEEE 0 LP_VCU020_AA_VCU_CM_single_Nm -10000.0 10000.0 /end CHARACTERISTIC
/begin CHARACTERISTIC Cal_AccPdlHDCOffThreshold "" VALUE 0x0000 /* @ECU_Address@Cal_AccPdlHDCOffThreshold@ */ Scalar_FLOAT32_IEEE 0 LP_VCU020_AA_VCU_CM_single_pct -100.0 100.0 /end CHARACTERISTIC
/begin CHARACTERISTIC Cal_BattPtcPwr "" VALUE 0x0000 /* @ECU_Address@Cal_BattPtcPwr@ */ Scalar_FLOAT32_IEEE 0 LP_VCU020_AA_VCU_CM_single_kw 0.0 300.0 /end CHARACTERISTIC
/begin CHARACTERISTIC Cal_BattPwrLPFKd "" VALUE 0x0000 /* @ECU_Address@Cal_BattPwrLPFKd@ */ Scalar_FLOAT32_IEEE 0 LP_VCU020_AA_VCU_CM_single 0.0 1.0 /end CHARACTERISTIC
/begin CHARACTERISTIC Cal_BrkLightMinCtlTm "" VALUE 0x0000 /* @ECU_Address@Cal_BrkLightMinCtlTm@ */ Scalar_FLOAT32_IEEE 0 LP_VCU020_AA_VCU_CM_single_s 0.0 100.0 /end CHARACTERISTIC
/begin CHARACTERISTIC Cal_BrkOffDelay "" VALUE 0x0000 /* @ECU_Address@Cal_BrkOffDelay@ */ Scalar_FLOAT32_IEEE 0 LP_VCU020_AA_VCU_CM_single_s 0.0 10.0 /end CHARACTERISTIC
/begin CHARACTERISTIC Cal_BrkOnDPIDMinSpd "" VALUE 0x0000 /* @ECU_Address@Cal_BrkOnDPIDMinSpd@ */ Scalar_FLOAT32_IEEE 0 LP_VCU020_AA_VCU_CM_single_kph -300.0 300.0 /end CHARACTERISTIC
/begin CHARACTERISTIC Cal_BrkOnDelay "" VALUE 0x0000 /* @ECU_Address@Cal_BrkOnDelay@ */ Scalar_FLOAT32_IEEE 0 LP_VCU020_AA_VCU_CM_single_s 0.0 10.0 /end CHARACTERISTIC
/begin CHARACTERISTIC Cal_BrkOnPIDMinSpd "" VALUE 0x0000 /* @ECU_Address@Cal_BrkOnPIDMinSpd@ */ Scalar_FLOAT32_IEEE 0 LP_VCU020_AA_VCU_CM_single_kph -300.0 300.0 /end CHARACTERISTIC
/begin CHARACTERISTIC Cal_CCMMaxPwr "" VALUE 0x0000 /* @ECU_Address@Cal_CCMMaxPwr@ */ Scalar_FLOAT32_IEEE 0 LP_VCU020_AA_VCU_CM_single_kw 0.0 300.0 /end CHARACTERISTIC
/begin CHARACTERISTIC Cal_CCSActiveMinSpd "" VALUE 0x0000 /* @ECU_Address@Cal_CCSActiveMinSpd@ */ Scalar_FLOAT32_IEEE 0 LP_VCU020_AA_VCU_CM_single_kph -300.0 300.0 /end CHARACTERISTIC
/begin CHARACTERISTIC Cal_CCSAllowCancelTm "" VALUE 0x0000 /* @ECU_Address@Cal_CCSAllowCancelTm@ */ Scalar_FLOAT32_IEEE 0 LP_VCU020_AA_VCU_CM_single_s 0.0 10.0 /end CHARACTERISTIC
/begin CHARACTERISTIC Cal_CCSAllowConfirmTm "" VALUE 0x0000 /* @ECU_Address@Cal_CCSAllowConfirmTm@ */ Scalar_FLOAT32_IEEE 0 LP_VCU020_AA_VCU_CM_single_s 0.0 10.0 /end CHARACTERISTIC
/begin CHARACTERISTIC Cal_CCSCancelMinSpd "" VALUE 0x0000 /* @ECU_Address@Cal_CCSCancelMinSpd@ */ Scalar_FLOAT32_IEEE 0 LP_VCU020_AA_VCU_CM_single_kph -300.0 300.0 /end CHARACTERISTIC
/begin CHARACTERISTIC Cal_CCSCtlKd2TarAccn "" VALUE 0x0000 /* @ECU_Address@Cal_CCSCtlKd2TarAccn@ */ Scalar_FLOAT32_IEEE 0 LP_VCU020_AA_VCU_CM_single 0.0 10000.0 /end CHARACTERISTIC
/begin CHARACTERISTIC Cal_CCSCtlKi2TarAccn "" VALUE 0x0000 /* @ECU_Address@Cal_CCSCtlKi2TarAccn@ */ Scalar_FLOAT32_IEEE 0 LP_VCU020_AA_VCU_CM_single 0.0 10000.0 /end CHARACTERISTIC
/begin CHARACTERISTIC Cal_CCSCtlKp2TarAccn "" VALUE 0x0000 /* @ECU_Address@Cal_CCSCtlKp2TarAccn@ */ Scalar_FLOAT32_IEEE 0 LP_VCU020_AA_VCU_CM_single 0.0 10000.0 /end CHARACTERISTIC
/begin CHARACTERISTIC Cal_CCSCtlMaxWheelTrqLimit "" VALUE 0x0000 /* @ECU_Address@Cal_CCSCtlMaxWheelTrqLimit@ */ Scalar_FLOAT32_IEEE 0 LP_VCU020_AA_VCU_CM_single_Nm -10000.0 10000.0 /end CHARACTERISTIC
/begin CHARACTERISTIC Cal_CCSCtlMinWheelTrqLimit "" VALUE 0x0000 /* @ECU_Address@Cal_CCSCtlMinWheelTrqLimit@ */ Scalar_FLOAT32_IEEE 0 LP_VCU020_AA_VCU_CM_single_Nm -10000.0 10000.0 /end CHARACTERISTIC
/begin CHARACTERISTIC Cal_CCSCtlmodeSwtDeltaSpd "" VALUE 0x0000 /* @ECU_Address@Cal_CCSCtlmodeSwtDeltaSpd@ */ Scalar_FLOAT32_IEEE 0 LP_VCU020_AA_VCU_CM_single_kph -300.0 300.0 /end CHARACTERISTIC
/begin CHARACTERISTIC Cal_CCSTarSpdOffSet "" VALUE 0x0000 /* @ECU_Address@Cal_CCSTarSpdOffSet@ */ Scalar_FLOAT32_IEEE 0 LP_VCU020_AA_VCU_CM_single_kph -300.0 300.0 /end CHARACTERISTIC
/begin CHARACTERISTIC Cal_ClearABSActiveTrq "" VALUE 0x0000 /* @ECU_Address@Cal_ClearABSActiveTrq@ */ Scalar_FLOAT32_IEEE 0 LP_VCU020_AA_VCU_CM_single_Nm -100.0 100.0 /end CHARACTERISTIC
/begin CHARACTERISTIC Cal_CreepActiveDelay "" VALUE 0x0000 /* @ECU_Address@Cal_CreepActiveDelay@ */ Scalar_FLOAT32_IEEE 0 LP_VCU020_AA_VCU_CM_single_s 0.0 10.0 /end CHARACTERISTIC
/begin CHARACTERISTIC Cal_CreepActiveMinAccPdl2GearD "" VALUE 0x0000 /* @ECU_Address@Cal_CreepActiveMinAccPdl2GearD@ */ Scalar_FLOAT32_IEEE 0 LP_VCU020_AA_VCU_CM_single_pct 0.0 100.0 /end CHARACTERISTIC
/begin CHARACTERISTIC Cal_CreepActiveMinSpd2GearD "" VALUE 0x0000 /* @ECU_Address@Cal_CreepActiveMinSpd2GearD@ */ Scalar_FLOAT32_IEEE 0 LP_VCU020_AA_VCU_CM_single_kph -300.0 300.0 /end CHARACTERISTIC
/begin CHARACTERISTIC Cal_CreepDSpdIn "" VALUE 0x0000 /* @ECU_Address@Cal_CreepDSpdIn@ */ Scalar_FLOAT32_IEEE 0 LP_VCU020_AA_VCU_CM_single_kph -300.0 300.0 /end CHARACTERISTIC
/begin CHARACTERISTIC Cal_CreepDTarSpd "" VALUE 0x0000 /* @ECU_Address@Cal_CreepDTarSpd@ */ Scalar_FLOAT32_IEEE 0 LP_VCU020_AA_VCU_CM_single_kph 0.0 100.0 /end CHARACTERISTIC
/begin CHARACTERISTIC Cal_CreepInactiveDelay "" VALUE 0x0000 /* @ECU_Address@Cal_CreepInactiveDelay@ */ Scalar_FLOAT32_IEEE 0 LP_VCU020_AA_VCU_CM_single_s 0.0 10.0 /end CHARACTERISTIC
/begin CHARACTERISTIC Cal_CreepPIDMaxTrq "" VALUE 0x0000 /* @ECU_Address@Cal_CreepPIDMaxTrq@ */ Scalar_FLOAT32_IEEE 0 LP_VCU020_AA_VCU_CM_single_Nm -10000.0 10000.0 /end CHARACTERISTIC
/begin CHARACTERISTIC Cal_CreepPIDMinTrq "" VALUE 0x0000 /* @ECU_Address@Cal_CreepPIDMinTrq@ */ Scalar_FLOAT32_IEEE 0 LP_VCU020_AA_VCU_CM_single_Nm -10000.0 10000.0 /end CHARACTERISTIC
/begin CHARACTERISTIC Cal_CreepSpdIn "" VALUE 0x0000 /* @ECU_Address@Cal_CreepSpdIn@ */ Scalar_FLOAT32_IEEE 0 LP_VCU020_AA_VCU_CM_single_kph -300.0 300.0 /end CHARACTERISTIC
/begin CHARACTERISTIC Cal_CreepStartUpCtlMaxTm "" VALUE 0x0000 /* @ECU_Address@Cal_CreepStartUpCtlMaxTm@ */ Scalar_FLOAT32_IEEE 0 LP_VCU020_AA_VCU_CM_single_s 0.0 10.0 /end CHARACTERISTIC
/begin CHARACTERISTIC Cal_CreepTarSpd "" VALUE 0x0000 /* @ECU_Address@Cal_CreepTarSpd@ */ Scalar_FLOAT32_IEEE 0 LP_VCU020_AA_VCU_CM_single_kph -300.0 300.0 /end CHARACTERISTIC
/begin CHARACTERISTIC Cal_CreepTarSpdLowDeadband "" VALUE 0x0000 /* @ECU_Address@Cal_CreepTarSpdLowDeadband@ */ Scalar_FLOAT32_IEEE 0 LP_VCU020_AA_VCU_CM_single_kph -300.0 300.0 /end CHARACTERISTIC
/begin CHARACTERISTIC Cal_CreepTarSpdUpDeadband "" VALUE 0x0000 /* @ECU_Address@Cal_CreepTarSpdUpDeadband@ */ Scalar_FLOAT32_IEEE 0 LP_VCU020_AA_VCU_CM_single_kph -300.0 300.0 /end CHARACTERISTIC
/begin CHARACTERISTIC Cal_CreepTrqDnRate "" VALUE 0x0000 /* @ECU_Address@Cal_CreepTrqDnRate@ */ Scalar_FLOAT32_IEEE 0 LP_VCU020_AA_VCU_CM_single_Nm_s 0.0 20000.0 /end CHARACTERISTIC
/begin CHARACTERISTIC Cal_CreepTrqLPFKd "" VALUE 0x0000 /* @ECU_Address@Cal_CreepTrqLPFKd@ */ Scalar_FLOAT32_IEEE 0 LP_VCU020_AA_VCU_CM_single 0.0 1.0 /end CHARACTERISTIC
/begin CHARACTERISTIC Cal_CreepTrqUpRate "" VALUE 0x0000 /* @ECU_Address@Cal_CreepTrqUpRate@ */ Scalar_FLOAT32_IEEE 0 LP_VCU020_AA_VCU_CM_single_Nm_s 0.0 20000.0 /end CHARACTERISTIC
/begin CHARACTERISTIC Cal_DcdcPwr "" VALUE 0x0000 /* @ECU_Address@Cal_DcdcPwr@ */ Scalar_FLOAT32_IEEE 0 LP_VCU020_AA_VCU_CM_single_kw 0.0 300.0 /end CHARACTERISTIC
/begin CHARACTERISTIC Cal_DirectSpdThreshold "" VALUE 0x0000 /* @ECU_Address@Cal_DirectSpdThreshold@ */ Scalar_FLOAT32_IEEE 0 LP_VCU020_AA_VCU_CM_single_kph 0.0 5.0 /end CHARACTERISTIC
/begin CHARACTERISTIC Cal_EcoModeMaxSpdLowLimit "" VALUE 0x0000 /* @ECU_Address@Cal_EcoModeMaxSpdLowLimit@ */ Scalar_FLOAT32_IEEE 0 LP_VCU020_AA_VCU_CM_single_kph -300.0 300.0 /end CHARACTERISTIC
/begin CHARACTERISTIC Cal_EcoModeMaxSpdUpLimit "" VALUE 0x0000 /* @ECU_Address@Cal_EcoModeMaxSpdUpLimit@ */ Scalar_FLOAT32_IEEE 0 LP_VCU020_AA_VCU_CM_single_kph -300.0 300.0 /end CHARACTERISTIC
/begin CHARACTERISTIC Cal_Evb_AtmosphericPressure_kPa "" VALUE 0x0000 /* @ECU_Address@Cal_Evb_AtmosphericPressure_kPa@ */ Scalar_FLOAT32_IEEE 0 LP_VCU020_AA_VCU_CM_single_kPa 0.0 200.0 /end CHARACTERISTIC
/begin CHARACTERISTIC Cal_Evb_SafeModeWorkTime_sec "" VALUE 0x0000 /* @ECU_Address@Cal_Evb_SafeModeWorkTime_sec@ */ Scalar_FLOAT32_IEEE 0 LP_VCU020_AA_VCU_CM_single_sec 0.0 100.0 /end CHARACTERISTIC
/begin CHARACTERISTIC Cal_Evb_VehiSpdHighLowBoundary_kph "" VALUE 0x0000 /* @ECU_Address@Cal_Evb_VehiSpdHighLowBoundary_kph@ */ Scalar_FLOAT32_IEEE 0 LP_VCU020_AA_VCU_CM_single_kph 0.0 120.0 /end CHARACTERISTIC
/begin CHARACTERISTIC Cal_FrontMotRpmLPFKd "" VALUE 0x0000 /* @ECU_Address@Cal_FrontMotRpmLPFKd@ */ Scalar_FLOAT32_IEEE 0 LP_VCU020_AA_VCU_CM_single 0.0 1.0 /end CHARACTERISTIC
/begin CHARACTERISTIC Cal_FrontWheelSpdLPFKd "" VALUE 0x0000 /* @ECU_Address@Cal_FrontWheelSpdLPFKd@ */ Scalar_FLOAT32_IEEE 0 LP_VCU020_AA_VCU_CM_single 0.0 1.0 /end CHARACTERISTIC
/begin CHARACTERISTIC Cal_GearToggleInactiveTrq "" VALUE 0x0000 /* @ECU_Address@Cal_GearToggleInactiveTrq@ */ Scalar_FLOAT32_IEEE 0 LP_VCU020_AA_VCU_CM_single_Nm -10000.0 10000.0 /end CHARACTERISTIC
/begin CHARACTERISTIC Cal_GearToggleStsMaxTm "" VALUE 0x0000 /* @ECU_Address@Cal_GearToggleStsMaxTm@ */ Scalar_FLOAT32_IEEE 0 LP_VCU020_AA_VCU_CM_single_s 0.0 10.0 /end CHARACTERISTIC
/begin CHARACTERISTIC Cal_HACActiveHighMotRpm "" VALUE 0x0000 /* @ECU_Address@Cal_HACActiveHighMotRpm@ */ Scalar_FLOAT32_IEEE 0 LP_VCU020_AA_VCU_CM_single_rpm -20000.0 20000.0 /end CHARACTERISTIC
/begin CHARACTERISTIC Cal_HACActiveLowMotRpm "" VALUE 0x0000 /* @ECU_Address@Cal_HACActiveLowMotRpm@ */ Scalar_FLOAT32_IEEE 0 LP_VCU020_AA_VCU_CM_single_rpm -20000.0 20000.0 /end CHARACTERISTIC
/begin CHARACTERISTIC Cal_HACActiveVehSpd "" VALUE 0x0000 /* @ECU_Address@Cal_HACActiveVehSpd@ */ Scalar_FLOAT32_IEEE 0 LP_VCU020_AA_VCU_CM_single_kph -300.0 300.0 /end CHARACTERISTIC
/begin CHARACTERISTIC Cal_HACDecSpd "" VALUE 0x0000 /* @ECU_Address@Cal_HACDecSpd@ */ Scalar_FLOAT32_IEEE 0 LP_VCU020_AA_VCU_CM_single_kph -300.0 300.0 /end CHARACTERISTIC
/begin CHARACTERISTIC Cal_HACDecTime "" VALUE 0x0000 /* @ECU_Address@Cal_HACDecTime@ */ Scalar_FLOAT32_IEEE 0 LP_VCU020_AA_VCU_CM_single_s 0.0 100.0 /end CHARACTERISTIC
/begin CHARACTERISTIC Cal_HACInactiveVehSpd "" VALUE 0x0000 /* @ECU_Address@Cal_HACInactiveVehSpd@ */ Scalar_FLOAT32_IEEE 0 LP_VCU020_AA_VCU_CM_single_kph -300.0 300.0 /end CHARACTERISTIC
/begin CHARACTERISTIC Cal_HACMaxHoldTime "" VALUE 0x0000 /* @ECU_Address@Cal_HACMaxHoldTime@ */ Scalar_FLOAT32_IEEE 0 LP_VCU020_AA_VCU_CM_single_s 0.0 600.0 /end CHARACTERISTIC
/begin CHARACTERISTIC Cal_HACMaxTrq "" VALUE 0x0000 /* @ECU_Address@Cal_HACMaxTrq@ */ Scalar_FLOAT32_IEEE 0 LP_VCU020_AA_VCU_CM_single_Nm -10000.0 10000.0 /end CHARACTERISTIC
/begin CHARACTERISTIC Cal_HACMinTrq "" VALUE 0x0000 /* @ECU_Address@Cal_HACMinTrq@ */ Scalar_FLOAT32_IEEE 0 LP_VCU020_AA_VCU_CM_single_Nm -10000.0 10000.0 /end CHARACTERISTIC
/begin CHARACTERISTIC Cal_HACMode1ClearTrq "" VALUE 0x0000 /* @ECU_Address@Cal_HACMode1ClearTrq@ */ Scalar_FLOAT32_IEEE 0 LP_VCU020_AA_VCU_CM_single_Nm -10000.0 10000.0 /end CHARACTERISTIC
/begin CHARACTERISTIC Cal_HACMode1TrqLPF "" VALUE 0x0000 /* @ECU_Address@Cal_HACMode1TrqLPF@ */ Scalar_FLOAT32_IEEE 0 LP_VCU020_AA_VCU_CM_single 0.0 1.0 /end CHARACTERISTIC
/begin CHARACTERISTIC Cal_HACMode2ClearTrq "" VALUE 0x0000 /* @ECU_Address@Cal_HACMode2ClearTrq@ */ Scalar_FLOAT32_IEEE 0 LP_VCU020_AA_VCU_CM_single_Nm -10000.0 10000.0 /end CHARACTERISTIC
/begin CHARACTERISTIC Cal_HACMode2LowMotRpmDelay "" VALUE 0x0000 /* @ECU_Address@Cal_HACMode2LowMotRpmDelay@ */ Scalar_FLOAT32_IEEE 0 LP_VCU020_AA_VCU_CM_single_s 0.0 100.0 /end CHARACTERISTIC
/begin CHARACTERISTIC Cal_HACMode2TrqLPF "" VALUE 0x0000 /* @ECU_Address@Cal_HACMode2TrqLPF@ */ Scalar_FLOAT32_IEEE 0 LP_VCU020_AA_VCU_CM_single 0.0 1.0 /end CHARACTERISTIC
/begin CHARACTERISTIC Cal_HACMode3TrqLPF "" VALUE 0x0000 /* @ECU_Address@Cal_HACMode3TrqLPF@ */ Scalar_FLOAT32_IEEE 0 LP_VCU020_AA_VCU_CM_single 0.0 1.0 /end CHARACTERISTIC
/begin CHARACTERISTIC Cal_HACStsConfirmSpd "" VALUE 0x0000 /* @ECU_Address@Cal_HACStsConfirmSpd@ */ Scalar_FLOAT32_IEEE 0 LP_VCU020_AA_VCU_CM_single_kph -300.0 300.0 /end CHARACTERISTIC
/begin CHARACTERISTIC Cal_HACTrqClearConfirmTm "" VALUE 0x0000 /* @ECU_Address@Cal_HACTrqClearConfirmTm@ */ Scalar_FLOAT32_IEEE 0 LP_VCU020_AA_VCU_CM_single_s 0.0 100.0 /end CHARACTERISTIC
/begin CHARACTERISTIC Cal_HACTrqClearThreshold "" VALUE 0x0000 /* @ECU_Address@Cal_HACTrqClearThreshold@ */ Scalar_FLOAT32_IEEE 0 LP_VCU020_AA_VCU_CM_single_Nm -10000.0 10000.0 /end CHARACTERISTIC
/begin CHARACTERISTIC Cal_HDCActiveAccn "" VALUE 0x0000 /* @ECU_Address@Cal_HDCActiveAccn@ */ Scalar_FLOAT32_IEEE 0 LP_VCU020_AA_VCU_CM_single_m_s2 -20.0 20.0 /end CHARACTERISTIC
/begin CHARACTERISTIC Cal_HDCActiveConfirmTm "" VALUE 0x0000 /* @ECU_Address@Cal_HDCActiveConfirmTm@ */ Scalar_FLOAT32_IEEE 0 LP_VCU020_AA_VCU_CM_single_s 0.0 100.0 /end CHARACTERISTIC
/begin CHARACTERISTIC Cal_HDCActiveMaxAccPdlPct "" VALUE 0x0000 /* @ECU_Address@Cal_HDCActiveMaxAccPdlPct@ */ Scalar_FLOAT32_IEEE 0 LP_VCU020_AA_VCU_CM_single_pct -100.0 100.0 /end CHARACTERISTIC
/begin CHARACTERISTIC Cal_HDCActiveRecTrqLv1 "" VALUE 0x0000 /* @ECU_Address@Cal_HDCActiveRecTrqLv1@ */ Scalar_FLOAT32_IEEE 0 LP_VCU020_AA_VCU_CM_single_Nm -10000.0 10000.0 /end CHARACTERISTIC
/begin CHARACTERISTIC Cal_HDCActiveRecTrqLv2 "" VALUE 0x0000 /* @ECU_Address@Cal_HDCActiveRecTrqLv2@ */ Scalar_FLOAT32_IEEE 0 LP_VCU020_AA_VCU_CM_single_Nm -10000.0 10000.0 /end CHARACTERISTIC
/begin CHARACTERISTIC Cal_HDCActiveSpdLimit "" VALUE 0x0000 /* @ECU_Address@Cal_HDCActiveSpdLimit@ */ Scalar_FLOAT32_IEEE 0 LP_VCU020_AA_VCU_CM_single_kph -300.0 300.0 /end CHARACTERISTIC
/begin CHARACTERISTIC Cal_HDCInactiveSpdHigh "" VALUE 0x0000 /* @ECU_Address@Cal_HDCInactiveSpdHigh@ */ Scalar_FLOAT32_IEEE 0 LP_VCU020_AA_VCU_CM_single_kph -300.0 300.0 /end CHARACTERISTIC
/begin CHARACTERISTIC Cal_HDCInactiveSpdLow "" VALUE 0x0000 /* @ECU_Address@Cal_HDCInactiveSpdLow@ */ Scalar_FLOAT32_IEEE 0 LP_VCU020_AA_VCU_CM_single_kph -300.0 300.0 /end CHARACTERISTIC
/begin CHARACTERISTIC Cal_HDCMaxTrq "" VALUE 0x0000 /* @ECU_Address@Cal_HDCMaxTrq@ */ Scalar_FLOAT32_IEEE 0 LP_VCU020_AA_VCU_CM_single_Nm -10000.0 10000.0 /end CHARACTERISTIC
/begin CHARACTERISTIC Cal_HDCMinTrq "" VALUE 0x0000 /* @ECU_Address@Cal_HDCMinTrq@ */ Scalar_FLOAT32_IEEE 0 LP_VCU020_AA_VCU_CM_single_Nm -10000.0 10000.0 /end CHARACTERISTIC
/begin CHARACTERISTIC Cal_HDCTarSpd "" VALUE 0x0000 /* @ECU_Address@Cal_HDCTarSpd@ */ Scalar_FLOAT32_IEEE 0 LP_VCU020_AA_VCU_CM_single_kph -300.0 300.0 /end CHARACTERISTIC
/begin CHARACTERISTIC Cal_HacBackSlipInactiveSpd "" VALUE 0x0000 /* @ECU_Address@Cal_HacBackSlipInactiveSpd@ */ Scalar_FLOAT32_IEEE 0 LP_VCU020_AA_VCU_CM_single_kph -300.0 300.0 /end CHARACTERISTIC
/begin CHARACTERISTIC Cal_HacDecConfirmTm "" VALUE 0x0000 /* @ECU_Address@Cal_HacDecConfirmTm@ */ Scalar_FLOAT32_IEEE 0 LP_VCU020_AA_VCU_CM_single_s 0.0 100.0 /end CHARACTERISTIC
/begin CHARACTERISTIC Cal_HacDecPdlPct "" VALUE 0x0000 /* @ECU_Address@Cal_HacDecPdlPct@ */ Scalar_FLOAT32_IEEE 0 LP_VCU020_AA_VCU_CM_single_pct -100.0 100.0 /end CHARACTERISTIC
/begin CHARACTERISTIC Cal_MaxAccn2CCS "" VALUE 0x0000 /* @ECU_Address@Cal_MaxAccn2CCS@ */ Scalar_FLOAT32_IEEE 0 LP_VCU020_AA_VCU_CM_single_m_s2 -20.0 20.0 /end CHARACTERISTIC
/begin CHARACTERISTIC Cal_MaxDecn2CCS "" VALUE 0x0000 /* @ECU_Address@Cal_MaxDecn2CCS@ */ Scalar_FLOAT32_IEEE 0 LP_VCU020_AA_VCU_CM_single_m_s2 -20.0 20.0 /end CHARACTERISTIC
/begin CHARACTERISTIC Cal_MaxDrvTrqUpRate "" VALUE 0x0000 /* @ECU_Address@Cal_MaxDrvTrqUpRate@ */ Scalar_FLOAT32_IEEE 0 LP_VCU020_AA_VCU_CM_single_Nm_s 0.0 20000.0 /end CHARACTERISTIC
/begin CHARACTERISTIC Cal_MaxMotRpm2ZeroSpdSt "" VALUE 0x0000 /* @ECU_Address@Cal_MaxMotRpm2ZeroSpdSt@ */ Scalar_FLOAT32_IEEE 0 LP_VCU020_AA_VCU_CM_single_rpm -20000.0 20000.0 /end CHARACTERISTIC
/begin CHARACTERISTIC Cal_MaxRecTrqUpRate "" VALUE 0x0000 /* @ECU_Address@Cal_MaxRecTrqUpRate@ */ Scalar_FLOAT32_IEEE 0 LP_VCU020_AA_VCU_CM_single_Nm_s 0.0 20000.0 /end CHARACTERISTIC
/begin CHARACTERISTIC Cal_MaxSpd2CCS "" VALUE 0x0000 /* @ECU_Address@Cal_MaxSpd2CCS@ */ Scalar_FLOAT32_IEEE 0 LP_VCU020_AA_VCU_CM_single_kph 0.0 300.0 /end CHARACTERISTIC
/begin CHARACTERISTIC Cal_MaxSpd2ZeroSpdSt "" VALUE 0x0000 /* @ECU_Address@Cal_MaxSpd2ZeroSpdSt@ */ Scalar_FLOAT32_IEEE 0 LP_VCU020_AA_VCU_CM_single_kph -300.0 300.0 /end CHARACTERISTIC
/begin CHARACTERISTIC Cal_MaxSpdLimit2Backward "" VALUE 0x0000 /* @ECU_Address@Cal_MaxSpdLimit2Backward@ */ Scalar_FLOAT32_IEEE 0 LP_VCU020_AA_VCU_CM_single_kph -300.0 300.0 /end CHARACTERISTIC
/begin CHARACTERISTIC Cal_MaxSpdLimit2Forward "" VALUE 0x0000 /* @ECU_Address@Cal_MaxSpdLimit2Forward@ */ Scalar_FLOAT32_IEEE 0 LP_VCU020_AA_VCU_CM_single_kph -300.0 300.0 /end CHARACTERISTIC
/begin CHARACTERISTIC Cal_MaxSpdLimitOffSet "" VALUE 0x0000 /* @ECU_Address@Cal_MaxSpdLimitOffSet@ */ Scalar_FLOAT32_IEEE 0 LP_VCU020_AA_VCU_CM_single_kph -300.0 300.0 /end CHARACTERISTIC
/begin CHARACTERISTIC Cal_MaxSpdLimitTrqLPFKd "" VALUE 0x0000 /* @ECU_Address@Cal_MaxSpdLimitTrqLPFKd@ */ Scalar_FLOAT32_IEEE 0 LP_VCU020_AA_VCU_CM_single 0.0 1.0 /end CHARACTERISTIC
/begin CHARACTERISTIC Cal_MinSpd2CCS "" VALUE 0x0000 /* @ECU_Address@Cal_MinSpd2CCS@ */ Scalar_FLOAT32_IEEE 0 LP_VCU020_AA_VCU_CM_single_kph 0.0 300.0 /end CHARACTERISTIC
/begin CHARACTERISTIC Cal_MotMaxDrvPwr "" VALUE 0x0000 /* @ECU_Address@Cal_MotMaxDrvPwr@ */ Scalar_FLOAT32_IEEE 0 LP_VCU020_AA_VCU_CM_single_kw 0.0 200.0 /end CHARACTERISTIC
/begin CHARACTERISTIC Cal_MotMaxRecPwr "" VALUE 0x0000 /* @ECU_Address@Cal_MotMaxRecPwr@ */ Scalar_FLOAT32_IEEE 0 LP_VCU020_AA_VCU_CM_single_kw 0.0 200.0 /end CHARACTERISTIC
/begin CHARACTERISTIC Cal_MotRpmValid2SpdCalc "" VALUE 0x0000 /* @ECU_Address@Cal_MotRpmValid2SpdCalc@ */ Scalar_FLOAT32_IEEE 0 LP_VCU020_AA_VCU_CM_single_rpm -20000.0 20000.0 /end CHARACTERISTIC
/begin CHARACTERISTIC Cal_MotTrqDnRateLimit2ESCActive "" VALUE 0x0000 /* @ECU_Address@Cal_MotTrqDnRateLimit2ESCActive@ */ Scalar_FLOAT32_IEEE 0 LP_VCU020_AA_VCU_CM_single_Nm_s 0.0 20000.0 /end CHARACTERISTIC
/begin CHARACTERISTIC Cal_MotTrqUpRateLimit2ESCActive "" VALUE 0x0000 /* @ECU_Address@Cal_MotTrqUpRateLimit2ESCActive@ */ Scalar_FLOAT32_IEEE 0 LP_VCU020_AA_VCU_CM_single_Nm_s 0.0 20000.0 /end CHARACTERISTIC
/begin CHARACTERISTIC Cal_PwrLimitUpRateLimit "" VALUE 0x0000 /* @ECU_Address@Cal_PwrLimitUpRateLimit@ */ Scalar_FLOAT32_IEEE 0 LP_VCU020_AA_VCU_CM_single_kw_s 0.0 10000.0 /end CHARACTERISTIC
/begin CHARACTERISTIC Cal_PwrReduceLv0 "" VALUE 0x0000 /* @ECU_Address@Cal_PwrReduceLv0@ */ Scalar_FLOAT32_IEEE 0 LP_VCU020_AA_VCU_CM_single_kw 0.0 300.0 /end CHARACTERISTIC
/begin CHARACTERISTIC Cal_PwrReduceLv1 "" VALUE 0x0000 /* @ECU_Address@Cal_PwrReduceLv1@ */ Scalar_FLOAT32_IEEE 0 LP_VCU020_AA_VCU_CM_single_kw 0.0 300.0 /end CHARACTERISTIC
/begin CHARACTERISTIC Cal_PwrReduceLv2 "" VALUE 0x0000 /* @ECU_Address@Cal_PwrReduceLv2@ */ Scalar_FLOAT32_IEEE 0 LP_VCU020_AA_VCU_CM_single_kw 0.0 300.0 /end CHARACTERISTIC
/begin CHARACTERISTIC Cal_PwrReduceLv3 "" VALUE 0x0000 /* @ECU_Address@Cal_PwrReduceLv3@ */ Scalar_FLOAT32_IEEE 0 LP_VCU020_AA_VCU_CM_single_kw 0.0 300.0 /end CHARACTERISTIC
/begin CHARACTERISTIC Cal_RearWheelSpdLPFKd "" VALUE 0x0000 /* @ECU_Address@Cal_RearWheelSpdLPFKd@ */ Scalar_FLOAT32_IEEE 0 LP_VCU020_AA_VCU_CM_single 0.0 1.0 /end CHARACTERISTIC
/begin CHARACTERISTIC Cal_SetABSActiveTrq "" VALUE 0x0000 /* @ECU_Address@Cal_SetABSActiveTrq@ */ Scalar_FLOAT32_IEEE 0 LP_VCU020_AA_VCU_CM_single_Nm -100.0 100.0 /end CHARACTERISTIC
/begin CHARACTERISTIC Cal_SpdChooseSwithThreshold "" VALUE 0x0000 /* @ECU_Address@Cal_SpdChooseSwithThreshold@ */ Scalar_FLOAT32_IEEE 0 LP_VCU020_AA_VCU_CM_single_kph -300.0 300.0 /end CHARACTERISTIC
/begin CHARACTERISTIC Cal_SpdChooseSwithThreshold1 "" VALUE 0x0000 /* @ECU_Address@Cal_SpdChooseSwithThreshold1@ */ Scalar_FLOAT32_IEEE 0 LP_VCU020_AA_VCU_CM_single_kph -300.0 300.0 /end CHARACTERISTIC
/begin CHARACTERISTIC Cal_SpdDirectMotRpmThreshold "" VALUE 0x0000 /* @ECU_Address@Cal_SpdDirectMotRpmThreshold@ */ Scalar_FLOAT32_IEEE 0 LP_VCU020_AA_VCU_CM_single_rpm -20000.0 20000.0 /end CHARACTERISTIC
/begin CHARACTERISTIC Cal_SpdLimitActiveDeltaSpd "" VALUE 0x0000 /* @ECU_Address@Cal_SpdLimitActiveDeltaSpd@ */ Scalar_FLOAT32_IEEE 0 LP_VCU020_AA_VCU_CM_single_kph -300.0 300.0 /end CHARACTERISTIC
/begin CHARACTERISTIC Cal_SpdLimitActiveDeltaSpdOffSet "" VALUE 0x0000 /* @ECU_Address@Cal_SpdLimitActiveDeltaSpdOffSet@ */ Scalar_FLOAT32_IEEE 0 LP_VCU020_AA_VCU_CM_single_kph -300.0 300.0 /end CHARACTERISTIC
/begin CHARACTERISTIC Cal_SpdLimitErr0 "" VALUE 0x0000 /* @ECU_Address@Cal_SpdLimitErr0@ */ Scalar_FLOAT32_IEEE 0 LP_VCU020_AA_VCU_CM_single_kph -300.0 300.0 /end CHARACTERISTIC
/begin CHARACTERISTIC Cal_SpdLimitErr1 "" VALUE 0x0000 /* @ECU_Address@Cal_SpdLimitErr1@ */ Scalar_FLOAT32_IEEE 0 LP_VCU020_AA_VCU_CM_single_kph -300.0 300.0 /end CHARACTERISTIC
/begin CHARACTERISTIC Cal_SpdLimitErr2 "" VALUE 0x0000 /* @ECU_Address@Cal_SpdLimitErr2@ */ Scalar_FLOAT32_IEEE 0 LP_VCU020_AA_VCU_CM_single_kph -300.0 300.0 /end CHARACTERISTIC
/begin CHARACTERISTIC Cal_SpdLimitErr3 "" VALUE 0x0000 /* @ECU_Address@Cal_SpdLimitErr3@ */ Scalar_FLOAT32_IEEE 0 LP_VCU020_AA_VCU_CM_single_kph -300.0 300.0 /end CHARACTERISTIC
/begin CHARACTERISTIC Cal_SpdLimitMaxTrq "" VALUE 0x0000 /* @ECU_Address@Cal_SpdLimitMaxTrq@ */ Scalar_FLOAT32_IEEE 0 LP_VCU020_AA_VCU_CM_single_Nm -10000.0 10000.0 /end CHARACTERISTIC
/begin CHARACTERISTIC Cal_SpdLimitMinTrq "" VALUE 0x0000 /* @ECU_Address@Cal_SpdLimitMinTrq@ */ Scalar_FLOAT32_IEEE 0 LP_VCU020_AA_VCU_CM_single_Nm -10000.0 10000.0 /end CHARACTERISTIC
/begin CHARACTERISTIC Cal_SpdLimitTrqDnRateLimit "" VALUE 0x0000 /* @ECU_Address@Cal_SpdLimitTrqDnRateLimit@ */ Scalar_FLOAT32_IEEE 0 LP_VCU020_AA_VCU_CM_single_Nm_s 0.0 20000.0 /end CHARACTERISTIC
/begin CHARACTERISTIC Cal_SpdLimitTrqUpRateLimit "" VALUE 0x0000 /* @ECU_Address@Cal_SpdLimitTrqUpRateLimit@ */ Scalar_FLOAT32_IEEE 0 LP_VCU020_AA_VCU_CM_single_Nm_s 0.0 20000.0 /end CHARACTERISTIC
/begin CHARACTERISTIC Cal_StartUpActiveTrq "" VALUE 0x0000 /* @ECU_Address@Cal_StartUpActiveTrq@ */ Scalar_FLOAT32_IEEE 0 LP_VCU020_AA_VCU_CM_single_Nm -10000.0 10000.0 /end CHARACTERISTIC
/begin CHARACTERISTIC Cal_StartUpInactiveSpd "" VALUE 0x0000 /* @ECU_Address@Cal_StartUpInactiveSpd@ */ Scalar_FLOAT32_IEEE 0 LP_VCU020_AA_VCU_CM_single_kph -300.0 300.0 /end CHARACTERISTIC
/begin CHARACTERISTIC Cal_StartUpTrqLPFKd "" VALUE 0x0000 /* @ECU_Address@Cal_StartUpTrqLPFKd@ */ Scalar_FLOAT32_IEEE 0 LP_VCU020_AA_VCU_CM_single 0.0 1.0 /end CHARACTERISTIC
/begin CHARACTERISTIC Cal_TrqDirectNegThreshold "" VALUE 0x0000 /* @ECU_Address@Cal_TrqDirectNegThreshold@ */ Scalar_FLOAT32_IEEE 0 LP_VCU020_AA_VCU_CM_single_Nm -10000.0 10000.0 /end CHARACTERISTIC
/begin CHARACTERISTIC Cal_TrqDirectPosThreshold "" VALUE 0x0000 /* @ECU_Address@Cal_TrqDirectPosThreshold@ */ Scalar_FLOAT32_IEEE 0 LP_VCU020_AA_VCU_CM_single_Nm -10000.0 10000.0 /end CHARACTERISTIC
/begin CHARACTERISTIC Cal_TrqDirectThreshold "" VALUE 0x0000 /* @ECU_Address@Cal_TrqDirectThreshold@ */ Scalar_FLOAT32_IEEE 0 LP_VCU020_AA_VCU_CM_single 0.0 100.0 /end CHARACTERISTIC
/begin CHARACTERISTIC Cal_TrqDnLineHighPar "" VALUE 0x0000 /* @ECU_Address@Cal_TrqDnLineHighPar@ */ Scalar_FLOAT32_IEEE 0 LP_VCU020_AA_VCU_CM_single_Nm -10000.0 10000.0 /end CHARACTERISTIC
/begin CHARACTERISTIC Cal_TrqDnLineLowPar "" VALUE 0x0000 /* @ECU_Address@Cal_TrqDnLineLowPar@ */ Scalar_FLOAT32_IEEE 0 LP_VCU020_AA_VCU_CM_single_Nm -10000.0 10000.0 /end CHARACTERISTIC
/begin CHARACTERISTIC Cal_TrqDnRateLimit2StartShakeRestr "" VALUE 0x0000 /* @ECU_Address@Cal_TrqDnRateLimit2StartShakeRestr@ */ Scalar_FLOAT32_IEEE 0 LP_VCU020_AA_VCU_CM_single_Nm_s 0.0 20000.0 /end CHARACTERISTIC
/begin CHARACTERISTIC Cal_TrqDnRateLimit2StartUp "" VALUE 0x0000 /* @ECU_Address@Cal_TrqDnRateLimit2StartUp@ */ Scalar_FLOAT32_IEEE 0 LP_VCU020_AA_VCU_CM_single_Nm_s 0.0 20000.0 /end CHARACTERISTIC
/begin CHARACTERISTIC Cal_TrqInactiveCreepMaxTm "" VALUE 0x0000 /* @ECU_Address@Cal_TrqInactiveCreepMaxTm@ */ Scalar_FLOAT32_IEEE 0 LP_VCU020_AA_VCU_CM_single_s 0.0 10.0 /end CHARACTERISTIC
/begin CHARACTERISTIC Cal_TrqUpLineHighPar "" VALUE 0x0000 /* @ECU_Address@Cal_TrqUpLineHighPar@ */ Scalar_FLOAT32_IEEE 0 LP_VCU020_AA_VCU_CM_single_Nm -10000.0 10000.0 /end CHARACTERISTIC
/begin CHARACTERISTIC Cal_TrqUpLineLowPar "" VALUE 0x0000 /* @ECU_Address@Cal_TrqUpLineLowPar@ */ Scalar_FLOAT32_IEEE 0 LP_VCU020_AA_VCU_CM_single_Nm -10000.0 10000.0 /end CHARACTERISTIC
/begin CHARACTERISTIC Cal_TrqUpRateLimit2StartShakeRestr "" VALUE 0x0000 /* @ECU_Address@Cal_TrqUpRateLimit2StartShakeRestr@ */ Scalar_FLOAT32_IEEE 0 LP_VCU020_AA_VCU_CM_single_Nm_s 0.0 20000.0 /end CHARACTERISTIC
/begin CHARACTERISTIC Cal_TrqUpRateLimit2StartUp "" VALUE 0x0000 /* @ECU_Address@Cal_TrqUpRateLimit2StartUp@ */ Scalar_FLOAT32_IEEE 0 LP_VCU020_AA_VCU_CM_single_Nm_s 0.0 20000.0 /end CHARACTERISTIC
/begin CHARACTERISTIC Cal_VehAccn2BrkLightCancel "" VALUE 0x0000 /* @ECU_Address@Cal_VehAccn2BrkLightCancel@ */ Scalar_FLOAT32_IEEE 0 LP_VCU020_AA_VCU_CM_single_m_s2 -20.0 20.0 /end CHARACTERISTIC
/begin CHARACTERISTIC Cal_VehAccn2BrkLightConfirm "" VALUE 0x0000 /* @ECU_Address@Cal_VehAccn2BrkLightConfirm@ */ Scalar_FLOAT32_IEEE 0 LP_VCU020_AA_VCU_CM_single_m_s2 -20.0 20.0 /end CHARACTERISTIC
/begin CHARACTERISTIC Cal_VehAccnCalcPar1 "" VALUE 0x0000 /* @ECU_Address@Cal_VehAccnCalcPar1@ */ Scalar_FLOAT32_IEEE 0 LP_VCU020_AA_VCU_CM_single 0.0 1.0 /end CHARACTERISTIC
/begin CHARACTERISTIC Cal_VehAccnCalcPar2 "" VALUE 0x0000 /* @ECU_Address@Cal_VehAccnCalcPar2@ */ Scalar_FLOAT32_IEEE 0 LP_VCU020_AA_VCU_CM_single 0.0 1.0 /end CHARACTERISTIC
/begin CHARACTERISTIC Cal_VehSpdLPFKd2SpdLimit "" VALUE 0x0000 /* @ECU_Address@Cal_VehSpdLPFKd2SpdLimit@ */ Scalar_FLOAT32_IEEE 0 LP_VCU020_AA_VCU_CM_single 0.0 1.0 /end CHARACTERISTIC
/begin CHARACTERISTIC Cal_VehSpdScaleFactor "" VALUE 0x0000 /* @ECU_Address@Cal_VehSpdScaleFactor@ */ Scalar_FLOAT32_IEEE 0 LP_VCU020_AA_VCU_CM_single -300.0 300.0 /end CHARACTERISTIC
/begin CHARACTERISTIC Cal_VehSpdScaleFactor2CCSActive "" VALUE 0x0000 /* @ECU_Address@Cal_VehSpdScaleFactor2CCSActive@ */ Scalar_FLOAT32_IEEE 0 LP_VCU020_AA_VCU_CM_single 0.0 10.0 /end CHARACTERISTIC
/begin CHARACTERISTIC Cal_VehSpdScaleFactor2CCSCtl "" VALUE 0x0000 /* @ECU_Address@Cal_VehSpdScaleFactor2CCSCtl@ */ Scalar_FLOAT32_IEEE 0 LP_VCU020_AA_VCU_CM_single 0.0 10.0 /end CHARACTERISTIC
/begin CHARACTERISTIC Cal_ZeroSpdCancelTm "" VALUE 0x0000 /* @ECU_Address@Cal_ZeroSpdCancelTm@ */ Scalar_FLOAT32_IEEE 0 LP_VCU020_AA_VCU_CM_single_s 0.0 10.0 /end CHARACTERISTIC
/begin CHARACTERISTIC Cal_ZeroSpdConfirmTm "" VALUE 0x0000 /* @ECU_Address@Cal_ZeroSpdConfirmTm@ */ Scalar_FLOAT32_IEEE 0 LP_VCU020_AA_VCU_CM_single_s 0.0 10.0 /end CHARACTERISTIC
/begin CHARACTERISTIC Cfg_EcoModeSpdLimit "" VALUE 0x0000 /* @ECU_Address@Cfg_EcoModeSpdLimit@ */ Scalar_FLOAT32_IEEE 0 LP_VCU020_AA_VCU_CM_single 0.0 300.0 /end CHARACTERISTIC
/begin CHARACTERISTIC Cal_AccpedFaultStsCounter "" VALUE 0x0000 /* @ECU_Address@Cal_AccpedFaultStsCounter@ */ Scalar_UWORD 0 LP_VCU020_AA_VCU_CM_uint16 0.0 100.0 /end CHARACTERISTIC
/begin CHARACTERISTIC Cal_NShiftReqConfirmTime_msec "" VALUE 0x0000 /* @ECU_Address@Cal_NShiftReqConfirmTime_msec@ */ Scalar_UWORD 0 LP_VCU020_AA_VCU_CM_uint16_msec 0.0 1000.0 /end CHARACTERISTIC
/begin CHARACTERISTIC Cal_TempFaultStsCounter "" VALUE 0x0000 /* @ECU_Address@Cal_TempFaultStsCounter@ */ Scalar_UWORD 0 LP_VCU020_AA_VCU_CM_uint16 0.0 100.0 /end CHARACTERISTIC
/begin CHARACTERISTIC Cal_ACCAccnCtlMode "" VALUE 0x0000 /* @ECU_Address@Cal_ACCAccnCtlMode@ */ Scalar_UBYTE 0 LP_VCU020_AA_VCU_CM_uint8 0.0 1.0 /end CHARACTERISTIC
/begin CHARACTERISTIC Cal_APSAccnCtlMode "" VALUE 0x0000 /* @ECU_Address@Cal_APSAccnCtlMode@ */ Scalar_UBYTE 0 LP_VCU020_AA_VCU_CM_uint8 0.0 1.0 /end CHARACTERISTIC
/begin CHARACTERISTIC Cal_HACTrqRateMode "" VALUE 0x0000 /* @ECU_Address@Cal_HACTrqRateMode@ */ Scalar_UBYTE 0 LP_VCU020_AA_VCU_CM_uint8 0.0 1.0 /end CHARACTERISTIC
/begin CHARACTERISTIC Cal_VehiSpdDtoR_kph "" VALUE 0x0000 /* @ECU_Address@Cal_VehiSpdDtoR_kph@ */ Scalar_UBYTE 0 LP_VCU020_AA_VCU_CM_uint8_kph 0.0 100.0 /end CHARACTERISTIC
/begin CHARACTERISTIC Cfg_ABSFuncRes "" VALUE 0x0000 /* @ECU_Address@Cfg_ABSFuncRes@ */ Scalar_UBYTE 0 LP_VCU020_AA_VCU_CM_uint8 0.0 1.0 /end CHARACTERISTIC
/begin CHARACTERISTIC Cfg_ACCFunction "" VALUE 0x0000 /* @ECU_Address@Cfg_ACCFunction@ */ Scalar_UBYTE 0 LP_VCU020_AA_VCU_CM_uint8 0.0 1.0 /end CHARACTERISTIC
/begin CHARACTERISTIC Cfg_APSFunction "" VALUE 0x0000 /* @ECU_Address@Cfg_APSFunction@ */ Scalar_UBYTE 0 LP_VCU020_AA_VCU_CM_uint8 0.0 1.0 /end CHARACTERISTIC
/begin CHARACTERISTIC Cfg_AccnModeGearD "" VALUE 0x0000 /* @ECU_Address@Cfg_AccnModeGearD@ */ Scalar_UBYTE 0 LP_VCU020_AA_VCU_CM_uint8 0.0 3.0 /end CHARACTERISTIC
/begin CHARACTERISTIC Cfg_AccnModeGearR "" VALUE 0x0000 /* @ECU_Address@Cfg_AccnModeGearR@ */ Scalar_UBYTE 0 LP_VCU020_AA_VCU_CM_uint8 0.0 3.0 /end CHARACTERISTIC
/begin CHARACTERISTIC Cfg_CCSFunction "" VALUE 0x0000 /* @ECU_Address@Cfg_CCSFunction@ */ Scalar_UBYTE 0 LP_VCU020_AA_VCU_CM_uint8 0.0 1.0 /end CHARACTERISTIC
/begin CHARACTERISTIC Cfg_DecnModeGearD "" VALUE 0x0000 /* @ECU_Address@Cfg_DecnModeGearD@ */ Scalar_UBYTE 0 LP_VCU020_AA_VCU_CM_uint8 0.0 3.0 /end CHARACTERISTIC
/begin CHARACTERISTIC Cfg_DecnModeGearR "" VALUE 0x0000 /* @ECU_Address@Cfg_DecnModeGearR@ */ Scalar_UBYTE 0 LP_VCU020_AA_VCU_CM_uint8 0.0 3.0 /end CHARACTERISTIC
/begin CHARACTERISTIC Cfg_ESCFuncRes "" VALUE 0x0000 /* @ECU_Address@Cfg_ESCFuncRes@ */ Scalar_UBYTE 0 LP_VCU020_AA_VCU_CM_uint8 0.0 1.0 /end CHARACTERISTIC
/begin CHARACTERISTIC Cfg_HACFunctionGearD "" VALUE 0x0000 /* @ECU_Address@Cfg_HACFunctionGearD@ */ Scalar_UBYTE 0 LP_VCU020_AA_VCU_CM_uint8 0.0 1.0 /end CHARACTERISTIC
/begin CHARACTERISTIC Cfg_HACFunctionGearR "" VALUE 0x0000 /* @ECU_Address@Cfg_HACFunctionGearR@ */ Scalar_UBYTE 0 LP_VCU020_AA_VCU_CM_uint8 0.0 1.0 /end CHARACTERISTIC
/begin CHARACTERISTIC Cfg_HDCFunction "" VALUE 0x0000 /* @ECU_Address@Cfg_HDCFunction@ */ Scalar_UBYTE 0 LP_VCU020_AA_VCU_CM_uint8 0.0 1.0 /end CHARACTERISTIC
/begin CHARACTERISTIC Cfg_MaxSpdLimit "" VALUE 0x0000 /* @ECU_Address@Cfg_MaxSpdLimit@ */ Scalar_UBYTE 0 LP_VCU020_AA_VCU_CM_uint8 0.0 1.0 /end CHARACTERISTIC
/begin CHARACTERISTIC Cfg_StartUpCtl "" VALUE 0x0000 /* @ECU_Address@Cfg_StartUpCtl@ */ Scalar_UBYTE 0 LP_VCU020_AA_VCU_CM_uint8 0.0 1.0 /end CHARACTERISTIC
/begin CHARACTERISTIC Cfg_TrqDirectSwtCtl "" VALUE 0x0000 /* @ECU_Address@Cfg_TrqDirectSwtCtl@ */ Scalar_UBYTE 0 LP_VCU020_AA_VCU_CM_uint8 0.0 1.0 /end CHARACTERISTIC
/begin CHARACTERISTIC Cfg_ZeroSpdCtlGearD "" VALUE 0x0000 /* @ECU_Address@Cfg_ZeroSpdCtlGearD@ */ Scalar_UBYTE 0 LP_VCU020_AA_VCU_CM_uint8 0.0 2.0 /end CHARACTERISTIC
/begin CHARACTERISTIC Cfg_ZeroSpdCtlGearR "" VALUE 0x0000 /* @ECU_Address@Cfg_ZeroSpdCtlGearR@ */ Scalar_UBYTE 0 LP_VCU020_AA_VCU_CM_uint8 0.0 2.0 /end CHARACTERISTIC
/begin CHARACTERISTIC Test_AccnModeGearD "" VALUE 0x0000 /* @ECU_Address@Test_AccnModeGearD@ */ Scalar_UBYTE 0 LP_VCU020_AA_VCU_CM_uint8 0.0 1.0 /end CHARACTERISTIC
/begin CHARACTERISTIC Test_AccnModeGearR "" VALUE 0x0000 /* @ECU_Address@Test_AccnModeGearR@ */ Scalar_UBYTE 0 LP_VCU020_AA_VCU_CM_uint8 0.0 1.0 /end CHARACTERISTIC
/begin CHARACTERISTIC Test_DecnModeGearD "" VALUE 0x0000 /* @ECU_Address@Test_DecnModeGearD@ */ Scalar_UBYTE 0 LP_VCU020_AA_VCU_CM_uint8 0.0 1.0 /end CHARACTERISTIC
/begin CHARACTERISTIC Test_DecnModeGearR "" VALUE 0x0000 /* @ECU_Address@Test_DecnModeGearR@ */ Scalar_UBYTE 0 LP_VCU020_AA_VCU_CM_uint8 0.0 1.0 /end CHARACTERISTIC
/begin CHARACTERISTIC Test_ESCActive "" VALUE 0x0000 /* @ECU_Address@Test_ESCActive@ */ Scalar_UBYTE 0 LP_VCU020_AA_VCU_CM_uint8 0.0 1.0 /end CHARACTERISTIC
/begin CHARACTERISTIC Test_EcoModeSpdLimit "" VALUE 0x0000 /* @ECU_Address@Test_EcoModeSpdLimit@ */ Scalar_UBYTE 0 LP_VCU020_AA_VCU_CM_uint8 0.0 1.0 /end CHARACTERISTIC
/begin CHARACTERISTIC Test_ZeroSpdCtl "" VALUE 0x0000 /* @ECU_Address@Test_ZeroSpdCtl@ */ Scalar_UBYTE 0 LP_VCU020_AA_VCU_CM_uint8 0.0 1.0 /end CHARACTERISTIC
/begin CHARACTERISTIC CFG_CCSVehSpdCtl "" VALUE 0x0000 /* @ECU_Address@CFG_CCSVehSpdCtl@ */ Scalar_FLOAT32_IEEE 0 LP_VCU020_AA_VCU_CM_single_kph -300.0 300.0 /end CHARACTERISTIC
/begin CHARACTERISTIC Cal_DelayTm2DrvModeToggle "" VALUE 0x0000 /* @ECU_Address@Cal_DelayTm2DrvModeToggle@ */ Scalar_FLOAT32_IEEE 0 LP_VCU020_AA_VCU_CM_single_s 0.0 10.0 /end CHARACTERISTIC
/begin CHARACTERISTIC Cal_DrvModeToggleInactivePdlPct "" VALUE 0x0000 /* @ECU_Address@Cal_DrvModeToggleInactivePdlPct@ */ Scalar_FLOAT32_IEEE 0 LP_VCU020_AA_VCU_CM_single_pct 0.0 100.0 /end CHARACTERISTIC
/begin CHARACTERISTIC Cal_DrvModeToggleInactiveTm "" VALUE 0x0000 /* @ECU_Address@Cal_DrvModeToggleInactiveTm@ */ Scalar_FLOAT32_IEEE 0 LP_VCU020_AA_VCU_CM_single_s 0.0 10.0 /end CHARACTERISTIC
/begin CHARACTERISTIC Cal_DrvModeToggleInactiveTrq "" VALUE 0x0000 /* @ECU_Address@Cal_DrvModeToggleInactiveTrq@ */ Scalar_FLOAT32_IEEE 0 LP_VCU020_AA_VCU_CM_single_Nm -10000.0 10000.0 /end CHARACTERISTIC
/begin CHARACTERISTIC Cal_FixedStepSize "" VALUE 0x0000 /* @ECU_Address@Cal_FixedStepSize@ */ Scalar_FLOAT32_IEEE 0 LP_VCU020_AA_VCU_CM_single_s 0.0 1.0 /end CHARACTERISTIC
/begin CHARACTERISTIC Cal_LowSpdThreshold "" VALUE 0x0000 /* @ECU_Address@Cal_LowSpdThreshold@ */ Scalar_FLOAT32_IEEE 0 LP_VCU020_AA_VCU_CM_single_kph -300.0 300.0 /end CHARACTERISTIC
/begin CHARACTERISTIC Cal_MinMaxRecTrq "" VALUE 0x0000 /* @ECU_Address@Cal_MinMaxRecTrq@ */ Scalar_FLOAT32_IEEE 0 LP_VCU020_AA_VCU_CM_single_Nm -10000.0 10000.0 /end CHARACTERISTIC
/begin CHARACTERISTIC Cal_PwrlimtGain "" VALUE 0x0000 /* @ECU_Address@Cal_PwrlimtGain@ */ Scalar_FLOAT32_IEEE 0 LP_VCU020_AA_VCU_CM_single 0.2 1.0 /end CHARACTERISTIC
/begin CHARACTERISTIC Cal_RecTrqScaleFactor "" VALUE 0x0000 /* @ECU_Address@Cal_RecTrqScaleFactor@ */ Scalar_FLOAT32_IEEE 0 LP_VCU020_AA_VCU_CM_single 0.0 2.0 /end CHARACTERISTIC
/begin CHARACTERISTIC Cal_SpdScaleFactor2SpdCtl "" VALUE 0x0000 /* @ECU_Address@Cal_SpdScaleFactor2SpdCtl@ */ Scalar_FLOAT32_IEEE 0 LP_VCU020_AA_VCU_CM_single 0.0 2.0 /end CHARACTERISTIC
/begin CHARACTERISTIC CFG_CCSFuncSt "" VALUE 0x0000 /* @ECU_Address@CFG_CCSFuncSt@ */ Scalar_UBYTE 0 LP_VCU020_AA_VCU_CM_uint8 0.0 1.0 /end CHARACTERISTIC
/begin CHARACTERISTIC Cal_PwrMaxHoldTime "" VALUE 0x0000 /* @ECU_Address@Cal_PwrMaxHoldTime@ */ Scalar_UBYTE 0 LP_VCU020_AA_VCU_CM_uint8_ms 0.0 255.0 /end CHARACTERISTIC
/begin CHARACTERISTIC Cfg_BarrateMode "" VALUE 0x0000 /* @ECU_Address@Cfg_BarrateMode@ */ Scalar_UBYTE 0 LP_VCU020_AA_VCU_CM_uint8 0.0 1.0 /end CHARACTERISTIC
/begin CHARACTERISTIC Cfg_BrkRecFunction "" VALUE 0x0000 /* @ECU_Address@Cfg_BrkRecFunction@ */ Scalar_UBYTE 0 LP_VCU020_AA_VCU_CM_uint8 0.0 1.0 /end CHARACTERISTIC
/begin CHARACTERISTIC Cfg_EPBCtl "" VALUE 0x0000 /* @ECU_Address@Cfg_EPBCtl@ */ Scalar_UBYTE 0 LP_VCU020_AA_VCU_CM_uint8 0.0 3.0 /end CHARACTERISTIC
/begin CHARACTERISTIC Cfg_SlipRecFunction "" VALUE 0x0000 /* @ECU_Address@Cfg_SlipRecFunction@ */ Scalar_UBYTE 0 LP_VCU020_AA_VCU_CM_uint8 0.0 1.0 /end CHARACTERISTIC
/begin CHARACTERISTIC Test_BrkRecFunction "" VALUE 0x0000 /* @ECU_Address@Test_BrkRecFunction@ */ Scalar_UBYTE 0 LP_VCU020_AA_VCU_CM_uint8 0.0 1.0 /end CHARACTERISTIC
/begin CHARACTERISTIC Test_CCSModeDebug "" VALUE 0x0000 /* @ECU_Address@Test_CCSModeDebug@ */ Scalar_UBYTE 0 LP_VCU020_AA_VCU_CM_uint8 0.0 1.0 /end CHARACTERISTIC
/begin CHARACTERISTIC Test_EPBCtl "" VALUE 0x0000 /* @ECU_Address@Test_EPBCtl@ */ Scalar_UBYTE 0 LP_VCU020_AA_VCU_CM_uint8 0.0 1.0 /end CHARACTERISTIC
/begin CHARACTERISTIC Test_SlipRecFunction "" VALUE 0x0000 /* @ECU_Address@Test_SlipRecFunction@ */ Scalar_UBYTE 0 LP_VCU020_AA_VCU_CM_uint8 0.0 1.0 /end CHARACTERISTIC
/begin CHARACTERISTIC Cfg_HACTrqThresholdActive "" VALUE 0x0000 /* @ECU_Address@Cfg_HACTrqThresholdActive@ */ Scalar_BOOLEAN 0 LP_VCU020_AA_VCU_CM_boolean 0.0 1.0 /end CHARACTERISTIC
/begin MEASUREMENT View_WheelTrqUpRateLimit "" FLOAT32_IEEE LP_VCU020_AA_VCU_CM_single_Nm_s 0 0 -3.4E+38 3.4E+38 ECU_ADDRESS 0x0000 /* @ECU_Address@View_WheelTrqUpRateLimit@ */ /end MEASUREMENT
/begin MEASUREMENT View_WheelTrqDnRateLimit "" FLOAT32_IEEE LP_VCU020_AA_VCU_CM_single_Nm_s 0 0 -3.4E+38 3.4E+38 ECU_ADDRESS 0x0000 /* @ECU_Address@View_WheelTrqDnRateLimit@ */ /end MEASUREMENT
/begin MEASUREMENT View_WheelTrqReqLPF "" FLOAT32_IEEE LP_VCU020_AA_VCU_CM_single_Nm 0 0 -3.4E+38 3.4E+38 ECU_ADDRESS 0x0000 /* @ECU_Address@View_WheelTrqReqLPF@ */ /end MEASUREMENT
/begin MEASUREMENT View_MotTrqReqWithSUC "" FLOAT32_IEEE LP_VCU020_AA_VCU_CM_single_Nm 0 0 -3.4E+38 3.4E+38 ECU_ADDRESS 0x0000 /* @ECU_Address@View_MotTrqReqWithSUC@ */ /end MEASUREMENT
/begin MEASUREMENT View_MotTrqReqSUCnoadd "" FLOAT32_IEEE LP_VCU020_AA_VCU_CM_single_Nm 0 0 -3.4E+38 3.4E+38 ECU_ADDRESS 0x0000 /* @ECU_Address@View_MotTrqReqSUCnoadd@ */ /end MEASUREMENT
/begin MEASUREMENT View_StartUpCtlTrqAdd "" FLOAT32_IEEE LP_VCU020_AA_VCU_CM_single_Nm 0 0 -3.4E+38 3.4E+38 ECU_ADDRESS 0x0000 /* @ECU_Address@View_StartUpCtlTrqAdd@ */ /end MEASUREMENT
/begin MEASUREMENT View_TrqDirectSwtDnRateLimit "" FLOAT32_IEEE LP_VCU020_AA_VCU_CM_single_Nm_s 0 0 -3.4E+38 3.4E+38 ECU_ADDRESS 0x0000 /* @ECU_Address@View_TrqDirectSwtDnRateLimit@ */ /end MEASUREMENT
/begin MEASUREMENT View_TrqDirectSwtUpRateLimit "" FLOAT32_IEEE LP_VCU020_AA_VCU_CM_single_Nm_s 0 0 -3.4E+38 3.4E+38 ECU_ADDRESS 0x0000 /* @ECU_Address@View_TrqDirectSwtUpRateLimit@ */ /end MEASUREMENT
/begin MEASUREMENT View_MotTrqReqWithStCtl "" FLOAT32_IEEE LP_VCU020_AA_VCU_CM_single_Nm 0 0 -3.4E+38 3.4E+38 ECU_ADDRESS 0x0000 /* @ECU_Address@View_MotTrqReqWithStCtl@ */ /end MEASUREMENT
/begin MEASUREMENT View_WheelTrqLPFKd "" FLOAT32_IEEE LP_VCU020_AA_VCU_CM_single 0 0 -3.4E+38 3.4E+38 ECU_ADDRESS 0x0000 /* @ECU_Address@View_WheelTrqLPFKd@ */ /end MEASUREMENT
/begin MEASUREMENT View_WheelTrqReqRateLimit "" FLOAT32_IEEE LP_VCU020_AA_VCU_CM_single_Nm 0 0 -3.4E+38 3.4E+38 ECU_ADDRESS 0x0000 /* @ECU_Address@View_WheelTrqReqRateLimit@ */ /end MEASUREMENT
/begin MEASUREMENT View_WheelTrqReqWithMSL "" FLOAT32_IEEE LP_VCU020_AA_VCU_CM_single_Nm 0 0 -3.4E+38 3.4E+38 ECU_ADDRESS 0x0000 /* @ECU_Address@View_WheelTrqReqWithMSL@ */ /end MEASUREMENT
/begin MEASUREMENT View_SpdLimitWheelTrqReq "" FLOAT32_IEEE LP_VCU020_AA_VCU_CM_single_Nm 0 0 -3.4E+38 3.4E+38 ECU_ADDRESS 0x0000 /* @ECU_Address@View_SpdLimitWheelTrqReq@ */ /end MEASUREMENT
/begin MEASUREMENT View_WheelTrqReqWithHDC "" FLOAT32_IEEE LP_VCU020_AA_VCU_CM_single_Nm 0 0 -3.4E+38 3.4E+38 ECU_ADDRESS 0x0000 /* @ECU_Address@View_WheelTrqReqWithHDC@ */ /end MEASUREMENT
/begin MEASUREMENT View_HDCWheelTrqReq "" FLOAT32_IEEE LP_VCU020_AA_VCU_CM_single_Nm 0 0 -3.4E+38 3.4E+38 ECU_ADDRESS 0x0000 /* @ECU_Address@View_HDCWheelTrqReq@ */ /end MEASUREMENT
/begin MEASUREMENT View_WheelTrqReqWithHAC "" FLOAT32_IEEE LP_VCU020_AA_VCU_CM_single_Nm 0 0 -3.4E+38 3.4E+38 ECU_ADDRESS 0x0000 /* @ECU_Address@View_WheelTrqReqWithHAC@ */ /end MEASUREMENT
/begin MEASUREMENT View_WheelTrqReqWithCreepCtl "" FLOAT32_IEEE LP_VCU020_AA_VCU_CM_single_Nm 0 0 -3.4E+38 3.4E+38 ECU_ADDRESS 0x0000 /* @ECU_Address@View_WheelTrqReqWithCreepCtl@ */ /end MEASUREMENT
/begin MEASUREMENT View_HACCtlWheelTrqReq "" FLOAT32_IEEE LP_VCU020_AA_VCU_CM_single_Nm 0 0 -3.4E+38 3.4E+38 ECU_ADDRESS 0x0000 /* @ECU_Address@View_HACCtlWheelTrqReq@ */ /end MEASUREMENT
/begin MEASUREMENT View_ReferVehAccn "" FLOAT32_IEEE LP_VCU020_AA_VCU_CM_single_m_s2 0 0 -3.4E+38 3.4E+38 ECU_ADDRESS 0x0000 /* @ECU_Address@View_ReferVehAccn@ */ /end MEASUREMENT
/begin MEASUREMENT View_DriverWheelTrqReq "" FLOAT32_IEEE LP_VCU020_AA_VCU_CM_single_Nm 0 0 -3.4E+38 3.4E+38 ECU_ADDRESS 0x0000 /* @ECU_Address@View_DriverWheelTrqReq@ */ /end MEASUREMENT
/begin MEASUREMENT View_WheelMaxRecTrq "" FLOAT32_IEEE LP_VCU020_AA_VCU_CM_single_Nm 0 0 -3.4E+38 3.4E+38 ECU_ADDRESS 0x0000 /* @ECU_Address@View_WheelMaxRecTrq@ */ /end MEASUREMENT
/begin MEASUREMENT View_MotMaxRecPwr "" FLOAT32_IEEE LP_VCU020_AA_VCU_CM_single_kw 0 0 -3.4E+38 3.4E+38 ECU_ADDRESS 0x0000 /* @ECU_Address@View_MotMaxRecPwr@ */ /end MEASUREMENT
/begin MEASUREMENT View_MaxRecPwr_CloseLoop "" FLOAT32_IEEE LP_VCU020_AA_VCU_CM_single_kw 0 0 -3.4E+38 3.4E+38 ECU_ADDRESS 0x0000 /* @ECU_Address@View_MaxRecPwr_CloseLoop@ */ /end MEASUREMENT
/begin MEASUREMENT View_Test40 "" FLOAT32_IEEE LP_VCU020_AA_VCU_CM_single_Nm 0 0 -3.4E+38 3.4E+38 ECU_ADDRESS 0x0000 /* @ECU_Address@View_Test40@ */ /end MEASUREMENT
/begin MEASUREMENT View_Test30 "" FLOAT32_IEEE LP_VCU020_AA_VCU_CM_single_Nm 0 0 -3.4E+38 3.4E+38 ECU_ADDRESS 0x0000 /* @ECU_Address@View_Test30@ */ /end MEASUREMENT
/begin MEASUREMENT View_WheelMaxDrvTrq "" FLOAT32_IEEE LP_VCU020_AA_VCU_CM_single_Nm 0 0 -3.4E+38 3.4E+38 ECU_ADDRESS 0x0000 /* @ECU_Address@View_WheelMaxDrvTrq@ */ /end MEASUREMENT
/begin MEASUREMENT View_MotMaxDrvPwr "" FLOAT32_IEEE LP_VCU020_AA_VCU_CM_single_kw 0 0 -3.4E+38 3.4E+38 ECU_ADDRESS 0x0000 /* @ECU_Address@View_MotMaxDrvPwr@ */ /end MEASUREMENT
/begin MEASUREMENT View_MaxDischgPwr_CloseLoop "" FLOAT32_IEEE LP_VCU020_AA_VCU_CM_single_kw 0 0 -3.4E+38 3.4E+38 ECU_ADDRESS 0x0000 /* @ECU_Address@View_MaxDischgPwr_CloseLoop@ */ /end MEASUREMENT
/begin MEASUREMENT View_MotRpmFilt "" FLOAT32_IEEE LP_VCU020_AA_VCU_CM_single_rpm 0 0 -3.4E+38 3.4E+38 ECU_ADDRESS 0x0000 /* @ECU_Address@View_MotRpmFilt@ */ /end MEASUREMENT
/begin MEASUREMENT View_Test20 "" FLOAT32_IEEE LP_VCU020_AA_VCU_CM_single_Nm 0 0 -3.4E+38 3.4E+38 ECU_ADDRESS 0x0000 /* @ECU_Address@View_Test20@ */ /end MEASUREMENT
/begin MEASUREMENT View_Test10 "" FLOAT32_IEEE LP_VCU020_AA_VCU_CM_single_Nm 0 0 -3.4E+38 3.4E+38 ECU_ADDRESS 0x0000 /* @ECU_Address@View_Test10@ */ /end MEASUREMENT
/begin MEASUREMENT View_VehSpdFilt "" FLOAT32_IEEE LP_VCU020_AA_VCU_CM_single_kph 0 0 -3.4E+38 3.4E+38 ECU_ADDRESS 0x0000 /* @ECU_Address@View_VehSpdFilt@ */ /end MEASUREMENT
/begin MEASUREMENT View_WheelRadius "" FLOAT32_IEEE LP_VCU020_AA_VCU_CM_single 0 0 -3.4E+38 3.4E+38 ECU_ADDRESS 0x0000 /* @ECU_Address@View_WheelRadius@ */ /end MEASUREMENT
/begin MEASUREMENT View_FrontWheelSpdFilt "" FLOAT32_IEEE LP_VCU020_AA_VCU_CM_single_kph 0 0 -3.4E+38 3.4E+38 ECU_ADDRESS 0x0000 /* @ECU_Address@View_FrontWheelSpdFilt@ */ /end MEASUREMENT
/begin MEASUREMENT View_RearWheelSpdFilt "" FLOAT32_IEEE LP_VCU020_AA_VCU_CM_single_kph 0 0 -3.4E+38 3.4E+38 ECU_ADDRESS 0x0000 /* @ECU_Address@View_RearWheelSpdFilt@ */ /end MEASUREMENT
/begin MEASUREMENT View_GearRatio "" FLOAT32_IEEE LP_VCU020_AA_VCU_CM_single 0 0 -3.4E+38 3.4E+38 ECU_ADDRESS 0x0000 /* @ECU_Address@View_GearRatio@ */ /end MEASUREMENT
/begin MEASUREMENT View_CreepCtlWheelTrqReq "" FLOAT32_IEEE LP_VCU020_AA_VCU_CM_single_Nm 0 0 -3.4E+38 3.4E+38 ECU_ADDRESS 0x0000 /* @ECU_Address@View_CreepCtlWheelTrqReq@ */ /end MEASUREMENT
/begin MEASUREMENT View_CCSWheelTrqReq "" FLOAT32_IEEE LP_VCU020_AA_VCU_CM_single_Nm 0 0 -3.4E+38 3.4E+38 ECU_ADDRESS 0x0000 /* @ECU_Address@View_CCSWheelTrqReq@ */ /end MEASUREMENT
/begin MEASUREMENT View_CCSWheelTrqReqBySpd "" FLOAT32_IEEE LP_VCU020_AA_VCU_CM_single_Nm 0 0 -3.4E+38 3.4E+38 ECU_ADDRESS 0x0000 /* @ECU_Address@View_CCSWheelTrqReqBySpd@ */ /end MEASUREMENT
/begin MEASUREMENT View_CCSWheelTrqReqByAccn "" FLOAT32_IEEE LP_VCU020_AA_VCU_CM_single_Nm 0 0 -3.4E+38 3.4E+38 ECU_ADDRESS 0x0000 /* @ECU_Address@View_CCSWheelTrqReqByAccn@ */ /end MEASUREMENT
/begin MEASUREMENT View_CuriseOutTargetSpd "" FLOAT32_IEEE LP_VCU020_AA_VCU_CM_single_kph 0 0 -3.4E+38 3.4E+38 ECU_ADDRESS 0x0000 /* @ECU_Address@View_CuriseOutTargetSpd@ */ /end MEASUREMENT
/begin MEASUREMENT View_CruiseTargetSpd "" FLOAT32_IEEE LP_VCU020_AA_VCU_CM_single_kph 0 0 -3.4E+38 3.4E+38 ECU_ADDRESS 0x0000 /* @ECU_Address@View_CruiseTargetSpd@ */ /end MEASUREMENT
/begin MEASUREMENT View_APSWheelTrqReq "" FLOAT32_IEEE LP_VCU020_AA_VCU_CM_single_Nm 0 0 -3.4E+38 3.4E+38 ECU_ADDRESS 0x0000 /* @ECU_Address@View_APSWheelTrqReq@ */ /end MEASUREMENT
/begin MEASUREMENT View_ACCWheelTrqReq "" FLOAT32_IEEE LP_VCU020_AA_VCU_CM_single_Nm 0 0 -3.4E+38 3.4E+38 ECU_ADDRESS 0x0000 /* @ECU_Address@View_ACCWheelTrqReq@ */ /end MEASUREMENT
/begin MEASUREMENT View_ESCFuncActive "" UBYTE LP_VCU020_AA_VCU_CM_uint8 0 0 0 255 ECU_ADDRESS 0x0000 /* @ECU_Address@View_ESCFuncActive@ */ /end MEASUREMENT
/begin MEASUREMENT View_StartUpCtlMode "" UBYTE LP_VCU020_AA_VCU_CM_uint8 0 0 0 255 ECU_ADDRESS 0x0000 /* @ECU_Address@View_StartUpCtlMode@ */ /end MEASUREMENT
/begin MEASUREMENT View_AEBActiveSts "" UBYTE LP_VCU020_AA_VCU_CM_uint8 0 0 0 255 ECU_ADDRESS 0x0000 /* @ECU_Address@View_AEBActiveSts@ */ /end MEASUREMENT
/begin MEASUREMENT View_CDPActiveSts "" UBYTE LP_VCU020_AA_VCU_CM_uint8 0 0 0 255 ECU_ADDRESS 0x0000 /* @ECU_Address@View_CDPActiveSts@ */ /end MEASUREMENT
/begin MEASUREMENT View_TCSActiveSts "" UBYTE LP_VCU020_AA_VCU_CM_uint8 0 0 0 255 ECU_ADDRESS 0x0000 /* @ECU_Address@View_TCSActiveSts@ */ /end MEASUREMENT
/begin MEASUREMENT View_ABSActiveSts "" UBYTE LP_VCU020_AA_VCU_CM_uint8 0 0 0 255 ECU_ADDRESS 0x0000 /* @ECU_Address@View_ABSActiveSts@ */ /end MEASUREMENT
/begin MEASUREMENT View_MaxSpdLimitActiveSt "" UBYTE LP_VCU020_AA_VCU_CM_uint8 0 0 0 255 ECU_ADDRESS 0x0000 /* @ECU_Address@View_MaxSpdLimitActiveSt@ */ /end MEASUREMENT
/begin MEASUREMENT View_HDCActiveSts "" UBYTE LP_VCU020_AA_VCU_CM_uint8 0 0 0 255 ECU_ADDRESS 0x0000 /* @ECU_Address@View_HDCActiveSts@ */ /end MEASUREMENT
/begin MEASUREMENT View_HACInActiveReq "" UBYTE LP_VCU020_AA_VCU_CM_uint8 0 0 0 255 ECU_ADDRESS 0x0000 /* @ECU_Address@View_HACInActiveReq@ */ /end MEASUREMENT
/begin MEASUREMENT View_HACJudgeReq "" UBYTE LP_VCU020_AA_VCU_CM_uint8 0 0 0 255 ECU_ADDRESS 0x0000 /* @ECU_Address@View_HACJudgeReq@ */ /end MEASUREMENT
/begin MEASUREMENT View_HACActiveSts "" UBYTE LP_VCU020_AA_VCU_CM_uint8 0 0 0 255 ECU_ADDRESS 0x0000 /* @ECU_Address@View_HACActiveSts@ */ /end MEASUREMENT
/begin MEASUREMENT View_HACStsType "" UBYTE LP_VCU020_AA_VCU_CM_uint8 0 0 0 255 ECU_ADDRESS 0x0000 /* @ECU_Address@View_HACStsType@ */ /end MEASUREMENT
/begin MEASUREMENT View_CreepActiveSt "" UBYTE LP_VCU020_AA_VCU_CM_uint8 0 0 0 255 ECU_ADDRESS 0x0000 /* @ECU_Address@View_CreepActiveSt@ */ /end MEASUREMENT
/begin MEASUREMENT View_APSActiveSt "" UBYTE LP_VCU020_AA_VCU_CM_uint8 0 0 0 255 ECU_ADDRESS 0x0000 /* @ECU_Address@View_APSActiveSt@ */ /end MEASUREMENT
/begin MEASUREMENT View_RecType "" UBYTE LP_VCU020_AA_VCU_CM_uint8 0 0 0 255 ECU_ADDRESS 0x0000 /* @ECU_Address@View_RecType@ */ /end MEASUREMENT
/begin MEASUREMENT View_DecnModeGearR "" UBYTE LP_VCU020_AA_VCU_CM_uint8 0 0 0 255 ECU_ADDRESS 0x0000 /* @ECU_Address@View_DecnModeGearR@ */ /end MEASUREMENT
/begin MEASUREMENT View_DecnModeGearD "" UBYTE LP_VCU020_AA_VCU_CM_uint8 0 0 0 255 ECU_ADDRESS 0x0000 /* @ECU_Address@View_DecnModeGearD@ */ /end MEASUREMENT
/begin MEASUREMENT View_DrvType "" UBYTE LP_VCU020_AA_VCU_CM_uint8 0 0 0 255 ECU_ADDRESS 0x0000 /* @ECU_Address@View_DrvType@ */ /end MEASUREMENT
/begin MEASUREMENT View_AccnModeGearR "" UBYTE LP_VCU020_AA_VCU_CM_uint8 0 0 0 255 ECU_ADDRESS 0x0000 /* @ECU_Address@View_AccnModeGearR@ */ /end MEASUREMENT
/begin MEASUREMENT View_AccnModeGearD "" UBYTE LP_VCU020_AA_VCU_CM_uint8 0 0 0 255 ECU_ADDRESS 0x0000 /* @ECU_Address@View_AccnModeGearD@ */ /end MEASUREMENT
/begin MEASUREMENT View_ZeroSpdSt "" UBYTE LP_VCU020_AA_VCU_CM_uint8 0 0 0 255 ECU_ADDRESS 0x0000 /* @ECU_Address@View_ZeroSpdSt@ */ /end MEASUREMENT
/begin MEASUREMENT View_VehSpdFiltVD "" UBYTE LP_VCU020_AA_VCU_CM_uint8 0 0 0 255 ECU_ADDRESS 0x0000 /* @ECU_Address@View_VehSpdFiltVD@ */ /end MEASUREMENT
/begin MEASUREMENT View_FrontWheelSpdVD "" UBYTE LP_VCU020_AA_VCU_CM_uint8 0 0 0 255 ECU_ADDRESS 0x0000 /* @ECU_Address@View_FrontWheelSpdVD@ */ /end MEASUREMENT
/begin MEASUREMENT View_RearWheelSpdVD "" UBYTE LP_VCU020_AA_VCU_CM_uint8 0 0 0 255 ECU_ADDRESS 0x0000 /* @ECU_Address@View_RearWheelSpdVD@ */ /end MEASUREMENT
/begin MEASUREMENT View_ESPActiveSts "" UBYTE LP_VCU020_AA_VCU_CM_uint8 0 0 0 255 ECU_ADDRESS 0x0000 /* @ECU_Address@View_ESPActiveSts@ */ /end MEASUREMENT
/begin MEASUREMENT View_EolCfgESC "" UBYTE LP_VCU020_AA_VCU_CM_uint8 0 0 0 255 ECU_ADDRESS 0x0000 /* @ECU_Address@View_EolCfgESC@ */ /end MEASUREMENT
/begin MEASUREMENT View_EolCfgABS "" UBYTE LP_VCU020_AA_VCU_CM_uint8 0 0 0 255 ECU_ADDRESS 0x0000 /* @ECU_Address@View_EolCfgABS@ */ /end MEASUREMENT
/begin MEASUREMENT View_EolCfgAPS "" UBYTE LP_VCU020_AA_VCU_CM_uint8 0 0 0 255 ECU_ADDRESS 0x0000 /* @ECU_Address@View_EolCfgAPS@ */ /end MEASUREMENT
/begin MEASUREMENT View_EolCfgCCS "" UBYTE LP_VCU020_AA_VCU_CM_uint8 0 0 0 255 ECU_ADDRESS 0x0000 /* @ECU_Address@View_EolCfgCCS@ */ /end MEASUREMENT
/begin MEASUREMENT View_EolCfgACC "" UBYTE LP_VCU020_AA_VCU_CM_uint8 0 0 0 255 ECU_ADDRESS 0x0000 /* @ECU_Address@View_EolCfgACC@ */ /end MEASUREMENT
/begin MEASUREMENT View_EolCfgAEB "" UBYTE LP_VCU020_AA_VCU_CM_uint8 0 0 0 255 ECU_ADDRESS 0x0000 /* @ECU_Address@View_EolCfgAEB@ */ /end MEASUREMENT
/begin MEASUREMENT View_EolCfgEPB "" UBYTE LP_VCU020_AA_VCU_CM_uint8 0 0 0 255 ECU_ADDRESS 0x0000 /* @ECU_Address@View_EolCfgEPB@ */ /end MEASUREMENT
/begin MEASUREMENT View_EolCfgSlipRec "" UBYTE LP_VCU020_AA_VCU_CM_uint8 0 0 0 255 ECU_ADDRESS 0x0000 /* @ECU_Address@View_EolCfgSlipRec@ */ /end MEASUREMENT
/begin MEASUREMENT View_EolCfgBrkRec "" UBYTE LP_VCU020_AA_VCU_CM_uint8 0 0 0 255 ECU_ADDRESS 0x0000 /* @ECU_Address@View_EolCfgBrkRec@ */ /end MEASUREMENT
/begin COMPU_METHOD LP_VCU020_AA_VCU_CM_single_Pct_s "Q = V" RAT_FUNC "%8.6" "Pct/s" COEFFS 0 1 0 0 0 1 /end COMPU_METHOD
/begin COMPU_METHOD LP_VCU020_AA_VCU_CM_single_kph "Q = V" RAT_FUNC "%8.6" "kph" COEFFS 0 1 0 0 0 1 /end COMPU_METHOD
/begin COMPU_METHOD LP_VCU020_AA_VCU_CM_single "Q = V" RAT_FUNC "%8.6" "" COEFFS 0 1 0 0 0 1 /end COMPU_METHOD
/begin COMPU_METHOD LP_VCU020_AA_VCU_CM_single_pct "Q = V" RAT_FUNC "%8.6" "pct" COEFFS 0 1 0 0 0 1 /end COMPU_METHOD
/begin COMPU_METHOD LP_VCU020_AA_VCU_CM_single_Nm "Q = V" RAT_FUNC "%8.6" "Nm" COEFFS 0 1 0 0 0 1 /end COMPU_METHOD
/begin COMPU_METHOD LP_VCU020_AA_VCU_CM_single_Nm_s "Q = V" RAT_FUNC "%8.6" "Nm/s" COEFFS 0 1 0 0 0 1 /end COMPU_METHOD
/begin COMPU_METHOD LP_VCU020_AA_VCU_CM_single_s "Q = V" RAT_FUNC "%8.6" "s" COEFFS 0 1 0 0 0 1 /end COMPU_METHOD
/begin COMPU_METHOD LP_VCU020_AA_VCU_CM_single_rpm "Q = V" RAT_FUNC "%8.6" "rpm" COEFFS 0 1 0 0 0 1 /end COMPU_METHOD
/begin COMPU_METHOD LP_VCU020_AA_VCU_CM_single_kw "Q = V" RAT_FUNC "%8.6" "kw" COEFFS 0 1 0 0 0 1 /end COMPU_METHOD
/begin COMPU_METHOD LP_VCU020_AA_VCU_CM_single_kPa "Q = V" RAT_FUNC "%8.6" "kPa" COEFFS 0 1 0 0 0 1 /end COMPU_METHOD
/begin COMPU_METHOD LP_VCU020_AA_VCU_CM_single_sec "Q = V" RAT_FUNC "%8.6" "sec" COEFFS 0 1 0 0 0 1 /end COMPU_METHOD
/begin COMPU_METHOD LP_VCU020_AA_VCU_CM_single_m_s2 "Q = V" RAT_FUNC "%8.6" "m/s2" COEFFS 0 1 0 0 0 1 /end COMPU_METHOD
/begin COMPU_METHOD LP_VCU020_AA_VCU_CM_single_kw_s "Q = V" RAT_FUNC "%8.6" "kw/s" COEFFS 0 1 0 0 0 1 /end COMPU_METHOD
/begin COMPU_METHOD LP_VCU020_AA_VCU_CM_uint16 "Q = V" RAT_FUNC "%5.0" "" COEFFS 0 1 0 0 0 1 /end COMPU_METHOD
/begin COMPU_METHOD LP_VCU020_AA_VCU_CM_uint16_msec "Q = V" RAT_FUNC "%5.0" "msec" COEFFS 0 1 0 0 0 1 /end COMPU_METHOD
/begin COMPU_METHOD LP_VCU020_AA_VCU_CM_uint8 "Q = V" RAT_FUNC "%3.0" "" COEFFS 0 1 0 0 0 1 /end COMPU_METHOD
/begin COMPU_METHOD LP_VCU020_AA_VCU_CM_uint8_kph "Q = V" RAT_FUNC "%3.0" "kph" COEFFS 0 1 0 0 0 1 /end COMPU_METHOD
/begin COMPU_METHOD LP_VCU020_AA_VCU_CM_uint8_ms "Q = V" RAT_FUNC "%3.0" "ms" COEFFS 0 1 0 0 0 1 /end COMPU_METHOD
/begin COMPU_METHOD LP_VCU020_AA_VCU_CM_boolean "Q = V" RAT_FUNC "%1.0" "" COEFFS 0 1 0 0 0 1 /end COMPU_METHOD
/begin GROUP LP_VCU020_AA_VCU "LP_VCU020_AA_VCU" /* Root */ ROOT /begin SUB_GROUP Root_SWC /end SUB_GROUP /end GROUP
/begin GROUP Root_SWC "LP_VCU020_AA_VCU/SWC"
 /begin SUB_GROUP S4_AC_accessControl S4_DTR_drvrTorqueReq S4_SPY_SignalPreSys /end SUB_GROUP
/end GROUP
/begin GROUP S4_AC_accessControl "LP_VCU020_AA_VCU/SWC/AC_accessControl" /begin SUB_GROUP S1402_EvbCtrl /end SUB_GROUP /end GROUP
/begin GROUP S4_DTR_drvrTorqueReq "LP_VCU020_AA_VCU/SWC/DTR_drvrTorqueReq" /begin SUB_GROUP S1403_DrvCtrl S1403_GearCtrl /end SUB_GROUP /end GROUP
/begin GROUP S4_SPY_SignalPreSys "LP_VCU020_AA_VCU/SWC/SPY_SignalPreSys" /begin SUB_GROUP S1405_TempSensor S1405_ThrPed /end SUB_GROUP /end GROUP
/begin GROUP S1402_EvbCtrl "LP_VCU020_AA_VCU/SWC/AC_accessControl/EvbCtrl" /begin SUB_GROUP S1410_EvbCtrl /end SUB_GROUP /end GROUP
/begin GROUP S1403_DrvCtrl "LP_VCU020_AA_VCU/SWC/DTR_drvrTorqueReq/DrvCtrl" /begin SUB_GROUP S1699_DriveCtl /end SUB_GROUP /end GROUP
/begin GROUP S1403_GearCtrl "LP_VCU020_AA_VCU/SWC/DTR_drvrTorqueReq/GearCtrl" /begin SUB_GROUP S1700_GearCtrl /end SUB_GROUP /end GROUP
/begin GROUP S1405_TempSensor "LP_VCU020_AA_VCU/SWC/SPY_SignalPreSys/TempSensor" /begin SUB_GROUP S2846_TempSensor /end SUB_GROUP /end GROUP
/begin GROUP S1405_ThrPed "LP_VCU020_AA_VCU/SWC/SPY_SignalPreSys/ThrPed" /begin SUB_GROUP S2847_AccPed /end SUB_GROUP /end GROUP
/begin GROUP S1410_EvbCtrl "LP_VCU020_AA_VCU/SWC/AC_accessControl/EvbCtrl/EvbCtrl" /begin SUB_GROUP S1459_VacParamCalculate /end SUB_GROUP
 /begin REF_CHARACTERISTIC Cal_Evb_AtmosphericPressure_kPa Cal_Evb_SafeModeWorkTime_sec /end REF_CHARACTERISTIC
/end GROUP
/begin GROUP S1699_DriveCtl "LP_VCU020_AA_VCU/SWC/DTR_drvrTorqueReq/DrvCtrl/DriveCtl" /begin SUB_GROUP S1701_Control S1701_DataAssign /end SUB_GROUP /end GROUP
/begin GROUP S1700_GearCtrl "LP_VCU020_AA_VCU/SWC/DTR_drvrTorqueReq/GearCtrl/GearCtrl" /begin REF_CHARACTERISTIC Cal_NShiftReqConfirmTime_msec Cal_VehiSpdDtoR_kph /end REF_CHARACTERISTIC /end GROUP
/begin GROUP S2846_TempSensor "LP_VCU020_AA_VCU/SWC/SPY_SignalPreSys/TempSensor/TempSensor"
 /begin SUB_GROUP S3011_AcChgVolt S3011_DcChgNVolt S3011_DcChgPVolt S3011_TempSensorPwrDCN_Dig S3011_TempSensorPwrDCP_Dig /end SUB_GROUP
/end GROUP
/begin GROUP S2847_AccPed "LP_VCU020_AA_VCU/SWC/SPY_SignalPreSys/ThrPed/AccPed"
 /begin SUB_GROUP S3162_AccPedHPwr_DigVolt S3162_AccPedHSig_DigVolt S3162_AccPedLPwr_DigVolt S3162_AccPedLSig_DigVoltL S3162_Acc_ThrPoison_Clc /end SUB_GROUP
/end GROUP
/begin GROUP S1459_VacParamCalculate "LP_VCU020_AA_VCU/SWC/AC_accessControl/EvbCtrl/EvbCtrl/VacParamCalculate"
 /begin REF_CHARACTERISTIC CalMap_Evb_VacuumOff CalMap_Evb_VacuumOn Cal_Evb_VehiSpdHighLowBoundary_kph /end REF_CHARACTERISTIC
/end GROUP
/begin GROUP S1701_Control "LP_VCU020_AA_VCU/SWC/DTR_drvrTorqueReq/DrvCtrl/DriveCtl/Control"
 /begin SUB_GROUP S1702_Drv01_DynamicCalc S1702_Drv02_VehiclePwrTrqLimit S1702_Drv03_DriverRequestAnalysis S1702_Drv04_AdditionalFunctionCtl S1702_Drv05_CreepCtl S1702_Drv06_HillstartAssistControl S1702_Drv07_HillDescentControl S1702_Drv08_MaxSpdLimit S1702_Drv09_TotWheelTrqRateLimit S1702_Drv10_OptimalTrqSplit S1702_Drv11_StabilityControl S1702_Drv12_StartUpControl S1702_Drv13_SingalAggregate /end SUB_GROUP
/end GROUP
/begin GROUP S1701_DataAssign "LP_VCU020_AA_VCU/SWC/DTR_drvrTorqueReq/DrvCtrl/DriveCtl/DataAssign" /begin SUB_GROUP S1703_CCS_Signal S1703_EolCfg_Signal /end SUB_GROUP /end GROUP
/begin GROUP S3011_AcChgVolt "LP_VCU020_AA_VCU/SWC/SPY_SignalPreSys/TempSensor/TempSensor/AcChgVolt" /begin SUB_GROUP S3012_AccPedHSig_DigVolt S3012_Subsystem /end SUB_GROUP /end GROUP
/begin GROUP S3011_DcChgNVolt "LP_VCU020_AA_VCU/SWC/SPY_SignalPreSys/TempSensor/TempSensor/DcChgNVolt" /begin SUB_GROUP S3014_AccPedHSig_DigVolt S3014_Subsystem /end SUB_GROUP /end GROUP
/begin GROUP S3011_DcChgPVolt "LP_VCU020_AA_VCU/SWC/SPY_SignalPreSys/TempSensor/TempSensor/DcChgPVolt" /begin SUB_GROUP S3015_AccPedHSig_DigVolt S3015_Subsystem /end SUB_GROUP /end GROUP
/begin GROUP S3011_TempSensorPwrDCN_Dig "LP_VCU020_AA_VCU/SWC/SPY_SignalPreSys/TempSensor/TempSensor/TempSensorPwrDCN_Dig"
 /begin SUB_GROUP S3017_delay_cond1 S3017_delay_cond6 S3017_delay_cond7 S3017_delay_cond8 /end SUB_GROUP
/end GROUP
/begin GROUP S3011_TempSensorPwrDCP_Dig "LP_VCU020_AA_VCU/SWC/SPY_SignalPreSys/TempSensor/TempSensor/TempSensorPwrDCP_Dig"
 /begin SUB_GROUP S3018_delay_cond1 S3018_delay_cond6 S3018_delay_cond7 S3018_delay_cond8 /end SUB_GROUP
/end GROUP
/begin GROUP S3162_AccPedHPwr_DigVolt "LP_VCU020_AA_VCU/SWC/SPY_SignalPreSys/ThrPed/AccPed/AccPedHPwr_DigVolt"
 /begin SUB_GROUP S3163_delay_cond1 S3163_delay_cond2 S3163_delay_cond6 S3163_delay_cond7 S3163_delay_cond8 /end SUB_GROUP
/end GROUP
/begin GROUP S3162_AccPedHSig_DigVolt "LP_VCU020_AA_VCU/SWC/SPY_SignalPreSys/ThrPed/AccPed/AccPedHSig_DigVolt"
 /begin SUB_GROUP S3164_DCT_AccPedHSig_Sts S3164_DTC_AccPedHSig_OV S3164_DTC_AccPedHSig_STB S3164_DTC_AccPedHSig_STSTGorCO S3164_DTC_AccPedHSig_UV /end SUB_GROUP
/end GROUP
/begin GROUP S3162_AccPedLPwr_DigVolt "LP_VCU020_AA_VCU/SWC/SPY_SignalPreSys/ThrPed/AccPed/AccPedLPwr_DigVolt"
 /begin SUB_GROUP S3166_delay_cond1 S3166_delay_cond2 S3166_delay_cond6 S3166_delay_cond7 S3166_delay_cond8 /end SUB_GROUP
/end GROUP
/begin GROUP S3162_AccPedLSig_DigVoltL "LP_VCU020_AA_VCU/SWC/SPY_SignalPreSys/ThrPed/AccPed/AccPedLSig_DigVoltL"
 /begin SUB_GROUP S3167_DCT_AccPedLSig_Sts S3167_DTC_AccPedLSig_OV S3167_DTC_AccPedLSig_STB S3167_DTC_AccPedLSig_STSTGorCO S3167_DTC_AccPedLSig_UV /end SUB_GROUP
/end GROUP
/begin GROUP S3162_Acc_ThrPoison_Clc "LP_VCU020_AA_VCU/SWC/SPY_SignalPreSys/ThrPed/AccPed/Acc_ThrPoison_Clc" /begin SUB_GROUP S3169_delay_cond2 /end SUB_GROUP /end GROUP
/begin GROUP S1702_Drv01_DynamicCalc "LP_VCU020_AA_VCU/SWC/DTR_drvrTorqueReq/DrvCtrl/DriveCtl/Control/Drv01_DynamicCalc" /begin SUB_GROUP S1705_DynamicCalc /end SUB_GROUP /end GROUP
/begin GROUP S1702_Drv02_VehiclePwrTrqLimit "LP_VCU020_AA_VCU/SWC/DTR_drvrTorqueReq/DrvCtrl/DriveCtl/Control/Drv02_VehiclePwrTrqLimit" /begin SUB_GROUP S1706_VehiclePwrTrqLimit /end SUB_GROUP /end GROUP
/begin GROUP S1702_Drv03_DriverRequestAnalysis "LP_VCU020_AA_VCU/SWC/DTR_drvrTorqueReq/DrvCtrl/DriveCtl/Control/Drv03_DriverRequestAnalysis" /begin SUB_GROUP S1707_DriverRequestAnalysis /end SUB_GROUP /end GROUP
/begin GROUP S1702_Drv04_AdditionalFunctionCtl "LP_VCU020_AA_VCU/SWC/DTR_drvrTorqueReq/DrvCtrl/DriveCtl/Control/Drv04_AdditionalFunctionCtl" /begin SUB_GROUP S1708_AdditionalFunctionCtl /end SUB_GROUP /end GROUP
/begin GROUP S1702_Drv05_CreepCtl "LP_VCU020_AA_VCU/SWC/DTR_drvrTorqueReq/DrvCtrl/DriveCtl/Control/Drv05_CreepCtl" /begin SUB_GROUP S1709_CreepCtl /end SUB_GROUP /end GROUP
/begin GROUP S1702_Drv06_HillstartAssistControl "LP_VCU020_AA_VCU/SWC/DTR_drvrTorqueReq/DrvCtrl/DriveCtl/Control/Drv06_HillstartAssistControl" /begin SUB_GROUP S1710_HillstartAssistControl /end SUB_GROUP /end GROUP
/begin GROUP S1702_Drv07_HillDescentControl "LP_VCU020_AA_VCU/SWC/DTR_drvrTorqueReq/DrvCtrl/DriveCtl/Control/Drv07_HillDescentControl" /begin SUB_GROUP S1711_HillDescentControl /end SUB_GROUP /end GROUP
/begin GROUP S1702_Drv08_MaxSpdLimit "LP_VCU020_AA_VCU/SWC/DTR_drvrTorqueReq/DrvCtrl/DriveCtl/Control/Drv08_MaxSpdLimit" /begin SUB_GROUP S1712_MaxSpdLimit /end SUB_GROUP /end GROUP
/begin GROUP S1702_Drv09_TotWheelTrqRateLimit "LP_VCU020_AA_VCU/SWC/DTR_drvrTorqueReq/DrvCtrl/DriveCtl/Control/Drv09_TotWheelTrqRateLimit" /begin SUB_GROUP S1713_TotWheelTrqRateLimit /end SUB_GROUP /end GROUP
/begin GROUP S1702_Drv10_OptimalTrqSplit "LP_VCU020_AA_VCU/SWC/DTR_drvrTorqueReq/DrvCtrl/DriveCtl/Control/Drv10_OptimalTrqSplit" /begin SUB_GROUP S1714_OptimalTrqSplit /end SUB_GROUP /end GROUP
/begin GROUP S1702_Drv11_StabilityControl "LP_VCU020_AA_VCU/SWC/DTR_drvrTorqueReq/DrvCtrl/DriveCtl/Control/Drv11_StabilityControl" /begin SUB_GROUP S1715_StabilityControl /end SUB_GROUP /end GROUP
/begin GROUP S1702_Drv12_StartUpControl "LP_VCU020_AA_VCU/SWC/DTR_drvrTorqueReq/DrvCtrl/DriveCtl/Control/Drv12_StartUpControl" /begin SUB_GROUP S1716_StartUpControl /end SUB_GROUP /end GROUP
/begin GROUP S1702_Drv13_SingalAggregate "LP_VCU020_AA_VCU/SWC/DTR_drvrTorqueReq/DrvCtrl/DriveCtl/Control/Drv13_SingalAggregate" /begin SUB_GROUP S1717_SingalAggregate /end SUB_GROUP /end GROUP
/begin GROUP S1703_CCS_Signal "LP_VCU020_AA_VCU/SWC/DTR_drvrTorqueReq/DrvCtrl/DriveCtl/DataAssign/CCS_Signal" /begin REF_CHARACTERISTIC CFG_CCSFuncSt CFG_CCSVehSpdCtl Test_CCSModeDebug /end REF_CHARACTERISTIC /end GROUP
/begin GROUP S1703_EolCfg_Signal "LP_VCU020_AA_VCU/SWC/DTR_drvrTorqueReq/DrvCtrl/DriveCtl/DataAssign/EolCfg_Signal"
 /begin REF_MEASUREMENT View_EolCfgABS View_EolCfgACC View_EolCfgAEB View_EolCfgAPS View_EolCfgBrkRec View_EolCfgCCS View_EolCfgEPB View_EolCfgESC View_EolCfgSlipRec View_GearRatio View_WheelRadius /end REF_MEASUREMENT
/end GROUP
/begin GROUP S3012_AccPedHSig_DigVolt "LP_VCU020_AA_VCU/SWC/SPY_SignalPreSys/TempSensor/TempSensor/AcChgVolt/AccPedHSig_DigVolt"
 /begin SUB_GROUP S3019_DTC_AccPedHSig_OV S3019_DTC_AccPedHSig_STB S3019_DTC_AccPedHSig_STG /end SUB_GROUP
/end GROUP
/begin GROUP S3012_Subsystem "LP_VCU020_AA_VCU/SWC/SPY_SignalPreSys/TempSensor/TempSensor/AcChgVolt/Subsystem" /begin SUB_GROUP S3027_Subsystem2 /end SUB_GROUP /end GROUP
/begin GROUP S3014_AccPedHSig_DigVolt "LP_VCU020_AA_VCU/SWC/SPY_SignalPreSys/TempSensor/TempSensor/DcChgNVolt/AccPedHSig_DigVolt"
 /begin SUB_GROUP S3062_DTC_AccPedHSig_OV S3062_DTC_AccPedHSig_STB S3062_DTC_AccPedHSig_STG /end SUB_GROUP
/end GROUP
/begin GROUP S3014_Subsystem "LP_VCU020_AA_VCU/SWC/SPY_SignalPreSys/TempSensor/TempSensor/DcChgNVolt/Subsystem" /begin SUB_GROUP S3070_Subsystem2 /end SUB_GROUP /end GROUP
/begin GROUP S3015_AccPedHSig_DigVolt "LP_VCU020_AA_VCU/SWC/SPY_SignalPreSys/TempSensor/TempSensor/DcChgPVolt/AccPedHSig_DigVolt"
 /begin SUB_GROUP S3105_DTC_AccPedHSig_OV S3105_DTC_AccPedHSig_STB S3105_DTC_AccPedHSig_STG /end SUB_GROUP
/end GROUP
/begin GROUP S3015_Subsystem "LP_VCU020_AA_VCU/SWC/SPY_SignalPreSys/TempSensor/TempSensor/DcChgPVolt/Subsystem" /begin SUB_GROUP S3113_Subsystem2 /end SUB_GROUP /end GROUP
/begin GROUP S3017_delay_cond1 "LP_VCU020_AA_VCU/SWC/SPY_SignalPreSys/TempSensor/TempSensor/TempSensorPwrDCN_Dig/delay_cond1" /begin REF_CHARACTERISTIC Cal_TempFaultStsCounter /end REF_CHARACTERISTIC /end GROUP
/begin GROUP S3017_delay_cond6 "LP_VCU020_AA_VCU/SWC/SPY_SignalPreSys/TempSensor/TempSensor/TempSensorPwrDCN_Dig/delay_cond6" /begin REF_CHARACTERISTIC Cal_TempFaultStsCounter /end REF_CHARACTERISTIC /end GROUP
/begin GROUP S3017_delay_cond7 "LP_VCU020_AA_VCU/SWC/SPY_SignalPreSys/TempSensor/TempSensor/TempSensorPwrDCN_Dig/delay_cond7" /begin REF_CHARACTERISTIC Cal_TempFaultStsCounter /end REF_CHARACTERISTIC /end GROUP
/begin GROUP S3017_delay_cond8 "LP_VCU020_AA_VCU/SWC/SPY_SignalPreSys/TempSensor/TempSensor/TempSensorPwrDCN_Dig/delay_cond8" /begin REF_CHARACTERISTIC Cal_TempFaultStsCounter /end REF_CHARACTERISTIC /end GROUP
/begin GROUP S3018_delay_cond1 "LP_VCU020_AA_VCU/SWC/SPY_SignalPreSys/TempSensor/TempSensor/TempSensorPwrDCP_Dig/delay_cond1" /begin REF_CHARACTERISTIC Cal_TempFaultStsCounter /end REF_CHARACTERISTIC /end GROUP
/begin GROUP S3018_delay_cond6 "LP_VCU020_AA_VCU/SWC/SPY_SignalPreSys/TempSensor/TempSensor/TempSensorPwrDCP_Dig/delay_cond6" /begin REF_CHARACTERISTIC Cal_TempFaultStsCounter /end REF_CHARACTERISTIC /end GROUP
/begin GROUP S3018_delay_cond7 "LP_VCU020_AA_VCU/SWC/SPY_SignalPreSys/TempSensor/TempSensor/TempSensorPwrDCP_Dig/delay_cond7" /begin REF_CHARACTERISTIC Cal_TempFaultStsCounter /end REF_CHARACTERISTIC /end GROUP
/begin GROUP S3018_delay_cond8 "LP_VCU020_AA_VCU/SWC/SPY_SignalPreSys/TempSensor/TempSensor/TempSensorPwrDCP_Dig/delay_cond8" /begin REF_CHARACTERISTIC Cal_TempFaultStsCounter /end REF_CHARACTERISTIC /end GROUP
/begin GROUP S3163_delay_cond1 "LP_VCU020_AA_VCU/SWC/SPY_SignalPreSys/ThrPed/AccPed/AccPedHPwr_DigVolt/delay_cond1" /begin REF_CHARACTERISTIC Cal_AccpedFaultStsCounter /end REF_CHARACTERISTIC /end GROUP
/begin GROUP S3163_delay_cond2 "LP_VCU020_AA_VCU/SWC/SPY_SignalPreSys/ThrPed/AccPed/AccPedHPwr_DigVolt/delay_cond2" /begin REF_CHARACTERISTIC Cal_AccpedFaultStsCounter /end REF_CHARACTERISTIC /end GROUP
/begin GROUP S3163_delay_cond6 "LP_VCU020_AA_VCU/SWC/SPY_SignalPreSys/ThrPed/AccPed/AccPedHPwr_DigVolt/delay_cond6" /begin REF_CHARACTERISTIC Cal_AccpedFaultStsCounter /end REF_CHARACTERISTIC /end GROUP
/begin GROUP S3163_delay_cond7 "LP_VCU020_AA_VCU/SWC/SPY_SignalPreSys/ThrPed/AccPed/AccPedHPwr_DigVolt/delay_cond7" /begin REF_CHARACTERISTIC Cal_AccpedFaultStsCounter /end REF_CHARACTERISTIC /end GROUP
/begin GROUP S3163_delay_cond8 "LP_VCU020_AA_VCU/SWC/SPY_SignalPreSys/ThrPed/AccPed/AccPedHPwr_DigVolt/delay_cond8" /begin REF_CHARACTERISTIC Cal_AccpedFaultStsCounter /end REF_CHARACTERISTIC /end GROUP
/begin GROUP S3164_DCT_AccPedHSig_Sts "LP_VCU020_AA_VCU/SWC/SPY_SignalPreSys/ThrPed/AccPed/AccPedHSig_DigVolt/DCT_AccPedHSig_Sts" /begin SUB_GROUP S3178_delay_cond9 /end SUB_GROUP /end GROUP
/begin GROUP S3164_DTC_AccPedHSig_OV "LP_VCU020_AA_VCU/SWC/SPY_SignalPreSys/ThrPed/AccPed/AccPedHSig_DigVolt/DTC_AccPedHSig_OV" /begin SUB_GROUP S3179_delay_cond2 S3179_delay_cond3 /end SUB_GROUP /end GROUP
/begin GROUP S3164_DTC_AccPedHSig_STB "LP_VCU020_AA_VCU/SWC/SPY_SignalPreSys/ThrPed/AccPed/AccPedHSig_DigVolt/DTC_AccPedHSig_STB" /begin SUB_GROUP S3180_delay_cond6 S3180_delay_cond7 /end SUB_GROUP /end GROUP
/begin GROUP S3164_DTC_AccPedHSig_STSTGorCO "LP_VCU020_AA_VCU/SWC/SPY_SignalPreSys/ThrPed/AccPed/AccPedHSig_DigVolt/DTC_AccPedHSig_STSTGorCO" /begin SUB_GROUP S3181_delay_cond1 S3181_delay_cond8 /end SUB_GROUP /end GROUP
/begin GROUP S3164_DTC_AccPedHSig_UV "LP_VCU020_AA_VCU/SWC/SPY_SignalPreSys/ThrPed/AccPed/AccPedHSig_DigVolt/DTC_AccPedHSig_UV" /begin SUB_GROUP S3182_delay_cond4 S3182_delay_cond5 /end SUB_GROUP /end GROUP
/begin GROUP S3166_delay_cond1 "LP_VCU020_AA_VCU/SWC/SPY_SignalPreSys/ThrPed/AccPed/AccPedLPwr_DigVolt/delay_cond1" /begin REF_CHARACTERISTIC Cal_AccpedFaultStsCounter /end REF_CHARACTERISTIC /end GROUP
/begin GROUP S3166_delay_cond2 "LP_VCU020_AA_VCU/SWC/SPY_SignalPreSys/ThrPed/AccPed/AccPedLPwr_DigVolt/delay_cond2" /begin REF_CHARACTERISTIC Cal_AccpedFaultStsCounter /end REF_CHARACTERISTIC /end GROUP
/begin GROUP S3166_delay_cond6 "LP_VCU020_AA_VCU/SWC/SPY_SignalPreSys/ThrPed/AccPed/AccPedLPwr_DigVolt/delay_cond6" /begin REF_CHARACTERISTIC Cal_AccpedFaultStsCounter /end REF_CHARACTERISTIC /end GROUP
/begin GROUP S3166_delay_cond7 "LP_VCU020_AA_VCU/SWC/SPY_SignalPreSys/ThrPed/AccPed/AccPedLPwr_DigVolt/delay_cond7" /begin REF_CHARACTERISTIC Cal_AccpedFaultStsCounter /end REF_CHARACTERISTIC /end GROUP
/begin GROUP S3166_delay_cond8 "LP_VCU020_AA_VCU/SWC/SPY_SignalPreSys/ThrPed/AccPed/AccPedLPwr_DigVolt/delay_cond8" /begin REF_CHARACTERISTIC Cal_AccpedFaultStsCounter /end REF_CHARACTERISTIC /end GROUP
/begin GROUP S3167_DCT_AccPedLSig_Sts "LP_VCU020_AA_VCU/SWC/SPY_SignalPreSys/ThrPed/AccPed/AccPedLSig_DigVoltL/DCT_AccPedLSig_Sts" /begin SUB_GROUP S3219_delay_cond9 /end SUB_GROUP /end GROUP
/begin GROUP S3167_DTC_AccPedLSig_OV "LP_VCU020_AA_VCU/SWC/SPY_SignalPreSys/ThrPed/AccPed/AccPedLSig_DigVoltL/DTC_AccPedLSig_OV" /begin SUB_GROUP S3220_delay_cond2 S3220_delay_cond3 /end SUB_GROUP /end GROUP
/begin GROUP S3167_DTC_AccPedLSig_STB "LP_VCU020_AA_VCU/SWC/SPY_SignalPreSys/ThrPed/AccPed/AccPedLSig_DigVoltL/DTC_AccPedLSig_STB" /begin SUB_GROUP S3221_delay_cond6 S3221_delay_cond7 /end SUB_GROUP /end GROUP
/begin GROUP S3167_DTC_AccPedLSig_STSTGorCO "LP_VCU020_AA_VCU/SWC/SPY_SignalPreSys/ThrPed/AccPed/AccPedLSig_DigVoltL/DTC_AccPedLSig_STSTGorCO" /begin SUB_GROUP S3222_delay_cond1 S3222_delay_cond8 /end SUB_GROUP /end GROUP
/begin GROUP S3167_DTC_AccPedLSig_UV "LP_VCU020_AA_VCU/SWC/SPY_SignalPreSys/ThrPed/AccPed/AccPedLSig_DigVoltL/DTC_AccPedLSig_UV" /begin SUB_GROUP S3223_delay_cond4 S3223_delay_cond5 /end SUB_GROUP /end GROUP
/begin GROUP S3169_delay_cond2 "LP_VCU020_AA_VCU/SWC/SPY_SignalPreSys/ThrPed/AccPed/Acc_ThrPoison_Clc/delay_cond2" /begin REF_CHARACTERISTIC Cal_AccpedFaultStsCounter /end REF_CHARACTERISTIC /end GROUP
/begin GROUP S1705_DynamicCalc "LP_VCU020_AA_VCU/SWC/DTR_drvrTorqueReq/DrvCtrl/DriveCtl/Control/Drv01_DynamicCalc/DynamicCalc"
 /begin SUB_GROUP S1718_Calc_PdlPct S1718_Calc_VehAccn S1718_Calc_VehSpd S1718_FunctionConfig /end SUB_GROUP
/end GROUP
/begin GROUP S1706_VehiclePwrTrqLimit "LP_VCU020_AA_VCU/SWC/DTR_drvrTorqueReq/DrvCtrl/DriveCtl/Control/Drv02_VehiclePwrTrqLimit/VehiclePwrTrqLimit"
 /begin SUB_GROUP S1885_BattRealTimePwr S1885_CloseLoop_MaxDischgPwr S1885_CloseLoop_MaxRecPwr S1885_Diag_BattPTCPwrWithDischg S1885_Diag_CCMPwrWithDischg S1885_Diag_DCDCPwrWithDischg S1885_Diag_PTCHeatPwrWithDischg S1885_DrvEff S1885_Drv_Pwr2Trq S1885_PwrReduce S1885_Rec_Pwr2Trq /end SUB_GROUP
/end GROUP
/begin GROUP S1707_DriverRequestAnalysis "LP_VCU020_AA_VCU/SWC/DTR_drvrTorqueReq/DrvCtrl/DriveCtl/Control/Drv03_DriverRequestAnalysis/DriverRequestAnalysis"
 /begin SUB_GROUP S1977_AccnModeGearD S1977_AccnModeGearR S1977_DecnModeGearD S1977_DecnModeGearR S1977_DrvLv1_Rec2Zero S1977_DrvLv1_Slip2Zero S1977_DrvLv2_Rec2Zero S1977_DrvLv2_Slip2Zero S1977_DrvLv3_Rec2Zero S1977_DrvLv3_Slip2Zero S1977_DrvModeToggle S1977_LowSpdRecTrqCtl S1977_RecLv1_Rec2Zero S1977_RecLv1_Slip2Zero S1977_RecLv2_Rec2Zero S1977_RecLv2_Slip2Zero S1977_RecLv3_Rec2Zero S1977_RecLv3_Slip2Zero S1977_TrqScale_TestUse /end SUB_GROUP
 /begin REF_MEASUREMENT View_AccnModeGearD View_AccnModeGearR View_DecnModeGearD View_DecnModeGearR View_DriverWheelTrqReq View_DrvType View_RecType View_Test10 View_Test20 View_Test30 View_Test40 /end REF_MEASUREMENT
/end GROUP
/begin GROUP S1708_AdditionalFunctionCtl "LP_VCU020_AA_VCU/SWC/DTR_drvrTorqueReq/DrvCtrl/DriveCtl/Control/Drv04_AdditionalFunctionCtl/AdditionalFunctionCtl"
 /begin SUB_GROUP S2033_ACC S2033_ACC_AllowType S2033_APS S2033_APS_AllowType S2033_CCS S2033_CCS_ActiveSts S2033_CCS_AllowType S2033_EPBCtl /end SUB_GROUP
 /begin REF_CHARACTERISTIC Cal_APSActiveMaxTm /end REF_CHARACTERISTIC
 /begin REF_MEASUREMENT View_APSActiveSt /end REF_MEASUREMENT
/end GROUP
/begin GROUP S1709_CreepCtl "LP_VCU020_AA_VCU/SWC/DTR_drvrTorqueReq/DrvCtrl/DriveCtl/Control/Drv05_CreepCtl/CreepCtl" /begin SUB_GROUP S2265_CreepCtl S2265_CreepModeActive /end SUB_GROUP /begin REF_MEASUREMENT View_WheelTrqReqWithCreepCtl /end REF_MEASUREMENT /end GROUP
/begin GROUP S1710_HillstartAssistControl "LP_VCU020_AA_VCU/SWC/DTR_drvrTorqueReq/DrvCtrl/DriveCtl/Control/Drv06_HillstartAssistControl/HillstartAssistControl"
 /begin SUB_GROUP S2322_HACActiveSts S2322_HACInactiveTrqDec S2322_HAC_Active S2322_HAC_EpbCtl S2322_HillstartAssistControl S2322_Judge /end SUB_GROUP
 /begin REF_MEASUREMENT View_HACCtlWheelTrqReq View_HACStsType /end REF_MEASUREMENT
/end GROUP
/begin GROUP S1711_HillDescentControl "LP_VCU020_AA_VCU/SWC/DTR_drvrTorqueReq/DrvCtrl/DriveCtl/Control/Drv07_HillDescentControl/HillDescentControl"
 /begin SUB_GROUP S2417_AccPdl_BrkPdlResponse S2417_HDCActive S2417_HillDescentControl /end SUB_GROUP
 /begin REF_MEASUREMENT View_WheelTrqReqWithHDC /end REF_MEASUREMENT
/end GROUP
/begin GROUP S1712_MaxSpdLimit "LP_VCU020_AA_VCU/SWC/DTR_drvrTorqueReq/DrvCtrl/DriveCtl/Control/Drv08_MaxSpdLimit/MaxSpdLimit"
 /begin SUB_GROUP S2450_Calc_MaxSpdLimit S2450_MaxSpdLimit S2450_Relay_VehSpd S2450_VehSpdFilt2SpdLimit /end SUB_GROUP
 /begin REF_MEASUREMENT View_MaxSpdLimitActiveSt View_WheelTrqReqWithMSL /end REF_MEASUREMENT
/end GROUP
/begin GROUP S1713_TotWheelTrqRateLimit "LP_VCU020_AA_VCU/SWC/DTR_drvrTorqueReq/DrvCtrl/DriveCtl/Control/Drv09_TotWheelTrqRateLimit/TotWheelTrqRateLimit" /begin SUB_GROUP S2499_Calc_WheelTrqSmoothPar S2499_LPF /end SUB_GROUP /end GROUP
/begin GROUP S1714_OptimalTrqSplit "LP_VCU020_AA_VCU/SWC/DTR_drvrTorqueReq/DrvCtrl/DriveCtl/Control/Drv10_OptimalTrqSplit/OptimalTrqSplit" /begin SUB_GROUP S2543_OptimalRpmSplit /end SUB_GROUP /end GROUP
/begin GROUP S1715_StabilityControl "LP_VCU020_AA_VCU/SWC/DTR_drvrTorqueReq/DrvCtrl/DriveCtl/Control/Drv11_StabilityControl/StabilityControl"
 /begin SUB_GROUP S2550_ESCFuncActiveSt S2550_ESC_ABS_ActiveSts S2550_ESC_AEB_ActiveSts S2550_ESC_CDP_ActiveSts S2550_ESC_ESP_ActiveSts S2550_ESC_TrqResponeFilt S2550_ESP_TCS_EDC_ActiveSts /end SUB_GROUP
 /begin REF_CHARACTERISTIC Test_ESCActive /end REF_CHARACTERISTIC
 /begin REF_MEASUREMENT View_MotTrqReqWithStCtl /end REF_MEASUREMENT
/end GROUP
/begin GROUP S1716_StartUpControl "LP_VCU020_AA_VCU/SWC/DTR_drvrTorqueReq/DrvCtrl/DriveCtl/Control/Drv12_StartUpControl/StartUpControl"
 /begin SUB_GROUP S2646_StartUpCtlMode S2646_StartUpCtlTrqAdd S2646_TrqDirectSwtRateLimit S2646_VehDirectCtl S2646_case_0 S2646_case_10 S2646_case_20 /end SUB_GROUP
 /begin REF_CHARACTERISTIC Cal_StartUpTrqLPFKd /end REF_CHARACTERISTIC
 /begin REF_MEASUREMENT View_MotTrqReqSUCnoadd View_MotTrqReqWithSUC View_TrqDirectSwtDnRateLimit View_TrqDirectSwtUpRateLimit /end REF_MEASUREMENT
/end GROUP
/begin GROUP S1717_SingalAggregate "LP_VCU020_AA_VCU/SWC/DTR_drvrTorqueReq/DrvCtrl/DriveCtl/Control/Drv13_SingalAggregate/SingalAggregate" /begin SUB_GROUP S2699_BrkLightCtl S2699_EPBCtl S2699_VehiclePowerMode /end SUB_GROUP /end GROUP
/begin GROUP S3019_DTC_AccPedHSig_OV "LP_VCU020_AA_VCU/SWC/SPY_SignalPreSys/TempSensor/TempSensor/AcChgVolt/AccPedHSig_DigVolt/DTC_AccPedHSig_OV" /begin SUB_GROUP S3029_delay_cond2 S3029_delay_cond3 /end SUB_GROUP /end GROUP
/begin GROUP S3019_DTC_AccPedHSig_STB "LP_VCU020_AA_VCU/SWC/SPY_SignalPreSys/TempSensor/TempSensor/AcChgVolt/AccPedHSig_DigVolt/DTC_AccPedHSig_STB" /begin SUB_GROUP S3030_delay_cond6 S3030_delay_cond7 /end SUB_GROUP /end GROUP
/begin GROUP S3019_DTC_AccPedHSig_STG "LP_VCU020_AA_VCU/SWC/SPY_SignalPreSys/TempSensor/TempSensor/AcChgVolt/AccPedHSig_DigVolt/DTC_AccPedHSig_STG" /begin SUB_GROUP S3031_delay_cond1 S3031_delay_cond8 /end SUB_GROUP /end GROUP
/begin GROUP S3027_Subsystem2 "LP_VCU020_AA_VCU/SWC/SPY_SignalPreSys/TempSensor/TempSensor/AcChgVolt/Subsystem/Subsystem2" /begin SUB_GROUP S3055_delay_cond2 S3055_delay_cond3 /end SUB_GROUP /end GROUP
/begin GROUP S3062_DTC_AccPedHSig_OV "LP_VCU020_AA_VCU/SWC/SPY_SignalPreSys/TempSensor/TempSensor/DcChgNVolt/AccPedHSig_DigVolt/DTC_AccPedHSig_OV" /begin SUB_GROUP S3072_delay_cond2 S3072_delay_cond3 /end SUB_GROUP /end GROUP
/begin GROUP S3062_DTC_AccPedHSig_STB "LP_VCU020_AA_VCU/SWC/SPY_SignalPreSys/TempSensor/TempSensor/DcChgNVolt/AccPedHSig_DigVolt/DTC_AccPedHSig_STB" /begin SUB_GROUP S3073_delay_cond6 S3073_delay_cond7 /end SUB_GROUP /end GROUP
/begin GROUP S3062_DTC_AccPedHSig_STG "LP_VCU020_AA_VCU/SWC/SPY_SignalPreSys/TempSensor/TempSensor/DcChgNVolt/AccPedHSig_DigVolt/DTC_AccPedHSig_STG" /begin SUB_GROUP S3074_delay_cond1 S3074_delay_cond8 /end SUB_GROUP /end GROUP
/begin GROUP S3070_Subsystem2 "LP_VCU020_AA_VCU/SWC/SPY_SignalPreSys/TempSensor/TempSensor/DcChgNVolt/Subsystem/Subsystem2" /begin SUB_GROUP S3098_delay_cond2 S3098_delay_cond3 /end SUB_GROUP /end GROUP
/begin GROUP S3105_DTC_AccPedHSig_OV "LP_VCU020_AA_VCU/SWC/SPY_SignalPreSys/TempSensor/TempSensor/DcChgPVolt/AccPedHSig_DigVolt/DTC_AccPedHSig_OV" /begin SUB_GROUP S3115_delay_cond2 S3115_delay_cond3 /end SUB_GROUP /end GROUP
/begin GROUP S3105_DTC_AccPedHSig_STB "LP_VCU020_AA_VCU/SWC/SPY_SignalPreSys/TempSensor/TempSensor/DcChgPVolt/AccPedHSig_DigVolt/DTC_AccPedHSig_STB" /begin SUB_GROUP S3116_delay_cond6 S3116_delay_cond7 /end SUB_GROUP /end GROUP
/begin GROUP S3105_DTC_AccPedHSig_STG "LP_VCU020_AA_VCU/SWC/SPY_SignalPreSys/TempSensor/TempSensor/DcChgPVolt/AccPedHSig_DigVolt/DTC_AccPedHSig_STG" /begin SUB_GROUP S3117_delay_cond1 S3117_delay_cond8 /end SUB_GROUP /end GROUP
/begin GROUP S3113_Subsystem2 "LP_VCU020_AA_VCU/SWC/SPY_SignalPreSys/TempSensor/TempSensor/DcChgPVolt/Subsystem/Subsystem2" /begin SUB_GROUP S3141_delay_cond2 S3141_delay_cond3 /end SUB_GROUP /end GROUP
/begin GROUP S3178_delay_cond9 "LP_VCU020_AA_VCU/SWC/SPY_SignalPreSys/ThrPed/AccPed/AccPedHSig_DigVolt/DCT_AccPedHSig_Sts/delay_cond9" /begin REF_CHARACTERISTIC Cal_AccpedFaultStsCounter /end REF_CHARACTERISTIC /end GROUP
/begin GROUP S3179_delay_cond2 "LP_VCU020_AA_VCU/SWC/SPY_SignalPreSys/ThrPed/AccPed/AccPedHSig_DigVolt/DTC_AccPedHSig_OV/delay_cond2" /begin REF_CHARACTERISTIC Cal_AccpedFaultStsCounter /end REF_CHARACTERISTIC /end GROUP
/begin GROUP S3179_delay_cond3 "LP_VCU020_AA_VCU/SWC/SPY_SignalPreSys/ThrPed/AccPed/AccPedHSig_DigVolt/DTC_AccPedHSig_OV/delay_cond3" /begin REF_CHARACTERISTIC Cal_AccpedFaultStsCounter /end REF_CHARACTERISTIC /end GROUP
/begin GROUP S3180_delay_cond6 "LP_VCU020_AA_VCU/SWC/SPY_SignalPreSys/ThrPed/AccPed/AccPedHSig_DigVolt/DTC_AccPedHSig_STB/delay_cond6" /begin REF_CHARACTERISTIC Cal_AccpedFaultStsCounter /end REF_CHARACTERISTIC /end GROUP
/begin GROUP S3180_delay_cond7 "LP_VCU020_AA_VCU/SWC/SPY_SignalPreSys/ThrPed/AccPed/AccPedHSig_DigVolt/DTC_AccPedHSig_STB/delay_cond7" /begin REF_CHARACTERISTIC Cal_AccpedFaultStsCounter /end REF_CHARACTERISTIC /end GROUP
/begin GROUP S3181_delay_cond1 "LP_VCU020_AA_VCU/SWC/SPY_SignalPreSys/ThrPed/AccPed/AccPedHSig_DigVolt/DTC_AccPedHSig_STSTGorCO/delay_cond1" /begin REF_CHARACTERISTIC Cal_AccpedFaultStsCounter /end REF_CHARACTERISTIC /end GROUP
/begin GROUP S3181_delay_cond8 "LP_VCU020_AA_VCU/SWC/SPY_SignalPreSys/ThrPed/AccPed/AccPedHSig_DigVolt/DTC_AccPedHSig_STSTGorCO/delay_cond8" /begin REF_CHARACTERISTIC Cal_AccpedFaultStsCounter /end REF_CHARACTERISTIC /end GROUP
/begin GROUP S3182_delay_cond4 "LP_VCU020_AA_VCU/SWC/SPY_SignalPreSys/ThrPed/AccPed/AccPedHSig_DigVolt/DTC_AccPedHSig_UV/delay_cond4" /begin REF_CHARACTERISTIC Cal_AccpedFaultStsCounter /end REF_CHARACTERISTIC /end GROUP
/begin GROUP S3182_delay_cond5 "LP_VCU020_AA_VCU/SWC/SPY_SignalPreSys/ThrPed/AccPed/AccPedHSig_DigVolt/DTC_AccPedHSig_UV/delay_cond5" /begin REF_CHARACTERISTIC Cal_AccpedFaultStsCounter /end REF_CHARACTERISTIC /end GROUP
/begin GROUP S3219_delay_cond9 "LP_VCU020_AA_VCU/SWC/SPY_SignalPreSys/ThrPed/AccPed/AccPedLSig_DigVoltL/DCT_AccPedLSig_Sts/delay_cond9" /begin REF_CHARACTERISTIC Cal_AccpedFaultStsCounter /end REF_CHARACTERISTIC /end GROUP
/begin GROUP S3220_delay_cond2 "LP_VCU020_AA_VCU/SWC/SPY_SignalPreSys/ThrPed/AccPed/AccPedLSig_DigVoltL/DTC_AccPedLSig_OV/delay_cond2" /begin REF_CHARACTERISTIC Cal_AccpedFaultStsCounter /end REF_CHARACTERISTIC /end GROUP
/begin GROUP S3220_delay_cond3 "LP_VCU020_AA_VCU/SWC/SPY_SignalPreSys/ThrPed/AccPed/AccPedLSig_DigVoltL/DTC_AccPedLSig_OV/delay_cond3" /begin REF_CHARACTERISTIC Cal_AccpedFaultStsCounter /end REF_CHARACTERISTIC /end GROUP
/begin GROUP S3221_delay_cond6 "LP_VCU020_AA_VCU/SWC/SPY_SignalPreSys/ThrPed/AccPed/AccPedLSig_DigVoltL/DTC_AccPedLSig_STB/delay_cond6" /begin REF_CHARACTERISTIC Cal_AccpedFaultStsCounter /end REF_CHARACTERISTIC /end GROUP
/begin GROUP S3221_delay_cond7 "LP_VCU020_AA_VCU/SWC/SPY_SignalPreSys/ThrPed/AccPed/AccPedLSig_DigVoltL/DTC_AccPedLSig_STB/delay_cond7" /begin REF_CHARACTERISTIC Cal_AccpedFaultStsCounter /end REF_CHARACTERISTIC /end GROUP
/begin GROUP S3222_delay_cond1 "LP_VCU020_AA_VCU/SWC/SPY_SignalPreSys/ThrPed/AccPed/AccPedLSig_DigVoltL/DTC_AccPedLSig_STSTGorCO/delay_cond1" /begin REF_CHARACTERISTIC Cal_AccpedFaultStsCounter /end REF_CHARACTERISTIC /end GROUP
/begin GROUP S3222_delay_cond8 "LP_VCU020_AA_VCU/SWC/SPY_SignalPreSys/ThrPed/AccPed/AccPedLSig_DigVoltL/DTC_AccPedLSig_STSTGorCO/delay_cond8" /begin REF_CHARACTERISTIC Cal_AccpedFaultStsCounter /end REF_CHARACTERISTIC /end GROUP
/begin GROUP S3223_delay_cond4 "LP_VCU020_AA_VCU/SWC/SPY_SignalPreSys/ThrPed/AccPed/AccPedLSig_DigVoltL/DTC_AccPedLSig_UV/delay_cond4" /begin REF_CHARACTERISTIC Cal_AccpedFaultStsCounter /end REF_CHARACTERISTIC /end GROUP
/begin GROUP S3223_delay_cond5 "LP_VCU020_AA_VCU/SWC/SPY_SignalPreSys/ThrPed/AccPed/AccPedLSig_DigVoltL/DTC_AccPedLSig_UV/delay_cond5" /begin REF_CHARACTERISTIC Cal_AccpedFaultStsCounter /end REF_CHARACTERISTIC /end GROUP
/begin GROUP S1718_Calc_PdlPct "LP_VCU020_AA_VCU/SWC/DTR_drvrTorqueReq/DrvCtrl/DriveCtl/Control/Drv01_DynamicCalc/DynamicCalc/Calc_PdlPct"
 /begin REF_CHARACTERISTIC CalCrv_AccPdlPctDnRateLimit CalCrv_AccPdlPctLPFKd CalCrv_AccPdlPctUpRateLimit /end REF_CHARACTERISTIC
/end GROUP
/begin GROUP S1718_Calc_VehAccn "LP_VCU020_AA_VCU/SWC/DTR_drvrTorqueReq/DrvCtrl/DriveCtl/Control/Drv01_DynamicCalc/DynamicCalc/Calc_VehAccn" /begin SUB_GROUP S1720_VehAccnPreCalc /end SUB_GROUP /begin REF_MEASUREMENT View_ReferVehAccn /end REF_MEASUREMENT /end GROUP
/begin GROUP S1718_Calc_VehSpd "LP_VCU020_AA_VCU/SWC/DTR_drvrTorqueReq/DrvCtrl/DriveCtl/Control/Drv01_DynamicCalc/DynamicCalc/Calc_VehSpd"
 /begin SUB_GROUP S1721_FrontMotRpmFilt S1721_FrontWheelSpdFilt S1721_RearWheelSpdFilt S1721_ReferVehSpdFilt S1721_VehSpdFilt S1721_ZeroSpdConfirm /end SUB_GROUP
 /begin REF_MEASUREMENT View_FrontWheelSpdFilt View_FrontWheelSpdVD View_MotRpmFilt View_RearWheelSpdFilt View_RearWheelSpdVD View_VehSpdFilt View_VehSpdFiltVD View_ZeroSpdSt /end REF_MEASUREMENT
/end GROUP
/begin GROUP S1718_FunctionConfig "LP_VCU020_AA_VCU/SWC/DTR_drvrTorqueReq/DrvCtrl/DriveCtl/Control/Drv01_DynamicCalc/DynamicCalc/FunctionConfig"
 /begin SUB_GROUP S1723_ACCFunction S1723_APSFunction S1723_BarrateMode S1723_BrkRecFunction S1723_CCSFunction S1723_DrvModeCtl S1723_ESCFunction S1723_HACFunction S1723_HDCFunction S1723_MaxSpdLimit S1723_SlipRecFunction S1723_StartUpCtl S1723_ZeroSpdCtl /end SUB_GROUP
/end GROUP
/begin GROUP S1885_BattRealTimePwr "LP_VCU020_AA_VCU/SWC/DTR_drvrTorqueReq/DrvCtrl/DriveCtl/Control/Drv02_VehiclePwrTrqLimit/VehiclePwrTrqLimit/BattRealTimePwr" /begin REF_CHARACTERISTIC Cal_BattPwrLPFKd /end REF_CHARACTERISTIC /end GROUP
/begin GROUP S1885_CloseLoop_MaxDischgPwr "LP_VCU020_AA_VCU/SWC/DTR_drvrTorqueReq/DrvCtrl/DriveCtl/Control/Drv02_VehiclePwrTrqLimit/VehiclePwrTrqLimit/CloseLoop_MaxDischgPwr" /begin REF_CHARACTERISTIC Cal_MotMaxDrvPwr Cal_PwrMaxHoldTime Cal_PwrlimtGain /end REF_CHARACTERISTIC /begin REF_MEASUREMENT View_MaxDischgPwr_CloseLoop /end REF_MEASUREMENT /end GROUP
/begin GROUP S1885_CloseLoop_MaxRecPwr "LP_VCU020_AA_VCU/SWC/DTR_drvrTorqueReq/DrvCtrl/DriveCtl/Control/Drv02_VehiclePwrTrqLimit/VehiclePwrTrqLimit/CloseLoop_MaxRecPwr" /begin REF_CHARACTERISTIC Cal_MotMaxRecPwr Cal_PwrMaxHoldTime Cal_PwrlimtGain /end REF_CHARACTERISTIC /begin REF_MEASUREMENT View_MaxRecPwr_CloseLoop /end REF_MEASUREMENT /end GROUP
/begin GROUP S1885_Diag_BattPTCPwrWithDischg "LP_VCU020_AA_VCU/SWC/DTR_drvrTorqueReq/DrvCtrl/DriveCtl/Control/Drv02_VehiclePwrTrqLimit/VehiclePwrTrqLimit/Diag_BattPTCPwrWithDischg" /begin REF_CHARACTERISTIC Cal_BattPtcPwr /end REF_CHARACTERISTIC /end GROUP
/begin GROUP S1885_Diag_CCMPwrWithDischg "LP_VCU020_AA_VCU/SWC/DTR_drvrTorqueReq/DrvCtrl/DriveCtl/Control/Drv02_VehiclePwrTrqLimit/VehiclePwrTrqLimit/Diag_CCMPwrWithDischg" /begin REF_CHARACTERISTIC Cal_CCMMaxPwr /end REF_CHARACTERISTIC /end GROUP
/begin GROUP S1885_Diag_DCDCPwrWithDischg "LP_VCU020_AA_VCU/SWC/DTR_drvrTorqueReq/DrvCtrl/DriveCtl/Control/Drv02_VehiclePwrTrqLimit/VehiclePwrTrqLimit/Diag_DCDCPwrWithDischg" /begin REF_CHARACTERISTIC Cal_DcdcPwr /end REF_CHARACTERISTIC /end GROUP
/begin GROUP S1885_Diag_PTCHeatPwrWithDischg "LP_VCU020_AA_VCU/SWC/DTR_drvrTorqueReq/DrvCtrl/DriveCtl/Control/Drv02_VehiclePwrTrqLimit/VehiclePwrTrqLimit/Diag_PTCHeatPwrWithDischg" /begin REF_CHARACTERISTIC Cal_AcPtcHeatPwr /end REF_CHARACTERISTIC /end GROUP
/begin GROUP S1885_DrvEff "LP_VCU020_AA_VCU/SWC/DTR_drvrTorqueReq/DrvCtrl/DriveCtl/Control/Drv02_VehiclePwrTrqLimit/VehiclePwrTrqLimit/DrvEff" /begin REF_CHARACTERISTIC CalMap_MotDrvEff Cal_MotMaxDrvPwr /end REF_CHARACTERISTIC /end GROUP
/begin GROUP S1885_Drv_Pwr2Trq "LP_VCU020_AA_VCU/SWC/DTR_drvrTorqueReq/DrvCtrl/DriveCtl/Control/Drv02_VehiclePwrTrqLimit/VehiclePwrTrqLimit/Drv_Pwr2Trq" /begin REF_CHARACTERISTIC CalCrv_MotExCharDrvTrq /end REF_CHARACTERISTIC /begin REF_MEASUREMENT View_MotMaxDrvPwr View_WheelMaxDrvTrq /end REF_MEASUREMENT /end GROUP
/begin GROUP S1885_PwrReduce "LP_VCU020_AA_VCU/SWC/DTR_drvrTorqueReq/DrvCtrl/DriveCtl/Control/Drv02_VehiclePwrTrqLimit/VehiclePwrTrqLimit/PwrReduce"
 /begin REF_CHARACTERISTIC Cal_PwrLimitUpRateLimit Cal_PwrReduceLv0 Cal_PwrReduceLv1 Cal_PwrReduceLv2 Cal_PwrReduceLv3 /end REF_CHARACTERISTIC
/end GROUP
/begin GROUP S1885_Rec_Pwr2Trq "LP_VCU020_AA_VCU/SWC/DTR_drvrTorqueReq/DrvCtrl/DriveCtl/Control/Drv02_VehiclePwrTrqLimit/VehiclePwrTrqLimit/Rec_Pwr2Trq" /begin REF_CHARACTERISTIC CalCrv_MotExCharRecTrq /end REF_CHARACTERISTIC /begin REF_MEASUREMENT View_MotMaxRecPwr View_WheelMaxRecTrq /end REF_MEASUREMENT /end GROUP
/begin GROUP S1977_AccnModeGearD "LP_VCU020_AA_VCU/SWC/DTR_drvrTorqueReq/DrvCtrl/DriveCtl/Control/Drv03_DriverRequestAnalysis/DriverRequestAnalysis/AccnModeGearD" /begin REF_CHARACTERISTIC Cal_DelayTm2DrvModeToggle /end REF_CHARACTERISTIC /end GROUP
/begin GROUP S1977_AccnModeGearR "LP_VCU020_AA_VCU/SWC/DTR_drvrTorqueReq/DrvCtrl/DriveCtl/Control/Drv03_DriverRequestAnalysis/DriverRequestAnalysis/AccnModeGearR" /begin REF_CHARACTERISTIC Cal_DelayTm2DrvModeToggle /end REF_CHARACTERISTIC /end GROUP
/begin GROUP S1977_DecnModeGearD "LP_VCU020_AA_VCU/SWC/DTR_drvrTorqueReq/DrvCtrl/DriveCtl/Control/Drv03_DriverRequestAnalysis/DriverRequestAnalysis/DecnModeGearD" /begin REF_CHARACTERISTIC Cal_DelayTm2DrvModeToggle /end REF_CHARACTERISTIC /end GROUP
/begin GROUP S1977_DecnModeGearR "LP_VCU020_AA_VCU/SWC/DTR_drvrTorqueReq/DrvCtrl/DriveCtl/Control/Drv03_DriverRequestAnalysis/DriverRequestAnalysis/DecnModeGearR" /begin REF_CHARACTERISTIC Cal_DelayTm2DrvModeToggle /end REF_CHARACTERISTIC /end GROUP
/begin GROUP S1977_DrvLv1_Rec2Zero "LP_VCU020_AA_VCU/SWC/DTR_drvrTorqueReq/DrvCtrl/DriveCtl/Control/Drv03_DriverRequestAnalysis/DriverRequestAnalysis/DrvLv1_Rec2Zero" /begin REF_CHARACTERISTIC CalMap_DrvTrqLv1Rec2Zero /end REF_CHARACTERISTIC /end GROUP
/begin GROUP S1977_DrvLv1_Slip2Zero "LP_VCU020_AA_VCU/SWC/DTR_drvrTorqueReq/DrvCtrl/DriveCtl/Control/Drv03_DriverRequestAnalysis/DriverRequestAnalysis/DrvLv1_Slip2Zero" /begin REF_CHARACTERISTIC CalMap_DrvTrqLv1Slip2Zero /end REF_CHARACTERISTIC /end GROUP
/begin GROUP S1977_DrvLv2_Rec2Zero "LP_VCU020_AA_VCU/SWC/DTR_drvrTorqueReq/DrvCtrl/DriveCtl/Control/Drv03_DriverRequestAnalysis/DriverRequestAnalysis/DrvLv2_Rec2Zero" /begin REF_CHARACTERISTIC CalMap_DrvTrqLv2Rec2Zero /end REF_CHARACTERISTIC /end GROUP
/begin GROUP S1977_DrvLv2_Slip2Zero "LP_VCU020_AA_VCU/SWC/DTR_drvrTorqueReq/DrvCtrl/DriveCtl/Control/Drv03_DriverRequestAnalysis/DriverRequestAnalysis/DrvLv2_Slip2Zero" /begin REF_CHARACTERISTIC CalMap_DrvTrqLv2Slip2Zero /end REF_CHARACTERISTIC /end GROUP
/begin GROUP S1977_DrvLv3_Rec2Zero "LP_VCU020_AA_VCU/SWC/DTR_drvrTorqueReq/DrvCtrl/DriveCtl/Control/Drv03_DriverRequestAnalysis/DriverRequestAnalysis/DrvLv3_Rec2Zero" /begin REF_CHARACTERISTIC CalMap_DrvTrqLv3Rec2Zero /end REF_CHARACTERISTIC /end GROUP
/begin GROUP S1977_DrvLv3_Slip2Zero "LP_VCU020_AA_VCU/SWC/DTR_drvrTorqueReq/DrvCtrl/DriveCtl/Control/Drv03_DriverRequestAnalysis/DriverRequestAnalysis/DrvLv3_Slip2Zero" /begin REF_CHARACTERISTIC CalMap_DrvTrqLv3Slip2Zero /end REF_CHARACTERISTIC /end GROUP
/begin GROUP S1977_DrvModeToggle "LP_VCU020_AA_VCU/SWC/DTR_drvrTorqueReq/DrvCtrl/DriveCtl/Control/Drv03_DriverRequestAnalysis/DriverRequestAnalysis/DrvModeToggle"
 /begin REF_CHARACTERISTIC CalCrv_DrvModeToggleTrqLPF Cal_DelayTm2DrvModeToggle Cal_DrvModeToggleInactivePdlPct Cal_DrvModeToggleInactiveTm Cal_DrvModeToggleInactiveTrq /end REF_CHARACTERISTIC
/end GROUP
/begin GROUP S1977_LowSpdRecTrqCtl "LP_VCU020_AA_VCU/SWC/DTR_drvrTorqueReq/DrvCtrl/DriveCtl/Control/Drv03_DriverRequestAnalysis/DriverRequestAnalysis/LowSpdRecTrqCtl" /begin SUB_GROUP S2006_MaxRecTrq /end SUB_GROUP /begin REF_CHARACTERISTIC Cal_LowSpdThreshold /end REF_CHARACTERISTIC /end GROUP
/begin GROUP S1977_RecLv1_Rec2Zero "LP_VCU020_AA_VCU/SWC/DTR_drvrTorqueReq/DrvCtrl/DriveCtl/Control/Drv03_DriverRequestAnalysis/DriverRequestAnalysis/RecLv1_Rec2Zero" /begin REF_CHARACTERISTIC CalMap_RecTrqLv1Rec2Zero /end REF_CHARACTERISTIC /end GROUP
/begin GROUP S1977_RecLv1_Slip2Zero "LP_VCU020_AA_VCU/SWC/DTR_drvrTorqueReq/DrvCtrl/DriveCtl/Control/Drv03_DriverRequestAnalysis/DriverRequestAnalysis/RecLv1_Slip2Zero" /begin REF_CHARACTERISTIC CalMap_RecTrqLv1Slip2Zero /end REF_CHARACTERISTIC /end GROUP
/begin GROUP S1977_RecLv2_Rec2Zero "LP_VCU020_AA_VCU/SWC/DTR_drvrTorqueReq/DrvCtrl/DriveCtl/Control/Drv03_DriverRequestAnalysis/DriverRequestAnalysis/RecLv2_Rec2Zero" /begin REF_CHARACTERISTIC CalMap_RecTrqLv2Rec2Zero /end REF_CHARACTERISTIC /end GROUP
/begin GROUP S1977_RecLv2_Slip2Zero "LP_VCU020_AA_VCU/SWC/DTR_drvrTorqueReq/DrvCtrl/DriveCtl/Control/Drv03_DriverRequestAnalysis/DriverRequestAnalysis/RecLv2_Slip2Zero" /begin REF_CHARACTERISTIC CalMap_RecTrqLv2Slip2Zero /end REF_CHARACTERISTIC /end GROUP
/begin GROUP S1977_RecLv3_Rec2Zero "LP_VCU020_AA_VCU/SWC/DTR_drvrTorqueReq/DrvCtrl/DriveCtl/Control/Drv03_DriverRequestAnalysis/DriverRequestAnalysis/RecLv3_Rec2Zero" /begin REF_CHARACTERISTIC CalMap_RecTrqLv3Rec2Zero /end REF_CHARACTERISTIC /end GROUP
/begin GROUP S1977_RecLv3_Slip2Zero "LP_VCU020_AA_VCU/SWC/DTR_drvrTorqueReq/DrvCtrl/DriveCtl/Control/Drv03_DriverRequestAnalysis/DriverRequestAnalysis/RecLv3_Slip2Zero" /begin REF_CHARACTERISTIC CalMap_RecTrqLv3Slip2Zero /end REF_CHARACTERISTIC /end GROUP
/begin GROUP S1977_TrqScale_TestUse "LP_VCU020_AA_VCU/SWC/DTR_drvrTorqueReq/DrvCtrl/DriveCtl/Control/Drv03_DriverRequestAnalysis/DriverRequestAnalysis/TrqScale_TestUse" /begin REF_CHARACTERISTIC Cal_RecTrqScaleFactor /end REF_CHARACTERISTIC /end GROUP
/begin GROUP S2033_ACC "LP_VCU020_AA_VCU/SWC/DTR_drvrTorqueReq/DrvCtrl/DriveCtl/Control/Drv04_AdditionalFunctionCtl/AdditionalFunctionCtl/ACC"
 /begin SUB_GROUP S2034_ACC_PauseByAccPdl S2034_ACC_SpdCtlMode S2034_WheelTrqReq /end SUB_GROUP
/end GROUP
/begin GROUP S2033_ACC_AllowType "LP_VCU020_AA_VCU/SWC/DTR_drvrTorqueReq/DrvCtrl/DriveCtl/Control/Drv04_AdditionalFunctionCtl/AdditionalFunctionCtl/ACC_AllowType" /begin REF_CHARACTERISTIC Cal_ACCAllowCancelTm Cal_ACCAllowConfirmTm /end REF_CHARACTERISTIC /end GROUP
/begin GROUP S2033_APS "LP_VCU020_AA_VCU/SWC/DTR_drvrTorqueReq/DrvCtrl/DriveCtl/Control/Drv04_AdditionalFunctionCtl/AdditionalFunctionCtl/APS"
 /begin SUB_GROUP S2037_APSPauseByAccPdl S2037_APS_SpdCtlMode S2037_WheelTrqReq /end SUB_GROUP
/end GROUP
/begin GROUP S2033_APS_AllowType "LP_VCU020_AA_VCU/SWC/DTR_drvrTorqueReq/DrvCtrl/DriveCtl/Control/Drv04_AdditionalFunctionCtl/AdditionalFunctionCtl/APS_AllowType"
 /begin REF_CHARACTERISTIC Cal_APSAllowCancelTm Cal_APSAllowConfirmTm Cal_APSEnableMaxSpd /end REF_CHARACTERISTIC
/end GROUP
/begin GROUP S2033_CCS "LP_VCU020_AA_VCU/SWC/DTR_drvrTorqueReq/DrvCtrl/DriveCtl/Control/Drv04_AdditionalFunctionCtl/AdditionalFunctionCtl/CCS" /begin SUB_GROUP S2041_CCSTarSpdLimit S2041_VehSpd /end SUB_GROUP
 /begin REF_CHARACTERISTIC CalCrv_CCSCtlKd2TarSpd CalCrv_CCSCtlKi2TarSpd CalCrv_CCSCtlKp2TarSpd Cal_CCSCtlKd2TarAccn Cal_CCSCtlKi2TarAccn Cal_CCSCtlKp2TarAccn Cal_CCSCtlMaxWheelTrqLimit Cal_CCSCtlMinWheelTrqLimit Cal_CCSCtlmodeSwtDeltaSpd Cal_MaxAccn2CCS Cal_MaxDecn2CCS /end REF_CHARACTERISTIC
 /begin REF_MEASUREMENT View_CCSWheelTrqReq View_CCSWheelTrqReqByAccn View_CCSWheelTrqReqBySpd /end REF_MEASUREMENT
/end GROUP
/begin GROUP S2033_CCS_ActiveSts "LP_VCU020_AA_VCU/SWC/DTR_drvrTorqueReq/DrvCtrl/DriveCtl/Control/Drv04_AdditionalFunctionCtl/AdditionalFunctionCtl/CCS_ActiveSts"
 /begin REF_CHARACTERISTIC Cal_CCSActiveMinSpd Cal_CCSCancelMinSpd Cal_VehSpdScaleFactor2CCSActive /end REF_CHARACTERISTIC
/end GROUP
/begin GROUP S2033_CCS_AllowType "LP_VCU020_AA_VCU/SWC/DTR_drvrTorqueReq/DrvCtrl/DriveCtl/Control/Drv04_AdditionalFunctionCtl/AdditionalFunctionCtl/CCS_AllowType" /begin REF_CHARACTERISTIC Cal_CCSAllowCancelTm Cal_CCSAllowConfirmTm /end REF_CHARACTERISTIC /end GROUP
/begin GROUP S2033_EPBCtl "LP_VCU020_AA_VCU/SWC/DTR_drvrTorqueReq/DrvCtrl/DriveCtl/Control/Drv04_AdditionalFunctionCtl/AdditionalFunctionCtl/EPBCtl" /begin REF_CHARACTERISTIC Cal_APSEPBCtlMaxWaitTm /end REF_CHARACTERISTIC /end GROUP
/begin GROUP S2265_CreepCtl "LP_VCU020_AA_VCU/SWC/DTR_drvrTorqueReq/DrvCtrl/DriveCtl/Control/Drv05_CreepCtl/CreepCtl/CreepCtl" /begin SUB_GROUP S2268_BrkForceOn_TrqResponse S2268_Par_PID S2268_ek_Trim /end SUB_GROUP
 /begin REF_CHARACTERISTIC CalCrv_CreepDTrq CalCrv_CreepTrq CalCrv_CreepTrqDnRateLimit CalCrv_CreepTrqUpRateLimit Cal_CreepDTarSpd Cal_CreepPIDMaxTrq Cal_CreepPIDMinTrq Cal_CreepStartUpCtlMaxTm Cal_CreepTarSpd Cal_CreepTrqDnRate Cal_CreepTrqLPFKd Cal_CreepTrqUpRate /end REF_CHARACTERISTIC
 /begin REF_MEASUREMENT View_CreepCtlWheelTrqReq /end REF_MEASUREMENT
/end GROUP
/begin GROUP S2265_CreepModeActive "LP_VCU020_AA_VCU/SWC/DTR_drvrTorqueReq/DrvCtrl/DriveCtl/Control/Drv05_CreepCtl/CreepCtl/CreepModeActive" /begin SUB_GROUP S2269_Relay_BrkPdl /end SUB_GROUP
 /begin REF_CHARACTERISTIC Cal_CreepActiveDelay Cal_CreepActiveMinAccPdl2GearD Cal_CreepActiveMinSpd2GearD Cal_CreepDSpdIn Cal_CreepInactiveDelay Cal_CreepSpdIn Cal_TrqInactiveCreepMaxTm /end REF_CHARACTERISTIC
 /begin REF_MEASUREMENT View_CreepActiveSt /end REF_MEASUREMENT
/end GROUP
/begin GROUP S2322_HACActiveSts "LP_VCU020_AA_VCU/SWC/DTR_drvrTorqueReq/DrvCtrl/DriveCtl/Control/Drv06_HillstartAssistControl/HillstartAssistControl/HACActiveSts" /begin REF_CHARACTERISTIC Cal_HACStsConfirmSpd /end REF_CHARACTERISTIC /begin REF_MEASUREMENT View_HACActiveSts View_WheelTrqReqWithHAC /end REF_MEASUREMENT /end GROUP
/begin GROUP S2322_HACInactiveTrqDec "LP_VCU020_AA_VCU/SWC/DTR_drvrTorqueReq/DrvCtrl/DriveCtl/Control/Drv06_HillstartAssistControl/HillstartAssistControl/HACInactiveTrqDec" /begin SUB_GROUP S2329_TrqDecByAVH S2329_TrqDecByEPB /end SUB_GROUP /end GROUP
/begin GROUP S2322_HAC_Active "LP_VCU020_AA_VCU/SWC/DTR_drvrTorqueReq/DrvCtrl/DriveCtl/Control/Drv06_HillstartAssistControl/HillstartAssistControl/HAC_Active"
 /begin SUB_GROUP S2330_HAC_ActiveReq S2330_HAC_ActiveSts S2330_HAC_InactiveReq /end SUB_GROUP
/end GROUP
/begin GROUP S2322_HAC_EpbCtl "LP_VCU020_AA_VCU/SWC/DTR_drvrTorqueReq/DrvCtrl/DriveCtl/Control/Drv06_HillstartAssistControl/HillstartAssistControl/HAC_EpbCtl" /begin REF_CHARACTERISTIC Cal_HACMaxHoldTime /end REF_CHARACTERISTIC /end GROUP
/begin GROUP S2322_HillstartAssistControl "LP_VCU020_AA_VCU/SWC/DTR_drvrTorqueReq/DrvCtrl/DriveCtl/Control/Drv06_HillstartAssistControl/HillstartAssistControl/HillstartAssistControl" /begin SUB_GROUP S2332_Par_PID_HAC1 S2332_Par_PID_HAC2 S2332_Par_PID_HAC3 /end SUB_GROUP
 /begin REF_CHARACTERISTIC Cal_HACMaxTrq Cal_HACMinTrq Cal_HACMode1TrqLPF Cal_HACMode2TrqLPF Cal_HACMode3TrqLPF /end REF_CHARACTERISTIC
/end GROUP
/begin GROUP S2322_Judge "LP_VCU020_AA_VCU/SWC/DTR_drvrTorqueReq/DrvCtrl/DriveCtl/Control/Drv06_HillstartAssistControl/HillstartAssistControl/Judge" /begin SUB_GROUP S2333_HacInactiveReqJudge /end SUB_GROUP /begin REF_CHARACTERISTIC Cal_HACDecSpd Cal_HACDecTime Cfg_HACTrqThresholdActive /end REF_CHARACTERISTIC /begin REF_MEASUREMENT View_HACInActiveReq View_HACJudgeReq /end REF_MEASUREMENT /end GROUP
/begin GROUP S2417_AccPdl_BrkPdlResponse "LP_VCU020_AA_VCU/SWC/DTR_drvrTorqueReq/DrvCtrl/DriveCtl/Control/Drv07_HillDescentControl/HillDescentControl/AccPdl&BrkPdlResponse"
 /begin REF_CHARACTERISTIC Cal_AccPdlActiveThreshold Cal_AccPdlHDCOffThreshold Cal_HDCInactiveSpdLow /end REF_CHARACTERISTIC
/end GROUP
/begin GROUP S2417_HDCActive "LP_VCU020_AA_VCU/SWC/DTR_drvrTorqueReq/DrvCtrl/DriveCtl/Control/Drv07_HillDescentControl/HillDescentControl/HDCActive" /begin SUB_GROUP S2420_VCU_HDCActiveRecTrq /end SUB_GROUP
 /begin REF_CHARACTERISTIC Cal_AccPdlHDCOffThreshold Cal_HDCActiveAccn Cal_HDCActiveConfirmTm Cal_HDCActiveMaxAccPdlPct Cal_HDCActiveSpdLimit Cal_HDCInactiveSpdHigh Cal_HDCInactiveSpdLow /end REF_CHARACTERISTIC
 /begin REF_MEASUREMENT View_HDCActiveSts /end REF_MEASUREMENT
/end GROUP
/begin GROUP S2417_HillDescentControl "LP_VCU020_AA_VCU/SWC/DTR_drvrTorqueReq/DrvCtrl/DriveCtl/Control/Drv07_HillDescentControl/HillDescentControl/HillDescentControl" /begin SUB_GROUP S2421_Subsystem /end SUB_GROUP /begin REF_CHARACTERISTIC Cal_HDCMaxTrq Cal_HDCMinTrq Cal_HDCTarSpd /end REF_CHARACTERISTIC /begin REF_MEASUREMENT View_HDCWheelTrqReq /end REF_MEASUREMENT /end GROUP
/begin GROUP S2450_Calc_MaxSpdLimit "LP_VCU020_AA_VCU/SWC/DTR_drvrTorqueReq/DrvCtrl/DriveCtl/Control/Drv08_MaxSpdLimit/MaxSpdLimit/Calc_MaxSpdLimit" /begin SUB_GROUP S2451_Par_PID /end SUB_GROUP
 /begin REF_CHARACTERISTIC Cal_MaxSpdLimitTrqLPFKd Cal_SpdLimitMaxTrq Cal_SpdLimitMinTrq Cal_SpdLimitTrqDnRateLimit Cal_SpdLimitTrqUpRateLimit /end REF_CHARACTERISTIC
 /begin REF_MEASUREMENT View_SpdLimitWheelTrqReq /end REF_MEASUREMENT
/end GROUP
/begin GROUP S2450_MaxSpdLimit "LP_VCU020_AA_VCU/SWC/DTR_drvrTorqueReq/DrvCtrl/DriveCtl/Control/Drv08_MaxSpdLimit/MaxSpdLimit/MaxSpdLimit" /begin SUB_GROUP S2455_EcoModeSpdLimit /end SUB_GROUP
 /begin REF_CHARACTERISTIC Cal_MaxSpdLimit2Backward Cal_MaxSpdLimit2Forward Cal_MaxSpdLimitOffSet Cal_SpdLimitErr0 Cal_SpdLimitErr1 Cal_SpdLimitErr2 Cal_SpdLimitErr3 Cfg_EcoModeSpdLimit Test_EcoModeSpdLimit /end REF_CHARACTERISTIC
/end GROUP
/begin GROUP S2450_Relay_VehSpd "LP_VCU020_AA_VCU/SWC/DTR_drvrTorqueReq/DrvCtrl/DriveCtl/Control/Drv08_MaxSpdLimit/MaxSpdLimit/Relay_VehSpd"
 /begin REF_CHARACTERISTIC Cal_SpdLimitActiveDeltaSpd Cal_SpdLimitActiveDeltaSpdOffSet /end REF_CHARACTERISTIC
/end GROUP
/begin GROUP S2450_VehSpdFilt2SpdLimit "LP_VCU020_AA_VCU/SWC/DTR_drvrTorqueReq/DrvCtrl/DriveCtl/Control/Drv08_MaxSpdLimit/MaxSpdLimit/VehSpdFilt2SpdLimit" /begin REF_CHARACTERISTIC Cal_VehSpdLPFKd2SpdLimit Cal_VehSpdScaleFactor /end REF_CHARACTERISTIC /end GROUP
/begin GROUP S2499_Calc_WheelTrqSmoothPar "LP_VCU020_AA_VCU/SWC/DTR_drvrTorqueReq/DrvCtrl/DriveCtl/Control/Drv09_TotWheelTrqRateLimit/TotWheelTrqRateLimit/Calc_WheelTrqSmoothPar"
 /begin SUB_GROUP S2500_DrvModeRateLimit S2500_GearToggle S2500_HACMode S2500_RecModeRateLimit S2500_WheelTrqReqRateLimit /end SUB_GROUP
 /begin REF_CHARACTERISTIC Cal_HACTrqRateMode /end REF_CHARACTERISTIC
 /begin REF_MEASUREMENT View_WheelTrqDnRateLimit View_WheelTrqUpRateLimit /end REF_MEASUREMENT
/end GROUP
/begin GROUP S2499_LPF "LP_VCU020_AA_VCU/SWC/DTR_drvrTorqueReq/DrvCtrl/DriveCtl/Control/Drv09_TotWheelTrqRateLimit/TotWheelTrqRateLimit/LPF" /begin REF_CHARACTERISTIC CalCrv_Kd2LastWheelTrq CalCrv_Kd2VehSpd /end REF_CHARACTERISTIC /begin REF_MEASUREMENT View_WheelTrqLPFKd View_WheelTrqReqLPF /end REF_MEASUREMENT /end GROUP
/begin GROUP S2543_OptimalRpmSplit "LP_VCU020_AA_VCU/SWC/DTR_drvrTorqueReq/DrvCtrl/DriveCtl/Control/Drv10_OptimalTrqSplit/OptimalTrqSplit/OptimalRpmSplit" /begin REF_CHARACTERISTIC Cal_SpdScaleFactor2SpdCtl /end REF_CHARACTERISTIC /end GROUP
/begin GROUP S2550_ESCFuncActiveSt "LP_VCU020_AA_VCU/SWC/DTR_drvrTorqueReq/DrvCtrl/DriveCtl/Control/Drv11_StabilityControl/StabilityControl/ESCFuncActiveSt" /begin REF_MEASUREMENT View_ESCFuncActive /end REF_MEASUREMENT /end GROUP
/begin GROUP S2550_ESC_ABS_ActiveSts "LP_VCU020_AA_VCU/SWC/DTR_drvrTorqueReq/DrvCtrl/DriveCtl/Control/Drv11_StabilityControl/StabilityControl/ESC_ABS_ActiveSts" /begin REF_CHARACTERISTIC Cal_ClearABSActiveTrq Cal_SetABSActiveTrq /end REF_CHARACTERISTIC /begin REF_MEASUREMENT View_ABSActiveSts /end REF_MEASUREMENT /end GROUP
/begin GROUP S2550_ESC_AEB_ActiveSts "LP_VCU020_AA_VCU/SWC/DTR_drvrTorqueReq/DrvCtrl/DriveCtl/Control/Drv11_StabilityControl/StabilityControl/ESC_AEB_ActiveSts" /begin REF_MEASUREMENT View_AEBActiveSts /end REF_MEASUREMENT /end GROUP
/begin GROUP S2550_ESC_CDP_ActiveSts "LP_VCU020_AA_VCU/SWC/DTR_drvrTorqueReq/DrvCtrl/DriveCtl/Control/Drv11_StabilityControl/StabilityControl/ESC_CDP_ActiveSts" /begin REF_MEASUREMENT View_CDPActiveSts /end REF_MEASUREMENT /end GROUP
/begin GROUP S2550_ESC_ESP_ActiveSts "LP_VCU020_AA_VCU/SWC/DTR_drvrTorqueReq/DrvCtrl/DriveCtl/Control/Drv11_StabilityControl/StabilityControl/ESC_ESP_ActiveSts" /begin REF_MEASUREMENT View_ESPActiveSts /end REF_MEASUREMENT /end GROUP
/begin GROUP S2550_ESC_TrqResponeFilt "LP_VCU020_AA_VCU/SWC/DTR_drvrTorqueReq/DrvCtrl/DriveCtl/Control/Drv11_StabilityControl/StabilityControl/ESC_TrqResponeFilt"
 /begin REF_CHARACTERISTIC Cal_MotTrqDnRateLimit2ESCActive Cal_MotTrqUpRateLimit2ESCActive /end REF_CHARACTERISTIC
/end GROUP
/begin GROUP S2550_ESP_TCS_EDC_ActiveSts "LP_VCU020_AA_VCU/SWC/DTR_drvrTorqueReq/DrvCtrl/DriveCtl/Control/Drv11_StabilityControl/StabilityControl/ESP_TCS&EDC_ActiveSts" /begin REF_MEASUREMENT View_TCSActiveSts /end REF_MEASUREMENT /end GROUP
/begin GROUP S2646_StartUpCtlMode "LP_VCU020_AA_VCU/SWC/DTR_drvrTorqueReq/DrvCtrl/DriveCtl/Control/Drv12_StartUpControl/StartUpControl/StartUpCtlMode"
 /begin REF_CHARACTERISTIC Cal_DirectSpdThreshold Cal_StartUpActiveTrq Cal_StartUpInactiveSpd Cal_TrqDirectNegThreshold Cal_TrqDirectPosThreshold Cal_TrqDirectThreshold /end REF_CHARACTERISTIC
 /begin REF_MEASUREMENT View_StartUpCtlMode /end REF_MEASUREMENT
/end GROUP
/begin GROUP S2646_StartUpCtlTrqAdd "LP_VCU020_AA_VCU/SWC/DTR_drvrTorqueReq/DrvCtrl/DriveCtl/Control/Drv12_StartUpControl/StartUpControl/StartUpCtlTrqAdd"
 /begin REF_CHARACTERISTIC CalCrv_StartUpCtlTrqReq Cal_GearToggleInactiveTrq Cal_TrqDnRateLimit2StartUp Cal_TrqUpRateLimit2StartUp /end REF_CHARACTERISTIC
 /begin REF_MEASUREMENT View_StartUpCtlTrqAdd /end REF_MEASUREMENT
/end GROUP
/begin GROUP S2646_TrqDirectSwtRateLimit "LP_VCU020_AA_VCU/SWC/DTR_drvrTorqueReq/DrvCtrl/DriveCtl/Control/Drv12_StartUpControl/StartUpControl/TrqDirectSwtRateLimit"
 /begin SUB_GROUP S2655_TrqDirectSwtDnRateLimit S2655_TrqDirectSwtUpRateLimit /end SUB_GROUP
 /begin REF_CHARACTERISTIC Cal_TrqDnLineHighPar Cal_TrqDnLineLowPar Cal_TrqUpLineHighPar Cal_TrqUpLineLowPar /end REF_CHARACTERISTIC
/end GROUP
/begin GROUP S2646_VehDirectCtl "LP_VCU020_AA_VCU/SWC/DTR_drvrTorqueReq/DrvCtrl/DriveCtl/Control/Drv12_StartUpControl/StartUpControl/VehDirectCtl" /begin SUB_GROUP S2656_Enabled_Subsystem /end SUB_GROUP /begin REF_CHARACTERISTIC Cal_GearToggleInactiveTrq /end REF_CHARACTERISTIC /end GROUP
/begin GROUP S2646_case_0 "LP_VCU020_AA_VCU/SWC/DTR_drvrTorqueReq/DrvCtrl/DriveCtl/Control/Drv12_StartUpControl/StartUpControl/case_0"
 /begin REF_CHARACTERISTIC Cal_MotTrqDnRateLimit2ESCActive Cal_MotTrqUpRateLimit2ESCActive /end REF_CHARACTERISTIC
/end GROUP
/begin GROUP S2646_case_10 "LP_VCU020_AA_VCU/SWC/DTR_drvrTorqueReq/DrvCtrl/DriveCtl/Control/Drv12_StartUpControl/StartUpControl/case_10"
 /begin REF_CHARACTERISTIC Cal_TrqDnRateLimit2StartShakeRestr Cal_TrqUpRateLimit2StartShakeRestr /end REF_CHARACTERISTIC
/end GROUP
/begin GROUP S2646_case_20 "LP_VCU020_AA_VCU/SWC/DTR_drvrTorqueReq/DrvCtrl/DriveCtl/Control/Drv12_StartUpControl/StartUpControl/case_20"
 /begin REF_CHARACTERISTIC CalCrv_DrvTrqUpRateScaleFactorByPdlPct CalMap_MotTrqDnRateLimit2TrqCrossZero CalMap_MotTrqUpRateLimit2TrqCrossZero /end REF_CHARACTERISTIC
/end GROUP
/begin GROUP S2699_BrkLightCtl "LP_VCU020_AA_VCU/SWC/DTR_drvrTorqueReq/DrvCtrl/DriveCtl/Control/Drv13_SingalAggregate/SingalAggregate/BrkLightCtl"
 /begin REF_CHARACTERISTIC Cal_BrkLightMinCtlTm Cal_FixedStepSize Cal_VehAccn2BrkLightCancel Cal_VehAccn2BrkLightConfirm /end REF_CHARACTERISTIC
/end GROUP
/begin GROUP S2699_EPBCtl "LP_VCU020_AA_VCU/SWC/DTR_drvrTorqueReq/DrvCtrl/DriveCtl/Control/Drv13_SingalAggregate/SingalAggregate/EPBCtl" /begin REF_CHARACTERISTIC Cfg_EPBCtl Test_EPBCtl /end REF_CHARACTERISTIC /end GROUP
/begin GROUP S2699_VehiclePowerMode "LP_VCU020_AA_VCU/SWC/DTR_drvrTorqueReq/DrvCtrl/DriveCtl/Control/Drv13_SingalAggregate/SingalAggregate/VehiclePowerMode" /begin REF_CHARACTERISTIC Cal_FixedStepSize /end REF_CHARACTERISTIC /end GROUP
/begin GROUP S3029_delay_cond2 "LP_VCU020_AA_VCU/SWC/SPY_SignalPreSys/TempSensor/TempSensor/AcChgVolt/AccPedHSig_DigVolt/DTC_AccPedHSig_OV/delay_cond2" /begin REF_CHARACTERISTIC Cal_TempFaultStsCounter /end REF_CHARACTERISTIC /end GROUP
/begin GROUP S3029_delay_cond3 "LP_VCU020_AA_VCU/SWC/SPY_SignalPreSys/TempSensor/TempSensor/AcChgVolt/AccPedHSig_DigVolt/DTC_AccPedHSig_OV/delay_cond3" /begin REF_CHARACTERISTIC Cal_TempFaultStsCounter /end REF_CHARACTERISTIC /end GROUP
/begin GROUP S3030_delay_cond6 "LP_VCU020_AA_VCU/SWC/SPY_SignalPreSys/TempSensor/TempSensor/AcChgVolt/AccPedHSig_DigVolt/DTC_AccPedHSig_STB/delay_cond6" /begin REF_CHARACTERISTIC Cal_TempFaultStsCounter /end REF_CHARACTERISTIC /end GROUP
/begin GROUP S3030_delay_cond7 "LP_VCU020_AA_VCU/SWC/SPY_SignalPreSys/TempSensor/TempSensor/AcChgVolt/AccPedHSig_DigVolt/DTC_AccPedHSig_STB/delay_cond7" /begin REF_CHARACTERISTIC Cal_TempFaultStsCounter /end REF_CHARACTERISTIC /end GROUP
/begin GROUP S3031_delay_cond1 "LP_VCU020_AA_VCU/SWC/SPY_SignalPreSys/TempSensor/TempSensor/AcChgVolt/AccPedHSig_DigVolt/DTC_AccPedHSig_STG/delay_cond1" /begin REF_CHARACTERISTIC Cal_TempFaultStsCounter /end REF_CHARACTERISTIC /end GROUP
/begin GROUP S3031_delay_cond8 "LP_VCU020_AA_VCU/SWC/SPY_SignalPreSys/TempSensor/TempSensor/AcChgVolt/AccPedHSig_DigVolt/DTC_AccPedHSig_STG/delay_cond8" /begin REF_CHARACTERISTIC Cal_TempFaultStsCounter /end REF_CHARACTERISTIC /end GROUP
/begin GROUP S3055_delay_cond2 "LP_VCU020_AA_VCU/SWC/SPY_SignalPreSys/TempSensor/TempSensor/AcChgVolt/Subsystem/Subsystem2/delay_cond2" /begin REF_CHARACTERISTIC Cal_TempFaultStsCounter /end REF_CHARACTERISTIC /end GROUP
/begin GROUP S3055_delay_cond3 "LP_VCU020_AA_VCU/SWC/SPY_SignalPreSys/TempSensor/TempSensor/AcChgVolt/Subsystem/Subsystem2/delay_cond3" /begin REF_CHARACTERISTIC Cal_TempFaultStsCounter /end REF_CHARACTERISTIC /end GROUP
/begin GROUP S3072_delay_cond2 "LP_VCU020_AA_VCU/SWC/SPY_SignalPreSys/TempSensor/TempSensor/DcChgNVolt/AccPedHSig_DigVolt/DTC_AccPedHSig_OV/delay_cond2" /begin REF_CHARACTERISTIC Cal_TempFaultStsCounter /end REF_CHARACTERISTIC /end GROUP
/begin GROUP S3072_delay_cond3 "LP_VCU020_AA_VCU/SWC/SPY_SignalPreSys/TempSensor/TempSensor/DcChgNVolt/AccPedHSig_DigVolt/DTC_AccPedHSig_OV/delay_cond3" /begin REF_CHARACTERISTIC Cal_TempFaultStsCounter /end REF_CHARACTERISTIC /end GROUP
/begin GROUP S3073_delay_cond6 "LP_VCU020_AA_VCU/SWC/SPY_SignalPreSys/TempSensor/TempSensor/DcChgNVolt/AccPedHSig_DigVolt/DTC_AccPedHSig_STB/delay_cond6" /begin REF_CHARACTERISTIC Cal_TempFaultStsCounter /end REF_CHARACTERISTIC /end GROUP
/begin GROUP S3073_delay_cond7 "LP_VCU020_AA_VCU/SWC/SPY_SignalPreSys/TempSensor/TempSensor/DcChgNVolt/AccPedHSig_DigVolt/DTC_AccPedHSig_STB/delay_cond7" /begin REF_CHARACTERISTIC Cal_TempFaultStsCounter /end REF_CHARACTERISTIC /end GROUP
/begin GROUP S3074_delay_cond1 "LP_VCU020_AA_VCU/SWC/SPY_SignalPreSys/TempSensor/TempSensor/DcChgNVolt/AccPedHSig_DigVolt/DTC_AccPedHSig_STG/delay_cond1" /begin REF_CHARACTERISTIC Cal_TempFaultStsCounter /end REF_CHARACTERISTIC /end GROUP
/begin GROUP S3074_delay_cond8 "LP_VCU020_AA_VCU/SWC/SPY_SignalPreSys/TempSensor/TempSensor/DcChgNVolt/AccPedHSig_DigVolt/DTC_AccPedHSig_STG/delay_cond8" /begin REF_CHARACTERISTIC Cal_TempFaultStsCounter /end REF_CHARACTERISTIC /end GROUP
/begin GROUP S3098_delay_cond2 "LP_VCU020_AA_VCU/SWC/SPY_SignalPreSys/TempSensor/TempSensor/DcChgNVolt/Subsystem/Subsystem2/delay_cond2" /begin REF_CHARACTERISTIC Cal_TempFaultStsCounter /end REF_CHARACTERISTIC /end GROUP
/begin GROUP S3098_delay_cond3 "LP_VCU020_AA_VCU/SWC/SPY_SignalPreSys/TempSensor/TempSensor/DcChgNVolt/Subsystem/Subsystem2/delay_cond3" /begin REF_CHARACTERISTIC Cal_TempFaultStsCounter /end REF_CHARACTERISTIC /end GROUP
/begin GROUP S3115_delay_cond2 "LP_VCU020_AA_VCU/SWC/SPY_SignalPreSys/TempSensor/TempSensor/DcChgPVolt/AccPedHSig_DigVolt/DTC_AccPedHSig_OV/delay_cond2" /begin REF_CHARACTERISTIC Cal_TempFaultStsCounter /end REF_CHARACTERISTIC /end GROUP
/begin GROUP S3115_delay_cond3 "LP_VCU020_AA_VCU/SWC/SPY_SignalPreSys/TempSensor/TempSensor/DcChgPVolt/AccPedHSig_DigVolt/DTC_AccPedHSig_OV/delay_cond3" /begin REF_CHARACTERISTIC Cal_TempFaultStsCounter /end REF_CHARACTERISTIC /end GROUP
/begin GROUP S3116_delay_cond6 "LP_VCU020_AA_VCU/SWC/SPY_SignalPreSys/TempSensor/TempSensor/DcChgPVolt/AccPedHSig_DigVolt/DTC_AccPedHSig_STB/delay_cond6" /begin REF_CHARACTERISTIC Cal_TempFaultStsCounter /end REF_CHARACTERISTIC /end GROUP
/begin GROUP S3116_delay_cond7 "LP_VCU020_AA_VCU/SWC/SPY_SignalPreSys/TempSensor/TempSensor/DcChgPVolt/AccPedHSig_DigVolt/DTC_AccPedHSig_STB/delay_cond7" /begin REF_CHARACTERISTIC Cal_TempFaultStsCounter /end REF_CHARACTERISTIC /end GROUP
/begin GROUP S3117_delay_cond1 "LP_VCU020_AA_VCU/SWC/SPY_SignalPreSys/TempSensor/TempSensor/DcChgPVolt/AccPedHSig_DigVolt/DTC_AccPedHSig_STG/delay_cond1" /begin REF_CHARACTERISTIC Cal_TempFaultStsCounter /end REF_CHARACTERISTIC /end GROUP
/begin GROUP S3117_delay_cond8 "LP_VCU020_AA_VCU/SWC/SPY_SignalPreSys/TempSensor/TempSensor/DcChgPVolt/AccPedHSig_DigVolt/DTC_AccPedHSig_STG/delay_cond8" /begin REF_CHARACTERISTIC Cal_TempFaultStsCounter /end REF_CHARACTERISTIC /end GROUP
/begin GROUP S3141_delay_cond2 "LP_VCU020_AA_VCU/SWC/SPY_SignalPreSys/TempSensor/TempSensor/DcChgPVolt/Subsystem/Subsystem2/delay_cond2" /begin REF_CHARACTERISTIC Cal_TempFaultStsCounter /end REF_CHARACTERISTIC /end GROUP
/begin GROUP S3141_delay_cond3 "LP_VCU020_AA_VCU/SWC/SPY_SignalPreSys/TempSensor/TempSensor/DcChgPVolt/Subsystem/Subsystem2/delay_cond3" /begin REF_CHARACTERISTIC Cal_TempFaultStsCounter /end REF_CHARACTERISTIC /end GROUP
/begin GROUP S1720_VehAccnPreCalc "LP_VCU020_AA_VCU/SWC/DTR_drvrTorqueReq/DrvCtrl/DriveCtl/Control/Drv01_DynamicCalc/DynamicCalc/Calc_VehAccn/VehAccnPreCalc" /begin REF_CHARACTERISTIC Cal_FixedStepSize Cal_VehAccnCalcPar1 Cal_VehAccnCalcPar2 /end REF_CHARACTERISTIC /end GROUP
/begin GROUP S1721_FrontMotRpmFilt "LP_VCU020_AA_VCU/SWC/DTR_drvrTorqueReq/DrvCtrl/DriveCtl/Control/Drv01_DynamicCalc/DynamicCalc/Calc_VehSpd/FrontMotRpmFilt" /begin REF_CHARACTERISTIC Cal_FrontMotRpmLPFKd /end REF_CHARACTERISTIC /end GROUP
/begin GROUP S1721_FrontWheelSpdFilt "LP_VCU020_AA_VCU/SWC/DTR_drvrTorqueReq/DrvCtrl/DriveCtl/Control/Drv01_DynamicCalc/DynamicCalc/Calc_VehSpd/FrontWheelSpdFilt" /begin REF_CHARACTERISTIC Cal_FrontWheelSpdLPFKd /end REF_CHARACTERISTIC /end GROUP
/begin GROUP S1721_RearWheelSpdFilt "LP_VCU020_AA_VCU/SWC/DTR_drvrTorqueReq/DrvCtrl/DriveCtl/Control/Drv01_DynamicCalc/DynamicCalc/Calc_VehSpd/RearWheelSpdFilt" /begin REF_CHARACTERISTIC Cal_RearWheelSpdLPFKd /end REF_CHARACTERISTIC /end GROUP
/begin GROUP S1721_ReferVehSpdFilt "LP_VCU020_AA_VCU/SWC/DTR_drvrTorqueReq/DrvCtrl/DriveCtl/Control/Drv01_DynamicCalc/DynamicCalc/Calc_VehSpd/ReferVehSpdFilt" /begin SUB_GROUP S1746_Subsystem /end SUB_GROUP
 /begin REF_CHARACTERISTIC Cal_SpdChooseSwithThreshold Cal_SpdChooseSwithThreshold1 Cal_SpdDirectMotRpmThreshold /end REF_CHARACTERISTIC
/end GROUP
/begin GROUP S1721_VehSpdFilt "LP_VCU020_AA_VCU/SWC/DTR_drvrTorqueReq/DrvCtrl/DriveCtl/Control/Drv01_DynamicCalc/DynamicCalc/Calc_VehSpd/VehSpdFilt" /begin REF_CHARACTERISTIC CalCrv_VehSpdLPFKd /end REF_CHARACTERISTIC /end GROUP
/begin GROUP S1721_ZeroSpdConfirm "LP_VCU020_AA_VCU/SWC/DTR_drvrTorqueReq/DrvCtrl/DriveCtl/Control/Drv01_DynamicCalc/DynamicCalc/Calc_VehSpd/ZeroSpdConfirm"
 /begin REF_CHARACTERISTIC Cal_MaxMotRpm2ZeroSpdSt Cal_MaxSpd2ZeroSpdSt Cal_ZeroSpdCancelTm Cal_ZeroSpdConfirmTm /end REF_CHARACTERISTIC
/end GROUP
/begin GROUP S1723_ACCFunction "LP_VCU020_AA_VCU/SWC/DTR_drvrTorqueReq/DrvCtrl/DriveCtl/Control/Drv01_DynamicCalc/DynamicCalc/FunctionConfig/ACCFunction" /begin REF_CHARACTERISTIC Cfg_ACCFunction /end REF_CHARACTERISTIC /end GROUP
/begin GROUP S1723_APSFunction "LP_VCU020_AA_VCU/SWC/DTR_drvrTorqueReq/DrvCtrl/DriveCtl/Control/Drv01_DynamicCalc/DynamicCalc/FunctionConfig/APSFunction" /begin REF_CHARACTERISTIC Cfg_APSFunction /end REF_CHARACTERISTIC /end GROUP
/begin GROUP S1723_BarrateMode "LP_VCU020_AA_VCU/SWC/DTR_drvrTorqueReq/DrvCtrl/DriveCtl/Control/Drv01_DynamicCalc/DynamicCalc/FunctionConfig/BarrateMode" /begin REF_CHARACTERISTIC Cfg_BarrateMode /end REF_CHARACTERISTIC /end GROUP
/begin GROUP S1723_BrkRecFunction "LP_VCU020_AA_VCU/SWC/DTR_drvrTorqueReq/DrvCtrl/DriveCtl/Control/Drv01_DynamicCalc/DynamicCalc/FunctionConfig/BrkRecFunction" /begin REF_CHARACTERISTIC Cfg_BrkRecFunction Test_BrkRecFunction /end REF_CHARACTERISTIC /end GROUP
/begin GROUP S1723_CCSFunction "LP_VCU020_AA_VCU/SWC/DTR_drvrTorqueReq/DrvCtrl/DriveCtl/Control/Drv01_DynamicCalc/DynamicCalc/FunctionConfig/CCSFunction" /begin REF_CHARACTERISTIC Cfg_CCSFunction /end REF_CHARACTERISTIC /end GROUP
/begin GROUP S1723_DrvModeCtl "LP_VCU020_AA_VCU/SWC/DTR_drvrTorqueReq/DrvCtrl/DriveCtl/Control/Drv01_DynamicCalc/DynamicCalc/FunctionConfig/DrvModeCtl"
 /begin REF_CHARACTERISTIC Cfg_AccnModeGearD Cfg_AccnModeGearR Cfg_DecnModeGearD Cfg_DecnModeGearR Test_AccnModeGearD Test_AccnModeGearR Test_DecnModeGearD Test_DecnModeGearR /end REF_CHARACTERISTIC
/end GROUP
/begin GROUP S1723_ESCFunction "LP_VCU020_AA_VCU/SWC/DTR_drvrTorqueReq/DrvCtrl/DriveCtl/Control/Drv01_DynamicCalc/DynamicCalc/FunctionConfig/ESCFunction" /begin REF_CHARACTERISTIC Cfg_ABSFuncRes Cfg_ESCFuncRes /end REF_CHARACTERISTIC /end GROUP
/begin GROUP S1723_HACFunction "LP_VCU020_AA_VCU/SWC/DTR_drvrTorqueReq/DrvCtrl/DriveCtl/Control/Drv01_DynamicCalc/DynamicCalc/FunctionConfig/HACFunction" /begin REF_CHARACTERISTIC Cfg_HACFunctionGearD Cfg_HACFunctionGearR /end REF_CHARACTERISTIC /end GROUP
/begin GROUP S1723_HDCFunction "LP_VCU020_AA_VCU/SWC/DTR_drvrTorqueReq/DrvCtrl/DriveCtl/Control/Drv01_DynamicCalc/DynamicCalc/FunctionConfig/HDCFunction" /begin REF_CHARACTERISTIC Cfg_HDCFunction /end REF_CHARACTERISTIC /end GROUP
/begin GROUP S1723_MaxSpdLimit "LP_VCU020_AA_VCU/SWC/DTR_drvrTorqueReq/DrvCtrl/DriveCtl/Control/Drv01_DynamicCalc/DynamicCalc/FunctionConfig/MaxSpdLimit" /begin REF_CHARACTERISTIC Cfg_MaxSpdLimit /end REF_CHARACTERISTIC /end GROUP
/begin GROUP S1723_SlipRecFunction "LP_VCU020_AA_VCU/SWC/DTR_drvrTorqueReq/DrvCtrl/DriveCtl/Control/Drv01_DynamicCalc/DynamicCalc/FunctionConfig/SlipRecFunction" /begin REF_CHARACTERISTIC Cfg_SlipRecFunction Test_SlipRecFunction /end REF_CHARACTERISTIC /end GROUP
/begin GROUP S1723_StartUpCtl "LP_VCU020_AA_VCU/SWC/DTR_drvrTorqueReq/DrvCtrl/DriveCtl/Control/Drv01_DynamicCalc/DynamicCalc/FunctionConfig/StartUpCtl" /begin REF_CHARACTERISTIC Cfg_StartUpCtl Cfg_TrqDirectSwtCtl /end REF_CHARACTERISTIC /end GROUP
/begin GROUP S1723_ZeroSpdCtl "LP_VCU020_AA_VCU/SWC/DTR_drvrTorqueReq/DrvCtrl/DriveCtl/Control/Drv01_DynamicCalc/DynamicCalc/FunctionConfig/ZeroSpdCtl" /begin REF_CHARACTERISTIC Cfg_ZeroSpdCtlGearD Cfg_ZeroSpdCtlGearR Test_ZeroSpdCtl /end REF_CHARACTERISTIC /end GROUP
/begin GROUP S2006_MaxRecTrq "LP_VCU020_AA_VCU/SWC/DTR_drvrTorqueReq/DrvCtrl/DriveCtl/Control/Drv03_DriverRequestAnalysis/DriverRequestAnalysis/LowSpdRecTrqCtl/MaxRecTrq"
 /begin REF_CHARACTERISTIC CalCrv_RecTrqScaleFactor Cal_LowSpdThreshold Cal_MinMaxRecTrq /end REF_CHARACTERISTIC
/end GROUP
/begin GROUP S2034_ACC_PauseByAccPdl "LP_VCU020_AA_VCU/SWC/DTR_drvrTorqueReq/DrvCtrl/DriveCtl/Control/Drv04_AdditionalFunctionCtl/AdditionalFunctionCtl/ACC/ACC_PauseByAccPdl" /begin REF_CHARACTERISTIC Cal_AccPdlActiveTrqOffSet2ACC /end REF_CHARACTERISTIC /end GROUP
/begin GROUP S2034_ACC_SpdCtlMode "LP_VCU020_AA_VCU/SWC/DTR_drvrTorqueReq/DrvCtrl/DriveCtl/Control/Drv04_AdditionalFunctionCtl/AdditionalFunctionCtl/ACC/ACC_SpdCtlMode" /begin REF_CHARACTERISTIC Cal_ACCAccnCtlMode /end REF_CHARACTERISTIC /end GROUP
/begin GROUP S2034_WheelTrqReq "LP_VCU020_AA_VCU/SWC/DTR_drvrTorqueReq/DrvCtrl/DriveCtl/Control/Drv04_AdditionalFunctionCtl/AdditionalFunctionCtl/ACC/WheelTrqReq" /begin REF_MEASUREMENT View_ACCWheelTrqReq /end REF_MEASUREMENT /end GROUP
/begin GROUP S2037_APSPauseByAccPdl "LP_VCU020_AA_VCU/SWC/DTR_drvrTorqueReq/DrvCtrl/DriveCtl/Control/Drv04_AdditionalFunctionCtl/AdditionalFunctionCtl/APS/APSPauseByAccPdl" /begin REF_CHARACTERISTIC Cal_APSPdlActiveDeltaTrq /end REF_CHARACTERISTIC /end GROUP
/begin GROUP S2037_APS_SpdCtlMode "LP_VCU020_AA_VCU/SWC/DTR_drvrTorqueReq/DrvCtrl/DriveCtl/Control/Drv04_AdditionalFunctionCtl/AdditionalFunctionCtl/APS/APS_SpdCtlMode" /begin REF_CHARACTERISTIC Cal_APSAccnCtlMode Cal_APSActiveMaxSpd /end REF_CHARACTERISTIC /end GROUP
/begin GROUP S2037_WheelTrqReq "LP_VCU020_AA_VCU/SWC/DTR_drvrTorqueReq/DrvCtrl/DriveCtl/Control/Drv04_AdditionalFunctionCtl/AdditionalFunctionCtl/APS/WheelTrqReq" /begin REF_MEASUREMENT View_APSWheelTrqReq /end REF_MEASUREMENT /end GROUP
/begin GROUP S2041_CCSTarSpdLimit "LP_VCU020_AA_VCU/SWC/DTR_drvrTorqueReq/DrvCtrl/DriveCtl/Control/Drv04_AdditionalFunctionCtl/AdditionalFunctionCtl/CCS/CCSTarSpdLimit" /begin REF_CHARACTERISTIC Cal_CCSTarSpdOffSet Cal_MaxSpd2CCS Cal_MinSpd2CCS /end REF_CHARACTERISTIC /begin REF_MEASUREMENT View_CruiseTargetSpd View_CuriseOutTargetSpd /end REF_MEASUREMENT /end GROUP
/begin GROUP S2041_VehSpd "LP_VCU020_AA_VCU/SWC/DTR_drvrTorqueReq/DrvCtrl/DriveCtl/Control/Drv04_AdditionalFunctionCtl/AdditionalFunctionCtl/CCS/VehSpd" /begin REF_CHARACTERISTIC Cal_VehSpdScaleFactor2CCSCtl /end REF_CHARACTERISTIC /end GROUP
/begin GROUP S2268_BrkForceOn_TrqResponse "LP_VCU020_AA_VCU/SWC/DTR_drvrTorqueReq/DrvCtrl/DriveCtl/Control/Drv05_CreepCtl/CreepCtl/CreepCtl/BrkForceOn_TrqResponse" /begin REF_CHARACTERISTIC Cal_BrkOnDPIDMinSpd Cal_BrkOnPIDMinSpd /end REF_CHARACTERISTIC /end GROUP
/begin GROUP S2268_Par_PID "LP_VCU020_AA_VCU/SWC/DTR_drvrTorqueReq/DrvCtrl/DriveCtl/Control/Drv05_CreepCtl/CreepCtl/CreepCtl/Par_PID" /begin REF_CHARACTERISTIC CalCrv_KdCreepCtl CalCrv_KiCreepCtl CalCrv_KpCreepCtl /end REF_CHARACTERISTIC /end GROUP
/begin GROUP S2268_ek_Trim "LP_VCU020_AA_VCU/SWC/DTR_drvrTorqueReq/DrvCtrl/DriveCtl/Control/Drv05_CreepCtl/CreepCtl/CreepCtl/ek_Trim" /begin REF_CHARACTERISTIC Cal_CreepTarSpdLowDeadband Cal_CreepTarSpdUpDeadband /end REF_CHARACTERISTIC /end GROUP
/begin GROUP S2269_Relay_BrkPdl "LP_VCU020_AA_VCU/SWC/DTR_drvrTorqueReq/DrvCtrl/DriveCtl/Control/Drv05_CreepCtl/CreepCtl/CreepModeActive/Relay_BrkPdl" /begin REF_CHARACTERISTIC Cal_BrkOffDelay Cal_BrkOnDelay /end REF_CHARACTERISTIC /end GROUP
/begin GROUP S2329_TrqDecByAVH "LP_VCU020_AA_VCU/SWC/DTR_drvrTorqueReq/DrvCtrl/DriveCtl/Control/Drv06_HillstartAssistControl/HillstartAssistControl/HACInactiveTrqDec/TrqDecByAVH"
 /begin REF_CHARACTERISTIC CalCrv_TrqDnRate2HACAVHActive CalCrv_TrqUpRate2HACAVHActive Cal_FixedStepSize /end REF_CHARACTERISTIC
/end GROUP
/begin GROUP S2329_TrqDecByEPB "LP_VCU020_AA_VCU/SWC/DTR_drvrTorqueReq/DrvCtrl/DriveCtl/Control/Drv06_HillstartAssistControl/HillstartAssistControl/HACInactiveTrqDec/TrqDecByEPB"
 /begin REF_CHARACTERISTIC CalCrv_TrqDnRate2HACEPBActive CalCrv_TrqUpRate2HACEPBActive Cal_FixedStepSize /end REF_CHARACTERISTIC
/end GROUP
/begin GROUP S2330_HAC_ActiveReq "LP_VCU020_AA_VCU/SWC/DTR_drvrTorqueReq/DrvCtrl/DriveCtl/Control/Drv06_HillstartAssistControl/HillstartAssistControl/HAC_Active/HAC_ActiveReq"
 /begin REF_CHARACTERISTIC Cal_HACActiveHighMotRpm Cal_HACActiveLowMotRpm Cal_HACActiveVehSpd Cal_HACMode2LowMotRpmDelay /end REF_CHARACTERISTIC
/end GROUP
/begin GROUP S2330_HAC_ActiveSts "LP_VCU020_AA_VCU/SWC/DTR_drvrTorqueReq/DrvCtrl/DriveCtl/Control/Drv06_HillstartAssistControl/HillstartAssistControl/HAC_Active/HAC_ActiveSts" /begin REF_CHARACTERISTIC Cal_HacBackSlipInactiveSpd /end REF_CHARACTERISTIC /end GROUP
/begin GROUP S2330_HAC_InactiveReq "LP_VCU020_AA_VCU/SWC/DTR_drvrTorqueReq/DrvCtrl/DriveCtl/Control/Drv06_HillstartAssistControl/HillstartAssistControl/HAC_Active/HAC_InactiveReq"
 /begin REF_CHARACTERISTIC Cal_HACInactiveVehSpd Cal_HACMode1ClearTrq Cal_HACMode2ClearTrq Cal_HACTrqClearConfirmTm Cal_HACTrqClearThreshold /end REF_CHARACTERISTIC
/end GROUP
/begin GROUP S2332_Par_PID_HAC1 "LP_VCU020_AA_VCU/SWC/DTR_drvrTorqueReq/DrvCtrl/DriveCtl/Control/Drv06_HillstartAssistControl/HillstartAssistControl/HillstartAssistControl/Par_PID_HAC1"
 /begin REF_CHARACTERISTIC CalCrv_KdHACWithSlowDown CalCrv_KiHACWithSlowDown CalCrv_KpHACWithSlowDown /end REF_CHARACTERISTIC
/end GROUP
/begin GROUP S2332_Par_PID_HAC2 "LP_VCU020_AA_VCU/SWC/DTR_drvrTorqueReq/DrvCtrl/DriveCtl/Control/Drv06_HillstartAssistControl/HillstartAssistControl/HillstartAssistControl/Par_PID_HAC2"
 /begin REF_CHARACTERISTIC CalCrv_KdHACWithBackSlide1 CalCrv_KiHACWithBackSlide1 CalCrv_KpHACWithBackSlide1 /end REF_CHARACTERISTIC
/end GROUP
/begin GROUP S2332_Par_PID_HAC3 "LP_VCU020_AA_VCU/SWC/DTR_drvrTorqueReq/DrvCtrl/DriveCtl/Control/Drv06_HillstartAssistControl/HillstartAssistControl/HillstartAssistControl/Par_PID_HAC3"
 /begin REF_CHARACTERISTIC CalCrv_KdHACWithBackSlide2 CalCrv_KiHACWithBackSlide2 CalCrv_KpHACWithBackSlide2 /end REF_CHARACTERISTIC
/end GROUP
/begin GROUP S2333_HacInactiveReqJudge "LP_VCU020_AA_VCU/SWC/DTR_drvrTorqueReq/DrvCtrl/DriveCtl/Control/Drv06_HillstartAssistControl/HillstartAssistControl/Judge/HacInactiveReqJudge"
 /begin REF_CHARACTERISTIC CalCrv_TrqThreshold2HAC Cal_HacDecConfirmTm Cal_HacDecPdlPct /end REF_CHARACTERISTIC
/end GROUP
/begin GROUP S2420_VCU_HDCActiveRecTrq "LP_VCU020_AA_VCU/SWC/DTR_drvrTorqueReq/DrvCtrl/DriveCtl/Control/Drv07_HillDescentControl/HillDescentControl/HDCActive/VCU_HDCActiveRecTrq" /begin REF_CHARACTERISTIC Cal_HDCActiveRecTrqLv1 Cal_HDCActiveRecTrqLv2 /end REF_CHARACTERISTIC /end GROUP
/begin GROUP S2421_Subsystem "LP_VCU020_AA_VCU/SWC/DTR_drvrTorqueReq/DrvCtrl/DriveCtl/Control/Drv07_HillDescentControl/HillDescentControl/HillDescentControl/Subsystem" /begin REF_CHARACTERISTIC CalCrv_KdHDC CalCrv_KiHDC CalCrv_KpHDC /end REF_CHARACTERISTIC /end GROUP
/begin GROUP S2451_Par_PID "LP_VCU020_AA_VCU/SWC/DTR_drvrTorqueReq/DrvCtrl/DriveCtl/Control/Drv08_MaxSpdLimit/MaxSpdLimit/Calc_MaxSpdLimit/Par_PID"
 /begin SUB_GROUP S2462_Subsystem S2462_Subsystem1 S2462_Subsystem2 S2462_Subsystem3 /end SUB_GROUP
/end GROUP
/begin GROUP S2455_EcoModeSpdLimit "LP_VCU020_AA_VCU/SWC/DTR_drvrTorqueReq/DrvCtrl/DriveCtl/Control/Drv08_MaxSpdLimit/MaxSpdLimit/MaxSpdLimit/EcoModeSpdLimit" /begin REF_CHARACTERISTIC Cal_EcoModeMaxSpdLowLimit Cal_EcoModeMaxSpdUpLimit /end REF_CHARACTERISTIC /end GROUP
/begin GROUP S2500_DrvModeRateLimit "LP_VCU020_AA_VCU/SWC/DTR_drvrTorqueReq/DrvCtrl/DriveCtl/Control/Drv09_TotWheelTrqRateLimit/TotWheelTrqRateLimit/Calc_WheelTrqSmoothPar/DrvModeRateLimit"
 /begin REF_CHARACTERISTIC CalCrv_DrvTrqDnRateLimitByLastTrq CalCrv_DrvTrqDnRateLimitByVehSpd CalCrv_DrvTrqUpRateLimitByLastTrq CalCrv_DrvTrqUpRateLimitByVehSpd CalCrv_DrvTrqUpRateScaleFactorByPdlPct Cal_MaxDrvTrqUpRate /end REF_CHARACTERISTIC
/end GROUP
/begin GROUP S2500_GearToggle "LP_VCU020_AA_VCU/SWC/DTR_drvrTorqueReq/DrvCtrl/DriveCtl/Control/Drv09_TotWheelTrqRateLimit/TotWheelTrqRateLimit/Calc_WheelTrqSmoothPar/GearToggle" /begin SUB_GROUP S2515_TrqUpRate_ByTm S2515_TrqUpRate_ByTrq /end SUB_GROUP /end GROUP
/begin GROUP S2500_HACMode "LP_VCU020_AA_VCU/SWC/DTR_drvrTorqueReq/DrvCtrl/DriveCtl/Control/Drv09_TotWheelTrqRateLimit/TotWheelTrqRateLimit/Calc_WheelTrqSmoothPar/HACMode"
 /begin REF_CHARACTERISTIC CalCrv_HACMode1TrqDnRate CalCrv_HACMode1TrqUpRate CalCrv_HACMode2TrqDnRate CalCrv_HACMode2TrqUpRate /end REF_CHARACTERISTIC
/end GROUP
/begin GROUP S2500_RecModeRateLimit "LP_VCU020_AA_VCU/SWC/DTR_drvrTorqueReq/DrvCtrl/DriveCtl/Control/Drv09_TotWheelTrqRateLimit/TotWheelTrqRateLimit/Calc_WheelTrqSmoothPar/RecModeRateLimit"
 /begin REF_CHARACTERISTIC CalCrv_DrvTrqUpRateScaleFactorByPdlPct CalCrv_RecTrqDnRateLimitByLastTrq CalCrv_RecTrqDnRateLimitByVehSpd CalCrv_RecTrqUpRateLimitByLastTrq CalCrv_RecTrqUpRateLimitByVehSpd Cal_MaxRecTrqUpRate /end REF_CHARACTERISTIC
/end GROUP
/begin GROUP S2500_WheelTrqReqRateLimit "LP_VCU020_AA_VCU/SWC/DTR_drvrTorqueReq/DrvCtrl/DriveCtl/Control/Drv09_TotWheelTrqRateLimit/TotWheelTrqRateLimit/Calc_WheelTrqSmoothPar/WheelTrqReqRateLimit" /begin REF_MEASUREMENT View_WheelTrqReqRateLimit /end REF_MEASUREMENT /end GROUP
/begin GROUP S2655_TrqDirectSwtDnRateLimit "LP_VCU020_AA_VCU/SWC/DTR_drvrTorqueReq/DrvCtrl/DriveCtl/Control/Drv12_StartUpControl/StartUpControl/TrqDirectSwtRateLimit/TrqDirectSwtDnRateLimit" /begin REF_CHARACTERISTIC CalMap_TrqDirectSwtDnRateLimit /end REF_CHARACTERISTIC /end GROUP
/begin GROUP S2655_TrqDirectSwtUpRateLimit "LP_VCU020_AA_VCU/SWC/DTR_drvrTorqueReq/DrvCtrl/DriveCtl/Control/Drv12_StartUpControl/StartUpControl/TrqDirectSwtRateLimit/TrqDirectSwtUpRateLimit" /begin REF_CHARACTERISTIC CalMap_TrqDirectSwtUpRateLimit /end REF_CHARACTERISTIC /end GROUP
/begin GROUP S2656_Enabled_Subsystem "LP_VCU020_AA_VCU/SWC/DTR_drvrTorqueReq/DrvCtrl/DriveCtl/Control/Drv12_StartUpControl/StartUpControl/VehDirectCtl/Enabled Subsystem" /begin REF_CHARACTERISTIC Cal_FixedStepSize Cal_GearToggleStsMaxTm /end REF_CHARACTERISTIC /end GROUP
/begin GROUP S1746_Subsystem "LP_VCU020_AA_VCU/SWC/DTR_drvrTorqueReq/DrvCtrl/DriveCtl/Control/Drv01_DynamicCalc/DynamicCalc/Calc_VehSpd/ReferVehSpdFilt/Subsystem" /begin SUB_GROUP S1785_MotRpm /end SUB_GROUP /end GROUP
/begin GROUP S2462_Subsystem "LP_VCU020_AA_VCU/SWC/DTR_drvrTorqueReq/DrvCtrl/DriveCtl/Control/Drv08_MaxSpdLimit/MaxSpdLimit/Calc_MaxSpdLimit/Par_PID/Subsystem" /begin REF_CHARACTERISTIC CalCrv_KdSpdLimit1 CalCrv_KiSpdLimit1 CalCrv_KpSpdLimit1 /end REF_CHARACTERISTIC /end GROUP
/begin GROUP S2462_Subsystem1 "LP_VCU020_AA_VCU/SWC/DTR_drvrTorqueReq/DrvCtrl/DriveCtl/Control/Drv08_MaxSpdLimit/MaxSpdLimit/Calc_MaxSpdLimit/Par_PID/Subsystem1" /begin REF_CHARACTERISTIC CalCrv_KdSpdLimit2 CalCrv_KiSpdLimit2 CalCrv_KpSpdLimit2 /end REF_CHARACTERISTIC /end GROUP
/begin GROUP S2462_Subsystem2 "LP_VCU020_AA_VCU/SWC/DTR_drvrTorqueReq/DrvCtrl/DriveCtl/Control/Drv08_MaxSpdLimit/MaxSpdLimit/Calc_MaxSpdLimit/Par_PID/Subsystem2" /begin REF_CHARACTERISTIC CalCrv_KdSpdLimit3 CalCrv_KiSpdLimit3 CalCrv_KpSpdLimit3 /end REF_CHARACTERISTIC /end GROUP
/begin GROUP S2462_Subsystem3 "LP_VCU020_AA_VCU/SWC/DTR_drvrTorqueReq/DrvCtrl/DriveCtl/Control/Drv08_MaxSpdLimit/MaxSpdLimit/Calc_MaxSpdLimit/Par_PID/Subsystem3" /begin REF_CHARACTERISTIC CalCrv_KdSpdLimit4 CalCrv_KiSpdLimit4 CalCrv_KpSpdLimit4 /end REF_CHARACTERISTIC /end GROUP
/begin GROUP S2515_TrqUpRate_ByTm "LP_VCU020_AA_VCU/SWC/DTR_drvrTorqueReq/DrvCtrl/DriveCtl/Control/Drv09_TotWheelTrqRateLimit/TotWheelTrqRateLimit/Calc_WheelTrqSmoothPar/GearToggle/TrqUpRate_ByTm"
 /begin REF_CHARACTERISTIC CalCrv_TrqQuickDnRate2GearN CalCrv_TrqQuickUpRate2GearN CalCrv_TrqSlowDnRate2GearN CalCrv_TrqSlowUpRate2GearN Cal_FixedStepSize /end REF_CHARACTERISTIC
/end GROUP
/begin GROUP S2515_TrqUpRate_ByTrq "LP_VCU020_AA_VCU/SWC/DTR_drvrTorqueReq/DrvCtrl/DriveCtl/Control/Drv09_TotWheelTrqRateLimit/TotWheelTrqRateLimit/Calc_WheelTrqSmoothPar/GearToggle/TrqUpRate_ByTrq" /begin REF_CHARACTERISTIC CalCrv_TrqDnRateLastTrqGearN CalCrv_TrqUpRateLastTrqGearN /end REF_CHARACTERISTIC /end GROUP
/begin GROUP S1785_MotRpm "LP_VCU020_AA_VCU/SWC/DTR_drvrTorqueReq/DrvCtrl/DriveCtl/Control/Drv01_DynamicCalc/DynamicCalc/Calc_VehSpd/ReferVehSpdFilt/Subsystem/MotRpm" /begin REF_CHARACTERISTIC CalCrv_MotRpmScaleFactor Cal_MotRpmValid2SpdCalc /end REF_CHARACTERISTIC /end GROUP
/end MODULE
/end PROJECT
/* (add any file trailer comments here) */
/* EOF LP_VCU020_AA_VCU.a2l */
